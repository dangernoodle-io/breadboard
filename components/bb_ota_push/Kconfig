## components/bb_pub/Kconfig
```kconfig
menu "breadboard: bb_pub"

config BB_PUB_MAX_SOURCES
    int "Maximum number of registered telemetry sources"
    default 16
    range 1 64
    help
        Capacity of the source registry (a fixed static array — no heap). Each
        slot is ~50 B of BSS. Attempting to register more sources than this
        returns BB_ERR_NO_SPACE (logged as "registry full ... dropped"); a
        high-watermark warning is logged at capacity minus one. Default 16: a
        full consumer registers ~8 sources today (wifi/thermal/rtos/power/info/
        health/fan + net_health), so 8 left no headroom for future sources.

config BB_PUB_MAX_SINKS
    int "Maximum number of concurrent telemetry sinks"
    default 4
    range 1 8
    help
        Capacity of the sink array for fan-out publishing. Attempting to add
        more sinks than this returns BB_ERR_NO_SPACE. bb_pub_set_sink (single-
        sink back-compat) replaces all sinks with one, so this limit only
        applies to callers using bb_pub_add_sink directly.

config BB_PUB_TOPIC_PREFIX
    string "MQTT topic prefix for published telemetry"
    default "metrics"
    help
        The first segment of the publish topic:
          <BB_PUB_TOPIC_PREFIX>/<hostname>/<subtopic>

config BB_METRICS_PREFIX
    string "Default Prometheus metric name prefix"
    default "bb"
    help
        Prefix prepended to all metric names emitted by GET /api/metrics
        (served by bb_telemetry). Consumers can override at runtime via
        bb_pub_set_metrics_prefix().

config BB_PUB_INTERVAL_MS
    int "Telemetry publish interval in milliseconds"
    default 10000
    range 1000 3600000
    help
        How often bb_pub fires the sample+publish cycle on ESP-IDF (via
        bb_timer periodic). Not used on host (call bb_pub_tick_once() directly).

config BB_PUB_WORKER_PRIORITY
    int "bb_pub telemetry worker task priority"
    default 1
    range 1 24
    help
        FreeRTOS task priority for the bb_pub periodic worker. The default
        priority 1 (lowest application priority) is appropriate for most
        deployments. On boards running a high-priority CPU-bound task (e.g.
        a mining loop at priority 20), raise this above the competing task's
        priority so the worker is not starved between yields. Default 1
        matches the prior hardcoded value (no behavior change).

config BB_PUB_MAX_PAYLOAD_EXTENDERS
    int "Maximum number of registered payload extenders"
    default 4
    range 1 16
    help
        Capacity of the payload-extender registry. bb_pub_register_payload_extender
        returns BB_ERR_NO_SPACE when this limit is reached. A high-watermark
        warning is logged at cap-1. Default 4 matches the prior hardcoded
        fallback (no behavior change).

config BB_PUB_SUBTOPIC_MAX
    int "Maximum length of a source subtopic string (bytes)"
    default 64
    range 16 128
    help
        Size of the per-source subtopic character buffer inside bb_pub. The
        published topic is <prefix>/<hostname>/<subtopic>; this limit applies
        to the subtopic segment only. Default 64 matches the prior hardcoded
        value (no behavior change). Cross-reference BB_PUB_BUFFER_TOPIC_MAX
        when the buffer feature is enabled — the total topic string must fit
        within that budget.

config BB_PUB_AUTOREGISTER
    bool "Auto-register bb_pub init via bb_registry (PRE_HTTP tier)"
    default y
    help
        When enabled, bb_pub self-registers at the PRE_HTTP tier, which starts
        the periodic worker task. Disable to call bb_pub_start manually.

config BB_PUB_WORKER_STACK
    int "bb_pub telemetry worker task stack (bytes)"
    default 8192 if (BB_MQTT_TLS_ENABLE || BB_HTTP_TLS_ENABLE)
    default 6144
    range 2048 16384
    help
        FreeRTOS task stack for the bb_pub periodic worker. The worker calls
        each sink's publish() synchronously, so the stack must cover the
        heaviest sink in use:

          - HTTP/TLS or MQTT/TLS sink: needs >= 8192 bytes to cover the mbedTLS
            handshake + cert-bundle parse. The default auto-sizes to 8192 when
            BB_MQTT_TLS_ENABLE or BB_HTTP_TLS_ENABLE is on.
          - Plaintext MQTT or plaintext HTTP: 6144. The worker ALSO serializes
            every source's JSON each tick (cJSON + newlib dtoa for float fields,
            a deep, ~2 KB stack chain that itself heap-allocates), independent of
            the sink. 4096 covered the plaintext sink publish but NOT that
            serialize path — a float field (e.g. soc_c) overflowed the stack into
            the heap and crashed a later alloc (B1-349). 6144 covers both.

        Gate-keyed defaults (B1-274 / B1-349): default 8192 with any TLS gate;
        6144 without. Override in sdkconfig if your specific sink mix differs.

config BB_PUB_BUFFER_ENABLE
    bool "Enable store-and-forward ring buffer (capture on sink error, replay on recovery)"
    default n
    help
        When enabled, bb_pub captures serialized topic+payload entries into a
        bb_ring when the first sink returns non-BB_OK. On the next tick where
        the sink succeeds, buffered entries are replayed oldest-first. Requires
        bb_ring. The entire feature compiles out when this is disabled.

config BB_PUB_BUFFER_MAX_ENTRIES
    int "Store-and-forward ring capacity (entries)"
    default 16
    range 1 256
    depends on BB_PUB_BUFFER_ENABLE
    help
        Maximum number of buffered topic+payload entries. When the ring is
        full, the oldest entry is evicted and the dropped counter increments.

config BB_PUB_BUFFER_MAX_PAYLOAD_BYTES
    int "Store-and-forward maximum entry size (bytes)"
    default 256
    range 64 4096
    depends on BB_PUB_BUFFER_ENABLE
    help
        Maximum size (bytes) for a single ring entry. Each entry packs:
          topic (up to BB_PUB_BUFFER_TOPIC_MAX bytes) + 1-byte NUL separator
          + payload. Entries larger than this limit are rejected (truncated
          counter++). The actual ring max_entry_bytes =
          BB_PUB_BUFFER_MAX_PAYLOAD_BYTES + BB_PUB_BUFFER_TOPIC_MAX + 1.

config BB_PUB_BUFFER_TOPIC_MAX
    int "Store-and-forward topic buffer length (bytes)"
    default 192
    range 64 512
    depends on BB_PUB_BUFFER_ENABLE
    help
        Maximum length of the topic string captured into each ring entry.
        Topics longer than this are silently dropped from the buffer (the
        live publish still proceeds). Must be larger than the longest
        possible topic: BB_PUB_TOPIC_PREFIX length + hostname length +
        subtopic length + 2 separators + null terminator. Default 192
        matches the prior hardcoded value (no behavior change).

config BB_PUB_WORKER_CORE
    int "bb_pub worker task core affinity"
    default -1
    range -1 1
    help
        -1 = no affinity (default, runs on either core); 0 or 1 = pin the
        bb_pub worker task to that core. Pin to the network core (0) to
        serialize with the esp-mqtt task and avoid a dual-core
        publish/reconnect race (TA-432).

config BB_PUB_BUFFER_ALWAYS
    bool "Always-on ring mode: route all sink[0] telemetry through the ring"
    default n
    depends on BB_PUB_BUFFER_ENABLE
    help
        When y, every sink[0] publish is enqueued into the ring and drained
        each tick (enqueue → drain), providing a uniform ordered queue even
        during healthy operation. Sinks[1..] keep the existing direct fan-out.

        The ring is allocated eagerly at init (not lazily on first failure),
        so this mode carries a standing RAM cost of approximately
        MAX_ENTRIES × (TOPIC_MAX + 1 + MAX_PAYLOAD_BYTES) bytes. Recommended
        only on PSRAM boards where the ring can be allocated in SPIRAM.

        captured_ms is injected ONLY when an entry was genuinely delayed across
        ticks: inject iff (now_epoch_ms − capture_epoch_ms) > 1.5 × interval_ms.
        Entries drained the same tick they were enqueued are considered "fresh"
        and carry no captured_ms field, keeping healthy points clean.

        When n (default), the ring stays lazy and is used only on sink failure
        (store-and-forward), with zero standing cost until an outage occurs.

config BB_PUB_TELEM_SNAP_MAX
    int "Maximum snapshot buffer size for telemetry sources (bytes)"
    default 512
    range 16 4096
    help
        Size of the single static scratch buffer used by the bb_pub worker to
        gather telemetry snapshots before storing them in bb_cache. A single
        buffer is safe because only the bb_pub worker calls gather() (single-
        threaded) and the gather result is copied into bb_cache under s_tick_lock
        before releasing it for the next source.
        Raised from 256 to 512: bb_pub_info's snapshot struct (bb_info_snap_t)
        is ~360 bytes, requiring at least 512 bytes of scratch buffer.

config BB_PUB_TELEM_SERIALIZE_MAX
    int "Maximum serialized-JSON copy-out buffer for telemetry sources (bytes)"
    default 512
    range 64 8192
    help
        Size of the bb_pub worker's stack buffer used to copy the memoized
        serialized JSON out of bb_cache (via bb_cache_get_serialized) in Phase 2b
        before fanning it to SSE and all sinks. Copy-out under the cache entry
        lock makes the fan-out UAF-safe: no caller holds the cache-owned pointer.
        A telem topic whose serialized payload exceeds this cap is skipped for
        that tick (logged). Raise if any telemetry topic's JSON exceeds 512 bytes
        (wifi/meta are well under; large payloads like "info" use the legacy
        bb_pub_register_source path, not the telem/cache path).

config BB_PUB_LEGACY_TRANSPORT_INJECT
    bool "Enable per-sink transport/tls field injection (legacy B1-388 behaviour)"
    default n
    help
        When y, bb_pub_tick_once re-serializes each source's JSON once per sink
        to stamp the sink's transport (e.g. "mqtt") and tls (bool) fields.  This
        was the pre-B1-388 behaviour and causes N serializations per source per
        tick (one per sink).
        When n (default), each source is serialized ONCE and the same payload is
        delivered to all sinks; transport/tls fields are omitted from payloads
        but remain on the bb_pub_sink_t struct for use by /meta and /api/info.

endmenu
```

## components/bb_pub_fan/Kconfig
```kconfig
menu "breadboard: bb_pub_fan"

config BB_PUB_FAN_AUTO_ATTACH
    bool "Auto-register fan telemetry source with bb_pub"
    default y
    depends on BB_PUB_AUTOREGISTER
    help
        When enabled, bb_pub_fan self-registers at the PRE_HTTP tier (after
        bb_pub) so fan readings are published on every bb_pub tick under
        the "fan" subtopic. Disable to call bb_pub_fan_register() manually.

endmenu
```

## components/bb_pub_mem/Kconfig
```kconfig
menu "breadboard: bb_pub_mem"

config BB_PUB_MEM_AUTO_ATTACH
    bool "Auto-register memory telemetry source with bb_pub"
    default y
    depends on BB_PUB_AUTOREGISTER
    help
        When enabled, bb_pub_mem self-registers at the PRE_HTTP tier (after
        bb_pub) so live memory metrics are published on every bb_pub tick under
        the "mem" subtopic. Disable to call bb_pub_mem_register() manually.

endmenu
```

## components/bb_pub_ota_quiesce/Kconfig
```kconfig
menu "breadboard: bb_pub_ota_quiesce"

config BB_PUB_QUIESCE_ON_OTA
    bool "Pause telemetry publishing during update-check/OTA TLS handshake"
    default y
    depends on BB_PUB_AUTOREGISTER
    help
        When enabled, bb_pub_ota_quiesce self-registers at the PRE_HTTP tier
        and installs bb_pub_pause / bb_pub_resume as the pause/resume hooks
        for both bb_update_check and bb_ota (push/pull/boot). This frees
        the heap occupied by in-flight telemetry sinks during the mbedTLS
        handshake, which is critical on heap-tight targets like the ESP32-S2.
        Disable to install the hooks manually via bb_pub_ota_quiesce_init().

endmenu
```

## components/bb_pub_power/Kconfig
```kconfig
menu "breadboard: bb_pub_power"

config BB_PUB_POWER_AUTO_ATTACH
    bool "Auto-register power telemetry source with bb_pub"
    default y
    depends on BB_PUB_AUTOREGISTER
    help
        When enabled, bb_pub_power self-registers at the PRE_HTTP tier (after
        bb_pub) so power readings are published on every bb_pub tick under
        the "power" subtopic. Disable to call bb_pub_power_register() manually.

endmenu
```

## components/bb_pub_thermal/Kconfig
```kconfig
menu "breadboard: bb_pub_thermal"

config BB_PUB_THERMAL_AUTO_ATTACH
    bool "Auto-register thermal telemetry source with bb_pub"
    default y
    depends on BB_PUB_AUTOREGISTER
    help
        When enabled, bb_pub_thermal self-registers at the PRE_HTTP tier (after
        bb_pub) so aggregate temperature readings are published on every bb_pub
        tick under the "thermal" subtopic. Disable to call
        bb_pub_thermal_register() manually.

endmenu
```

## components/bb_pub_wifi/Kconfig
```kconfig
menu "breadboard: bb_pub_wifi"

config BB_PUB_WIFI_AUTO_ATTACH
    bool "Auto-register wifi RSSI telemetry source with bb_pub"
    default y
    depends on BB_PUB_AUTOREGISTER
    help
        When enabled, bb_pub_wifi self-registers at the PRE_HTTP tier (after
        bb_pub) so wifi RSSI is published on every bb_pub tick under the
        "wifi" subtopic. The source is skipped (returns false) when the STA
        is not connected. Disable to call bb_pub_wifi_register() manually.

endmenu
```

## components/bb_queue/Kconfig
```kconfig
menu "breadboard: bb_queue"

config BB_QUEUE_REGISTRY_MAX
    int "Ring registry capacity (max concurrently-tracked bb_queue_t handles)"
    default 16
    range 1 32
    help
        Capacity of the diagnostic ring registry consumed by
        GET /api/diag/rings. Every bb_queue_create() self-registers here
        (best-effort); a full registry logs a warning and does not fail
        ring creation. Must be <= BB_REGISTRY_SNAPSHOT_MAX (64).

        Raising this increases the /api/diag/rings handler stack by
        ~44 bytes per entry.

endmenu
```

## components/bb_response/Kconfig
```kconfig
menu "breadboard: bb_response"

config BB_RESPONSE_MAX
    int "Maximum number of sections per registry"
    default 8
    range 1 32
    help
        Fixed-array capacity for sections in a bb_response_registry_t.
        Default 8 covers info (display+led+ntp+diag=4), sensors (3),
        telemetry (4), and health (2) with room to spare.

endmenu
```

## components/bb_ring/Kconfig
```kconfig
menu "breadboard: bb_ring"

config BB_RING_REGISTRY_MAX
    int "Ring registry capacity (max concurrently-tracked bb_ring_t handles)"
    default 12
    range 1 32
    help
        Capacity of the diagnostic ring registry consumed by
        GET /api/diag/rings. Every bb_ring_create() self-registers here
        (best-effort); a full registry logs a warning and does not fail
        ring creation. Must be <= BB_REGISTRY_SNAPSHOT_MAX (64).

        Raising this increases the /api/diag/rings handler stack by
        ~44 bytes per entry.

endmenu
```

## components/bb_section/Kconfig
```kconfig
menu "breadboard: bb_section"

config BB_SECTION_MAX
    int "Maximum number of sections per registry"
    default 8
    range 1 32
    help
        Fixed-array capacity for sections in a bb_section_registry_t.
        Default 8 covers info (display+led+ntp+diag=4), sensors (3),
        telemetry (4), and health (2) with room to spare.

endmenu
```
