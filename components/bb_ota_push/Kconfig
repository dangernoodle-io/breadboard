## components/bb_ota_push/Kconfig
```kconfig
menu "breadboard: bb_ota_push"

config BB_OTA_PUSH_AUTOREGISTER
    bool "Auto-register OTA push HTTP route via bb_init"
    default y
    help
        When enabled, bb_ota_push self-registers its HTTP route handler
        through bb_init. Disable this if you want to keep bb_ota_push's
        public C API but drive route registration manually or skip the route
        entirely (e.g. headless OTA-driver use).

config BB_OTA_PUSH_MAX_SIZE
    int "Maximum firmware binary size accepted by /api/ota/push (bytes)"
    range 65536 16777216
    default 4194304
    help
        Upper bound on Content-Length accepted by the OTA push handler.
        Requests with Content-Length exceeding this value are rejected
        with HTTP 413 before entering the receive loop. Requests with
        Content-Length <= 0 are rejected with HTTP 400. The default
        (4 MB) is comfortably larger than a typical OTA partition;
        consumers on boards with a smaller OTA partition can lower this
        to fail fast rather than spinning through receive timeout retries.

config BB_OTA_PUSH_RECV_BUF_SIZE
    int "OTA push receive/write chunk size (bytes)"
    range 512 16384
    default 1024
    help
        Size of the buffer used to receive the uploaded firmware and feed
        esp_ota_write(). Larger chunks mean fewer recv/write iterations and
        bigger flash writes, which avoids a flow-control stall on RAM-tight
        single-core targets (e.g. ESP32-S2) where the small default plus a
        small TCP window can wedge the transfer under cache-disable
        backpressure. Default 1024 preserves prior behavior; the buffer is
        malloc'd for the OTA duration, so size it to fit available heap.

config BB_OTA_PUSH_WDT_EXTENDED_S
    int "Task WDT timeout (s) during OTA push receive+write phase"
    range 30 1800
    default 300
    help
        Same rationale as CONFIG_BB_OTA_PULL_WDT_EXTENDED_S: esp_ota_write
        triggers cache_disable, and the consumer pause callback may hold
        the mining task in a semaphore wait for the full upload window.
        WDT-subscribed tasks (idle, mining) cannot reset the WDT during
        these windows; bb_ota_push temporarily reconfigures the WDT timeout
        for the duration of the push and restores
        CONFIG_ESP_TASK_WDT_TIMEOUT_S on exit.

config BB_OTA_PUSH_RECV_TIMEOUT_RETRIES
    int "Consecutive recv-timeout retries before aborting OTA push"
    range 1 1000
    default 30
    help
        Consecutive recv-timeout retries tolerated before aborting an OTA push
        receive.

config BB_OTA_PUSH_MIN_BPS
    int "Minimum accepted OTA push throughput (bytes/sec)"
    default 4096
    help
        Minimum average upload throughput (bytes/sec) for /api/update/push.
        The receive deadline is derived as content_len / MIN_BPS, clamped to
        [30 s, BB_OTA_PUSH_MAX_DURATION_S]. At 4096 B/s a typical 1.2–1.5 MB
        firmware image receives the full MAX_DURATION_S (240 s default) window,
        making the transfer tolerant of weak-link boards (~6 KB/s effective
        throughput for a 1.5 MB image once the ceiling governs). Genuinely
        stalled uploads are still caught by the socket recv-timeout retries
        (BB_OTA_PUSH_RECV_TIMEOUT_RETRIES); this floor only guards against an
        indefinite slow trickle. Lower further only if even weaker links must
        be supported, and consider raising BB_OTA_PUSH_MAX_DURATION_S — but
        keep it below BB_OTA_PUSH_WDT_EXTENDED_S to avoid tripping the WDT.

config BB_OTA_PUSH_MAX_DURATION_S
    int "Maximum OTA push receive duration (s)"
    default 240
    help
        Hard ceiling on the whole receive phase. MUST be less than
        BB_OTA_PUSH_WDT_EXTENDED_S so the clean abort+resume beats the task WDT.

endmenu
```

## components/bb_ota_validator/Kconfig
```kconfig
menu "breadboard: bb_ota_validator"

config BB_OTA_VALIDATOR_PARTITIONS_ROW_CAP
    int "GET /api/update/partitions: max app-partition rows per response"
    default 18
    range 1 32
    help
        Caller-allocated array capacity for the GET /api/update/partitions
        response's "partitions" row list (factory + ota_0..ota_N app
        partitions).

endmenu
```

## components/bb_power_health/Kconfig
```kconfig
menu "breadboard: bb_power_health"

config BB_VCORE_WD_WARMUP_MS
    int "Vcore watchdog warmup window (ms)"
    default 60000
    range 0 300000
    help
        No recovery action is taken for this many ms after boot.
        Allows the ASIC and regulator to stabilise before monitoring begins.

config BB_VCORE_WD_OK_MV
    int "Vcore healthy threshold (mV)"
    default 800
    range 100 3300
    help
        Readings at or above this level are considered healthy.
        A transient below this clears the healthy streak but does not
        trigger a collapse until it falls below BB_VCORE_WD_COLLAPSE_MV.

config BB_VCORE_WD_COLLAPSE_MV
    int "Vcore collapse threshold (mV)"
    default 500
    range 0 1000
    help
        Readings below this level (with the rail enabled) count toward
        the collapse poll counter (BB_VCORE_WD_COLLAPSE_POLLS).

config BB_VCORE_WD_COLLAPSE_POLLS
    int "Consecutive collapsed readings before recovery"
    default 3
    range 1 20
    help
        Number of consecutive readings below BB_VCORE_WD_COLLAPSE_MV
        required before a BB_VCORE_WD_RECOVER action is returned.

config BB_VCORE_WD_HEALTHY_RESET_MS
    int "Continuous healthy duration to reset burst counter (ms)"
    default 300000
    range 10000 3600000
    help
        After this many ms of uninterrupted healthy readings, the
        reboot-burst counter is reset.

config BB_VCORE_WD_BURST_MAX
    int "Maximum recovery attempts per burst window"
    default 3
    range 1 20
    help
        After this many BB_VCORE_WD_RECOVER actions within
        BB_VCORE_WD_WINDOW_MS, the watchdog switches to
        BB_VCORE_WD_BACKOFF until the burst window expires or the
        rail recovers.

config BB_VCORE_WD_WINDOW_MS
    int "Burst counting window (ms)"
    default 600000
    range 60000 3600000
    help
        Time window within which BB_VCORE_WD_BURST_MAX recovery
        attempts are counted before backing off.

endmenu
```

## components/bb_power_tps546/Kconfig
```kconfig
menu "breadboard: bb_power_tps546"

config BB_TPS546_OFF_SETTLE_MS
    int "OPERATION_OFF settle delay (ms)"
    range 1 100
    default 5
    help
        After writing OPERATION_OFF at the start of the TPS546 init/recover
        cycle, the driver waits this many milliseconds for the output rail
        to drain and the regulator latch state to stabilise before writing
        the new config program. 5 ms is sufficient for typical inductor/cap
        combinations; increase on boards with large output capacitance.

endmenu
```
