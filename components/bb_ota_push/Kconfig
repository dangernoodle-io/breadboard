## components/bb_sensors/Kconfig
```kconfig
menu "breadboard: bb_sensors"

config BB_SENSORS_PATCH_BODY_MAX
    int "Maximum PATCH /api/sensors body size (bytes)"
    default 256
    range 64 4096
    help
        Hard cap on the PATCH /api/sensors request body. Requests larger
        than this are rejected with 400 before any parsing occurs.
        Default 256 bytes is sufficient for full autofan config payloads.
        Raise for consumers that add large section PATCH payloads.

endmenu
```

## components/bb_serialize_console/Kconfig
```kconfig
menu "breadboard: bb_serialize_console"

config BB_SERIALIZE_CONSOLE_LINE_MAX_BYTES
    int "Stack line-buffer size (bytes) for console heap-report rendering"
    default 160
    range 64 512
    help
        Size of the on-stack line buffer bb_serialize_console_heap_report()
        uses to render a heap snapshot as a single human-readable
        "key=val key=val" line before logging it via bb_log_i(). A
        tuning/instrumentation knob, not a composition toggle -- overflow
        truncates the line (snprintf semantics, safe and NUL-terminated)
        rather than failing.

endmenu
```
