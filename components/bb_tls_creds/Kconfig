## components/bb_wifi/Kconfig
```kconfig
menu "breadboard: bb_wifi (routes)"

config BB_WIFI_RSSI_GOOD
    int "RSSI threshold for GOOD link bucket (dBm)"
    default -67
    range -100 0
    help
        RSSI >= this value is classified as GOOD. Moved from bb_net_health
        (net_health teardown PR-B); a saved sdkconfig override of the old
        BB_NET_HEALTH_RSSI_GOOD name silently reverts to this default.

config BB_WIFI_RSSI_MARGINAL_LO
    int "Lower RSSI threshold for MARGINAL link bucket (dBm)"
    default -75
    range -100 0
    help
        RSSI in the range [BB_WIFI_RSSI_MARGINAL_LO ..
        BB_WIFI_RSSI_GOOD-1] is classified as MARGINAL. RSSI below this
        value is classified as POOR. Moved from bb_net_health (net_health
        teardown PR-B); a saved sdkconfig override of the old
        BB_NET_HEALTH_RSSI_MARGINAL_LO name silently reverts to this
        default.

config BB_WIFI_HYST_DOWN
    int "Hysteresis sample count before downgrading link state"
    default 3
    range 1 10
    help
        Number of consecutive worse-bucket RSSI samples required before the
        published link state is downgraded. Prevents single-sample flaps.
        Moved from bb_net_health (net_health teardown PR-B); a saved
        sdkconfig override of the old BB_NET_HEALTH_HYST_DOWN name silently
        reverts to this default.

config BB_WIFI_HYST_UP
    int "Hysteresis sample count before upgrading link state"
    default 3
    range 1 10
    help
        Number of consecutive better-bucket RSSI samples required before the
        published link state is upgraded. Moved from bb_net_health
        (net_health teardown PR-B); a saved sdkconfig override of the old
        BB_NET_HEALTH_HYST_UP name silently reverts to this default.

config BB_WIFI_RECONFIGURE
    bool "Enable runtime wifi reconfigure + pending-creds try on boot"
    default y
    help
        Enables bb_wifi_reconfigure() which stages new credentials and reboots
        to try them. On boot, if pending creds get an IP they are committed as
        the new live credentials. On timeout the pending creds are cleared and
        the device reboots onto the prior live creds without incrementing
        boot_count. When disabled bb_wifi_reconfigure() returns BB_ERR_UNSUPPORTED
        and the autoinit path is byte-for-byte identical to the baseline.

config BB_WIFI_PENDING_TRY_TIMEOUT_S
    int "Bounded connect timeout for a runtime wifi reconfigure try (seconds)"
    default 30
    range 10 120
    depends on BB_WIFI_RECONFIGURE
    help
        Maximum time (seconds) to wait for an IP when attempting to connect
        with pending (staged) credentials. On timeout the pending creds are
        discarded, the device reboots onto the prior live credentials, and
        boot_count is NOT incremented.

config BB_WIFI_RECONN_CONNECTING_TIMEOUT_MS
    int "WiFi ST_CONNECTING watchdog timeout (ms)"
    range 5000 120000
    default 30000
    help
        If neither GOT_IP nor DISCONNECT arrives within this window after
        issuing esp_wifi_connect(), the reconnect manager treats the
        association as stalled, re-issues esp_wifi_disconnect +
        esp_wifi_connect, and stays in ST_CONNECTING. 30 s >> normal
        associate+DHCP (2–8 s), so false positives are rare.

config BB_WIFI_RECONN_PERSISTENT_FAIL_WINDOW_S
    int "WiFi persistent-fail safeguard reboot window (seconds)"
    range 60 3600
    default 300
    help
        If the device keeps failing to connect for longer than this window
        (measured from the first disconnect after boot), the reconnect
        manager triggers a safeguard reboot. Default 300 s (5 minutes)
        matches the legacy hard-coded value. On validated firmware the
        reboot does not increment boot_count.

config BB_WIFI_RECONN_HANDSHAKE_FAST_RETRY_LIMIT
    int "WiFi handshake-failure fast-retry limit (attempts)"
    range 0 50
    default 3
    help
        Number of consecutive handshake-timeout disconnects that retry
        immediately (no backoff) before the reconnect manager escalates to
        the tier-2 backoff delay.

config BB_WIFI_RECONN_HANDSHAKE_TIER2_LIMIT
    int "WiFi handshake-failure tier-2 backoff limit (attempts)"
    range 0 100
    default 6
    help
        Number of consecutive handshake-timeout disconnects, beyond the
        fast-retry limit, that back off at the tier-2 delay before the
        reconnect manager escalates to the tier-3 delay.

config BB_WIFI_RECONN_HANDSHAKE_BACKOFF_TIER2_MS
    int "WiFi handshake-failure tier-2 backoff delay (ms)"
    range 1000 120000
    default 10000
    help
        Backoff delay applied after a handshake-timeout disconnect once the
        fast-retry limit is exceeded but the tier-2 limit is not.

config BB_WIFI_RECONN_HANDSHAKE_BACKOFF_TIER3_MS
    int "WiFi handshake-failure tier-3 backoff delay (ms)"
    range 1000 300000
    default 30000
    help
        Backoff delay applied after a handshake-timeout disconnect once
        both the fast-retry and tier-2 limits are exceeded.

config BB_WIFI_RECONN_GENERIC_FAST_RETRY_LIMIT
    int "WiFi generic-failure fast-retry limit (attempts)"
    range 0 50
    default 10
    help
        Number of consecutive non-handshake disconnects that retry
        immediately (no backoff) before the reconnect manager applies the
        generic backoff pause.

config BB_WIFI_RECONN_GENERIC_BACKOFF_PAUSE_MS
    int "WiFi generic-failure backoff pause (ms)"
    range 1000 120000
    default 5000
    help
        Backoff delay applied after a non-handshake disconnect once the
        generic fast-retry limit is exceeded.

config BB_WIFI_RECONN_SLOW_TIER1_LIMIT
    int "WiFi slow-failure tier-1 limit (attempts)"
    range 0 50
    default 3
    help
        Number of consecutive AUTH_FAIL/NO_AP_FOUND disconnects (bad
        credentials or an absent AP) that back off at the tier-1 delay
        before the reconnect manager escalates to the tier-2 delay. Unlike
        the generic ladder, the SLOW tier never hot-retries -- even the
        first occurrence backs off.

config BB_WIFI_RECONN_SLOW_BACKOFF_TIER1_MS
    int "WiFi slow-failure tier-1 backoff delay (ms)"
    range 1000 120000
    default 30000
    help
        Backoff delay applied after an AUTH_FAIL/NO_AP_FOUND disconnect up
        to the tier-1 limit.

config BB_WIFI_RECONN_SLOW_BACKOFF_TIER2_MS
    int "WiFi slow-failure tier-2 backoff delay (ms)"
    range 1000 300000
    default 120000
    help
        Backoff delay applied after an AUTH_FAIL/NO_AP_FOUND disconnect
        once the tier-1 limit is exceeded.

choice BB_WIFI_POWER_SAVE
    prompt "WiFi power-save mode"
    default BB_WIFI_PS_MIN_MODEM
    help
        WiFi modem power-save. MIN_MODEM (default) sleeps the radio between
        beacons to save power but can cause beacon-miss/idle disconnects on
        quiet links; NONE keeps the radio always on for best link stability
        (recommended for mains-powered/always-on devices like miners).
    config BB_WIFI_PS_NONE
        bool "None (radio always on)"
    config BB_WIFI_PS_MIN_MODEM
        bool "Minimum modem sleep"
    config BB_WIFI_PS_MAX_MODEM
        bool "Maximum modem sleep"
endchoice

config BB_WIFI_INACTIVE_TIME_ENABLE
    bool "Enable beacon-loss detection via esp_wifi_set_inactive_time"
    default n
    help
        When enabled, calls esp_wifi_set_inactive_time(WIFI_IF_STA,
        CONFIG_BB_WIFI_INACTIVE_TIME_S) after esp_wifi_start() and after
        each bb_wifi_restart_sta() so the driver emits
        WIFI_EVENT_STA_DISCONNECTED after beacon starvation. The resulting
        disconnect flows into the normal reconnect FSM.

config BB_WIFI_INACTIVE_TIME_S
    int "Inactive time for beacon-loss detection (seconds)"
    range 3 600
    default 45
    depends on BB_WIFI_INACTIVE_TIME_ENABLE
    help
        Configures the WiFi driver's inactive time via
        esp_wifi_set_inactive_time(). If the station receives no beacon
        from the AP within this window, the driver emits
        WIFI_EVENT_STA_DISCONNECTED. Minimum 3 (ESP-IDF hard floor).

config BB_WIFI_RECOVERY_COOLDOWN_S
    int "App-driven recovery request cooldown (seconds)"
    range 10 3600
    default 60
    help
        Minimum interval between consecutive bb_wifi_request_recovery()
        actions. Requests within the cooldown window are logged and
        discarded. The hook API is always compiled.

config BB_WIFI_GW_PROBE_ENABLE
    bool "Enable gateway-reachability probe worker (observe-only)"
    default n
    help
        When enabled, a dedicated worker task pings the STA default gateway
        every BB_WIFI_GW_PROBE_PERIOD_S seconds and records the result via
        bb_wifi_get_gateway_status(). OBSERVE-ONLY (B1-518): the probe never
        triggers recovery on its own — a bare gateway ping is not sufficient
        signal that egress is dead (see PR #578). Opt-in (default n): a
        periodic ping worker + dedicated task is not imposed on every
        breadboard consumer, matching the opt-in-for-expensive-features
        convention and the old B1-371 tick-driven probe's opt-in shape.
        Enable per-board in sdkconfig where fleet-wide egress observability
        is wanted.

config BB_WIFI_GW_PROBE_PERIOD_S
    int "Gateway-probe interval (seconds)"
    range 5 300
    default 20
    depends on BB_WIFI_GW_PROBE_ENABLE
    help
        How often the dedicated gateway-probe worker pings the STA default
        gateway.

config BB_WIFI_GW_PROBE_TIMEOUT_MS
    int "Gateway-probe ICMP timeout (ms)"
    range 100 5000
    default 1000
    depends on BB_WIFI_GW_PROBE_ENABLE
    help
        Timeout passed to bb_wifi_gateway_reachable() for each probe.

config BB_WIFI_GW_PROBE_FAILS
    int "Consecutive gateway-probe failures before fail-streak bump (observe-only)"
    range 1 20
    default 3
    depends on BB_WIFI_GW_PROBE_ENABLE
    help
        Fed into wifi_reconn_policy_on_egress_probe() as fail_threshold,
        using a SEPARATE observe-owned state — does not affect the live
        reconnect FSM. The resulting action is always discarded; this only
        sizes gw_fail_streak in bb_wifi_get_gateway_status().

config BB_WIFI_GW_PROBE_STACK
    int "Gateway-probe worker task stack size (bytes)"
    default 3072
    depends on BB_WIFI_GW_PROBE_ENABLE
    help
        Matches esp_ping's own task_stack_size (bb_wifi_ping uses 3072 for
        its lazy ping session).

config BB_WIFI_GW_PROBE_PRIORITY
    int "Gateway-probe worker task priority"
    default 3
    depends on BB_WIFI_GW_PROBE_ENABLE
    help
        FreeRTOS priority for the dedicated gateway-probe worker task.

endmenu
```

## components/bb_wifi_http/Kconfig
```kconfig
menu "breadboard: bb_wifi_http (STA /api/wifi + /api/wifi/scan route bundle)"

endmenu
```

## components/bb_ws_server/Kconfig.projbuild
```kconfig
menu "BB WebSocket"

    config BB_WS_SERVER_MAX_CLIENTS
        int "Maximum concurrent WebSocket clients"
        default 2
        range 1 7
        help
            Maximum number of concurrent WebSocket client connections.
            WS shares the httpd socket pool with SSE and HTTP connections.
            The httpd default pool is 7 sockets; keep this value conservative
            (default 2) to leave headroom for HTTP and SSE connections.

    config BB_WS_SERVER_FRAME_MAX_PAYLOAD
        int "Maximum WebSocket frame payload size (bytes)"
        default 4096
        range 64 65536
        help
            Maximum payload size for a single WebSocket frame, in bytes.
            Used by the receive buffer in platform implementations.

    config BB_WS_SERVER_RECV_TIMEOUT_S
        int "WebSocket receive timeout (seconds)"
        default 10
        range 1 120
        help
            Per-frame receive timeout in seconds.

    config BB_WS_SERVER_SEND_TIMEOUT_S
        int "WebSocket send timeout (seconds)"
        default 10
        range 1 120
        help
            Per-frame send timeout in seconds.

    config BB_WS_SERVER_AUTOREGISTER
        bool "Auto-register bb_ws_server via bb_init"
        default n
        help
            When enabled, bb_ws_server_init is called automatically during
            bb_init_init().  Disable (default) to register endpoints
            manually in your own init function.

endmenu
```

## examples/bb_data_http_derisk/sdkconfig.defaults
```kconfig
CONFIG_IDF_TARGET="esp32"
CONFIG_ESPTOOLPY_FLASHSIZE_4MB=y
CONFIG_PARTITION_TABLE_CUSTOM=y
CONFIG_PARTITION_TABLE_CUSTOM_FILENAME="partitions.csv"
CONFIG_FREERTOS_HZ=1000
CONFIG_FREERTOS_CHECK_STACKOVERFLOW=2
CONFIG_LOG_DEFAULT_LEVEL=3

# bb_http_req_async_abort() (peer-liveness pre-pass, RST-based teardown of a
# dead SSE client) requires CONFIG_LWIP_SO_LINGER=y -- see bb_http_server.h.
CONFIG_LWIP_SO_LINGER=y

# Same de-risk-not-floor tradeoff as examples/floor -- smallest image, not
# fastest.
CONFIG_COMPILER_OPTIMIZATION_SIZE=y
CONFIG_NEWLIB_NANO_FORMAT=y
```

## examples/esp32-wroom-32/sdkconfig.defaults
```kconfig
CONFIG_IDF_TARGET="esp32"
CONFIG_ESPTOOLPY_FLASHSIZE_4MB=y
CONFIG_PARTITION_TABLE_CUSTOM=y
CONFIG_PARTITION_TABLE_CUSTOM_FILENAME="partitions.csv"
CONFIG_FREERTOS_HZ=1000
CONFIG_LOG_DEFAULT_LEVEL=3
```

## examples/minimal/sdkconfig.defaults
```kconfig
# Target configuration
CONFIG_IDF_TARGET="esp32p4"

# Flash configuration
CONFIG_ESPTOOLPY_FLASHSIZE_16MB=y
CONFIG_PARTITION_TABLE_CUSTOM=y
CONFIG_PARTITION_TABLE_CUSTOM_FILENAME="partitions.csv"

# PSRAM configuration
CONFIG_SPIRAM=y
CONFIG_SPIRAM_MODE_QUAD=y
CONFIG_SPIRAM_XIP_FROM_PSRAM=n

# Console configuration
CONFIG_ESP_CONSOLE_USB_SERIAL_JTAG=y

# WiFi remote configuration
CONFIG_ESP_WIFI_REMOTE_ENABLED=y
CONFIG_SLAVE_IDF_TARGET_ESP32C6=y

# FreeRTOS configuration
CONFIG_FREERTOS_HZ=1000

# Logging configuration
CONFIG_LOG_DEFAULT_LEVEL=3
```

## examples/smoke/sdkconfig.defaults.esp32-lifecycle-async
```kconfig
CONFIG_IDF_TARGET="esp32"
CONFIG_ESPTOOLPY_FLASHSIZE_4MB=y
CONFIG_PARTITION_TABLE_CUSTOM=y
CONFIG_PARTITION_TABLE_CUSTOM_FILENAME="partitions.csv"
CONFIG_FREERTOS_HZ=1000
CONFIG_LOG_DEFAULT_LEVEL=3
CONFIG_BB_LOG_ROUTES=y
CONFIG_BB_LOG_STREAM_AUTOREGISTER=y
CONFIG_BB_OTA_PULL_AUTOREGISTER=y
CONFIG_BB_OTA_PUSH_AUTOREGISTER=y
CONFIG_BB_BOARD_AUTOREGISTER=y
CONFIG_BB_MANIFEST_AUTOREGISTER=y
CONFIG_BB_OTA_VALIDATOR_AUTOREGISTER=y
CONFIG_BB_WIFI_ROUTES_AUTOREGISTER=y
CONFIG_BB_SYSTEM_ROUTES_AUTOREGISTER=y
CONFIG_BB_OPENAPI_AUTOREGISTER=y
CONFIG_BB_MDNS_AUTOREGISTER=y
CONFIG_BB_EVENT_AUTOREGISTER=y
CONFIG_BB_SMOKE_EVENT=y
# Enable RST-based SSE abort teardown (B1-517): bb_http_req_async_abort's
# SO_LINGER{on,0} setsockopt is inert without this — see bb_http.h.
CONFIG_LWIP_SO_LINGER=y
# Compile-gate for bb_lifecycle's optional async observer dispatch (B1-1034,
# default n — see components/bb_lifecycle/Kconfig): proves the
# bb_task_create()-STATIC + bb_bqueue substrate actually builds/links for an
# espidf target, not just on host. No in-tree caller registers an async
# observer here — this is a compile gate only (runtime HW validation of the
# drain task defers to B1-1037).
CONFIG_BB_LIFECYCLE_ASYNC=y
```
