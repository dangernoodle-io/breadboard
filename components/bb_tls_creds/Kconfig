## components/bb_tls_creds/Kconfig
```kconfig
menu "breadboard: bb_tls_creds"

config BB_MQTT_TLS_ENABLE
    bool "Enable TLS for the MQTT sink"
    default n
    help
        Opt-in TLS for the MQTT sink (bb_mqtt_client).  Default OFF for the
        smallest firmware footprint; the OTA/update-check HTTPS path
        (esp_http_client crt-bundle) is independent of this gate.
        When OFF, a cfg.tls=true request degrades gracefully: the
        bb_tls_creds resolve and broker-verification blocks are skipped;
        the broker connection proceeds plaintext.

config BB_HTTP_TLS_ENABLE
    bool "Enable TLS for the HTTP sink"
    default n
    help
        Opt-in TLS for the HTTP telemetry sink (bb_sink_http).  Default
        OFF for the smallest firmware footprint; the OTA/update-check
        HTTPS path (esp_http_client crt-bundle) is independent of this
        gate.  When OFF, the bb_tls_creds resolve and ca/cert/key
        assignments are skipped; the HTTP session opens without TLS.

config BB_TLS_MUTUAL_ENABLE
    bool "Enable mutual TLS (client certificate + key)"
    default n
    depends on BB_MQTT_TLS_ENABLE || BB_HTTP_TLS_ENABLE
    help
        Opt-in mutual TLS: enables the client certificate and private key
        credential paths in both the MQTT and HTTP sinks.  Requires at
        least one of BB_MQTT_TLS_ENABLE or BB_HTTP_TLS_ENABLE.  When OFF
        bb_tls_creds skips cert/key resolve_one calls, saving RAM and NVS
        lookup work; only the CA is resolved.

config BB_TLS_CREDS_NVS_MAX_LEN
    int "Max bytes for a single TLS credential read from NVS"
    default 4096
    help
        Bounds the heap buffer used to read one PEM (ca/cert/key) from NVS.
        Larger client certificate chains may need more than 4096 bytes.
        Heap-tight boards without PSRAM can lower this value to reclaim RAM
        at the cost of rejecting oversized credentials.

endmenu
```

## components/bb_transport_health/Kconfig
```kconfig
menu "breadboard: bb_transport_health"

config BB_TRANSPORT_HEALTH_MAX_SLOTS
    int "Maximum registered transport slots"
    default 8
    range 1 16
    help
        Fixed-capacity slot table for per-transport connectivity health.
        bb_transport_health_register() returns BB_ERR_NO_SPACE once this
        many transports are registered.

config BB_TRANSPORT_HEALTH_INFERRED_STALE_S
    int "Inferred-transport staleness threshold (seconds)"
    default 60
    range 5 3600
    help
        An INFERRED transport slot is considered failing (at snapshot time)
        when no activity has been marked for this many seconds.

endmenu
```

## components/bb_udp_client/Kconfig
```kconfig
menu "breadboard: bb_udp_client"

config BB_UDP_PORT
    int "Default UDP destination port"
    default 9109
    help
        Destination UDP port used for both unicast and broadcast sends.
        Persisted config in NVS ("bb_udp" namespace, key "port") overrides
        this default once set.

config BB_UDP_BROADCAST
    bool "Default to local broadcast (255.255.255.255)"
    default n
    help
        When enabled, sends target the local broadcast address instead of
        the configured unicast host (dotted-quad IPv4; no DNS resolution).
        Persisted NVS config ("bb_udp" namespace, keys "host"/"broadcast")
        overrides this default once set.

endmenu
```

## components/bb_update_check/Kconfig
```kconfig
menu "breadboard: bb_update_check"

config BB_UPDATE_CHECK_AUTOREGISTER
    bool "Auto-register GET /api/update/status via bb_registry"
    depends on !BB_OTA_STRATEGY_BOOT
    default y
    help
        When enabled, bb_update_check registers GET /api/update/status
        automatically via the bb_registry regular tier after the HTTP server
        starts. The polling timer is created at the same time but does not
        fire until bb_update_check_set_releases_url has been called.

        ENFORCE (B1-config-coupling): not selectable when BB_OTA_STRATEGY_BOOT
        is chosen (depends on !BB_OTA_STRATEGY_BOOT). Boot-mode boards run the
        manifest check synchronously at full early-boot heap inside the
        boot-mode worker; the recurring runtime task (~8 KB worker + HTTPS
        timer) is dead weight and cannot complete a TLS handshake on
        heap-tight boards. If a boot-mode board genuinely needs the runtime
        status route, switch the strategy to BB_OTA_STRATEGY_PULL.

config BB_UPDATE_CHECK_INTERVAL_S
    int "Default polling interval (seconds)"
    default 21600
    range 60 604800
    help
        Default poll interval when cfg.interval_s is 0. 21600 = 6 hours,
        which stays well under GitHub's 60 req/h unauthenticated rate
        limit even with many devices behind one NAT. Each tick the ESP-IDF
        worker picks the next interval as this value plus uniform ±10 min
        jitter (±600 s, floored at 60 s) to desynchronize fleets that
        reboot together.

config BB_UPDATE_CHECK_AUTO_ATTACH
    bool "Auto-attach update.available to /api/events"
    default y
    depends on BB_EVENT_ROUTES_AUTOREGISTER
    help
        When enabled, bb_update_check's init attaches "update.available"
        to the bb_event_routes SSE stream so /api/events surfaces it
        without an explicit consumer call. Disable if a consumer wants
        the bb_event topic for internal logic only.

config BB_UPDATE_CHECK_CUSTOM_PARSER_BUF_BYTES
    int "Custom parser response buffer size (bytes)"
    default 8192
    range 1024 65536
    help
        Size of the heap buffer allocated per fetch when a custom parser
        is registered via bb_update_check_set_parser(). The default GitHub
        parser is fully streaming and does not use this buffer. Custom
        parsers receive the complete response body here; if the response
        exceeds this limit, it is truncated and a warning is logged.
        Default 8192 saves 8 KB heap vs the old hardcoded 16384.
        Raise if your custom parser needs to process larger responses.

config BB_UPDATE_CHECK_JITTER_S
    int "Per-tick jitter half-range applied to the poll interval (seconds)"
    default 600
    range 0 3600
    help
        Each timer reschedule adds a uniform random offset in the range
        [-JITTER_S, +JITTER_S] to the base interval, floored at
        BB_UPDATE_CHECK_FLOOR_S. Setting to 0 disables jitter (every
        device fires at a fixed interval). Default 600 s (±10 minutes)
        matches the prior hardcoded value (no behavior change).

config BB_UPDATE_CHECK_FLOOR_S
    int "Minimum permitted poll interval after jitter application (seconds)"
    default 60
    range 10 300
    help
        Lower bound applied after the jitter offset is computed. Prevents
        the jitter from scheduling a check sooner than this many seconds.
        Default 60 matches the prior hardcoded value (no behavior change).

config BB_UPDATE_CHECK_TASK_CORE
    int "CPU core affinity for the on-demand update-check worker task"
    default 1
    range 0 1
    help
        Core on which the short-lived update-check worker task is pinned.
        Core 0 carries lwip/wifi/httpd; the mbedTLS handshake (200-600 ms)
        would starve IDLE0 on that core. Default 1 matches the prior
        hardcoded value (no behavior change). Set to tskNO_AFFINITY (-1)
        via bb_update_check_set_task_core() at runtime for no pinning.

config BB_UPDATE_CHECK_TASK_PRIORITY
    int "FreeRTOS priority for the on-demand update-check worker task"
    default 1
    range 1 24
    help
        FreeRTOS priority for the short-lived on-demand worker task that
        runs bb_update_check_run_one(). On boards running a CPU-bound task
        at a high priority (e.g. mining at priority 20), raise this above
        that task to avoid starvation during the mbedTLS handshake. Default
        1 (lowest app priority) matches the prior hardcoded value (no
        behavior change). Override at runtime via
        bb_update_check_set_task_priority().

endmenu
```

## components/bb_websocket/Kconfig.projbuild
```kconfig
menu "BB WebSocket"

    config BB_WEBSOCKET_MAX_CLIENTS
        int "Maximum concurrent WebSocket clients"
        default 2
        range 1 7
        help
            Maximum number of concurrent WebSocket client connections.
            WS shares the httpd socket pool with SSE and HTTP connections.
            The httpd default pool is 7 sockets; keep this value conservative
            (default 2) to leave headroom for HTTP and SSE connections.

    config BB_WEBSOCKET_FRAME_MAX_PAYLOAD
        int "Maximum WebSocket frame payload size (bytes)"
        default 4096
        range 64 65536
        help
            Maximum payload size for a single WebSocket frame, in bytes.
            Used by the receive buffer in platform implementations.

    config BB_WEBSOCKET_RECV_TIMEOUT_S
        int "WebSocket receive timeout (seconds)"
        default 10
        range 1 120
        help
            Per-frame receive timeout in seconds.

    config BB_WEBSOCKET_SEND_TIMEOUT_S
        int "WebSocket send timeout (seconds)"
        default 10
        range 1 120
        help
            Per-frame send timeout in seconds.

    config BB_WEBSOCKET_AUTOREGISTER
        bool "Auto-register bb_websocket via bb_init"
        default n
        help
            When enabled, bb_websocket_init is called automatically during
            bb_init_init().  Disable (default) to register endpoints
            manually in your own init function.

    config BB_WEBSOCKET_DIAG_AUTOREGISTER
        bool "Auto-register GET /api/diag/websocket"
        default y
        help
            When enabled, registers GET /api/diag/websocket at boot,
            reporting the current open WebSocket connection count
            (bb_websocket_open_count()). Infrastructure route; default on.

endmenu
```
