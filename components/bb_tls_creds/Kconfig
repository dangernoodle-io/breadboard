## examples/smoke/sdkconfig.defaults.tdongle
```kconfig
CONFIG_IDF_TARGET="esp32s3"
CONFIG_ESPTOOLPY_FLASHSIZE_16MB=y
CONFIG_PARTITION_TABLE_CUSTOM=y
CONFIG_PARTITION_TABLE_CUSTOM_FILENAME="partitions.csv"
CONFIG_FREERTOS_HZ=1000
# Stack overflow detection: method 2 (PTRVAL canary) prints the overflowing
# task name instead of aborting silently. Recommended alongside bb_health stack
# monitor. See CONFIG_BB_HEALTH_STACK_POLL_MS in bb_health Kconfig.
CONFIG_FREERTOS_CHECK_STACKOVERFLOW=2
CONFIG_LOG_DEFAULT_LEVEL=3
CONFIG_ESP_CONSOLE_USB_SERIAL_JTAG=y
# T-Dongle-S3 has 8 MB octal PSRAM
CONFIG_SPIRAM=y
CONFIG_SPIRAM_MODE_OCT=y
# Enable bb_log panic coredump capture
CONFIG_BB_DIAG_PANIC_COREDUMP=y
CONFIG_ESP_COREDUMP_ENABLE_TO_FLASH=y
CONFIG_ESP_COREDUMP_DATA_FORMAT_ELF=y
CONFIG_ESP_COREDUMP_CHECKSUM_CRC32=y
CONFIG_BB_LOG_ROUTES=y
CONFIG_BB_LOG_STREAM_AUTOREGISTER=y
CONFIG_BB_NV_FLASH_AUTOREGISTER=y
CONFIG_BB_NV_CONFIG_AUTOREGISTER=y
CONFIG_BB_OTA_PULL_AUTOREGISTER=y
CONFIG_BB_OTA_PUSH_AUTOREGISTER=y
CONFIG_BB_INFO_AUTOREGISTER=y
CONFIG_BB_BOARD_AUTOREGISTER=y
CONFIG_BB_MANIFEST_AUTOREGISTER=y
CONFIG_BB_OTA_VALIDATOR_AUTOREGISTER=y
CONFIG_BB_WIFI_ROUTES_AUTOREGISTER=y
CONFIG_BB_SYSTEM_ROUTES_AUTOREGISTER=y
CONFIG_BB_OPENAPI_AUTOREGISTER=y
CONFIG_BB_MDNS_AUTOREGISTER=y
CONFIG_BB_DISPLAY_ST77XX_VARIANT_ST7735=y
CONFIG_BB_EVENT_AUTOREGISTER=y
CONFIG_BB_SMOKE_EVENT=y
# Enable RST-based SSE abort teardown (B1-517): bb_http_req_async_abort's
# SO_LINGER{on,0} setsockopt is inert without this — see bb_http.h.
CONFIG_LWIP_SO_LINGER=y
# Exercise bb_cache_reactive change-driven WS deltas + snapshot-on-connect
# (B1-589 PR-4b) on this board (default n -- see components/bb_cache_reactive/Kconfig).
CONFIG_BB_CACHE_REACTIVE_ENABLE=y
```
