## components/bb_data_http/Kconfig
```kconfig
menu "breadboard: bb_data_http"

config BB_DATA_HTTP_MAX_CLIENTS
    int "Max concurrent SSE/WS clients"
    default 3
    range 1 16
    help
        Maximum number of simultaneous bb_data_http subscribers (SSE or WS).
        Sizes the compile-time client-slot pool; bb_data_http_init()'s cfg
        may only shrink this at runtime, never grow it.

config BB_DATA_HTTP_MAX_BLOCKING_CLIENTS
    int "Max concurrent BLOCKING clients"
    default BB_DATA_HTTP_MAX_CLIENTS
    range 0 BB_DATA_HTTP_MAX_CLIENTS
    help
        B1-1482: compile-time budget of client slots that may be occupied by
        a BLOCKING send_fn (one whose call can genuinely stall the shared
        broadcaster task for up to BB_DATA_HTTP_SEND_TIMEOUT_MS, e.g. the
        ESP-IDF SSE/WS backend's socket-timeout-bounded writes) -- see
        bb_data_http_client_cfg_t's `non_blocking` field (bb_data_http.h).
        This, not BB_DATA_HTTP_MAX_CLIENTS, is what the compile-time
        SEND_TIMEOUT_MS*this-value < SWEEP_INTERVAL_MS check (platform/
        espidf/bb_data_http/bb_data_http_espidf.c) actually multiplies: a
        genuinely non-blocking consumer (e.g. an MQTT egress client wired to
        bb_mqtt_client_enqueue(), which never blocks) never pays that
        per-sweep budget, so it must not be counted against it. Defaults to
        BB_DATA_HTTP_MAX_CLIENTS so every existing board's effective guard
        stays byte-for-byte what it was before this option existed (every
        client was implicitly blocking) -- tune it down only once at least
        one acquired client is known to set non_blocking=true, to free up
        BB_DATA_HTTP_MAX_CLIENTS headroom for it without re-tripping the
        guard. bb_data_http_client_acquire() rejects (BB_ERR_NO_SPACE) a
        blocking acquire once this many blocking clients are already active,
        counted by scanning live client slots -- never a separate counter.

config BB_DATA_HTTP_MAX_POLL_CLIENTS
    int "Max concurrent STATE (poll) subscriber slots"
    default BB_DATA_HTTP_MAX_CLIENTS
    range 0 16
    help
        B1-1447: sizes the compile-time pool of STATE bookkeeping blocks
        (dirty-mask + per-key seen-generation), separately from
        BB_DATA_HTTP_MAX_CLIENTS-sized fd-table slots -- a client whose
        subscribe_mask (bb_data_http_client_cfg_t) excludes STATE never
        consumes one. Defaults to BB_DATA_HTTP_MAX_CLIENTS so worst-case
        memory stays byte-identical to before this pool split; tune it down
        only when every client is known to be EVENT-only. 0 is valid --
        every STATE-including bb_data_http_client_acquire() call then fails
        BB_ERR_NO_SPACE, proving STATE support is genuinely optional at
        compile time. bb_data_http_init()'s cfg may only shrink this at
        runtime, never grow it (mirrors BB_DATA_HTTP_MAX_CLIENTS's own
        shrink-only cfg override).

config BB_DATA_HTTP_MAX_PUSH_CLIENTS
    int "Max concurrent EVENT (push) subscriber slots"
    default BB_DATA_HTTP_MAX_CLIENTS
    range 0 16
    help
        B1-1447: sizes the compile-time pool of EVENT bookkeeping blocks
        (ring read cursor + drop accounting), separately from
        BB_DATA_HTTP_MAX_CLIENTS-sized fd-table slots -- a client whose
        subscribe_mask (bb_data_http_client_cfg_t) excludes EVENT never
        consumes one. Defaults to BB_DATA_HTTP_MAX_CLIENTS so worst-case
        memory stays byte-identical to before this pool split; tune it down
        only when every client is known to be STATE-only. 0 is valid --
        every EVENT-including bb_data_http_client_acquire() call then fails
        BB_ERR_NO_SPACE, proving EVENT support is genuinely optional at
        compile time. bb_data_http_init()'s cfg may only shrink this at
        runtime, never grow it (mirrors BB_DATA_HTTP_MAX_CLIENTS's own
        shrink-only cfg override).

config BB_DATA_HTTP_OUTBOUND_CAPACITY
    int "Per-client outbound queue entry capacity"
    default 8
    range 1 64
    help
        Max number of rendered frames a client's outbound bb_queue holds at
        once (B1-1031 byte/age backpressure extension). On overflow the
        oldest queued frame is evicted (BB_QUEUE_EVICT_OLDEST).

config BB_DATA_HTTP_OUTBOUND_ENTRY_MAX
    int "Per-client outbound max rendered frame size (bytes)"
    default 512
    range 64 4096
    help
        Maximum size of a single rendered frame (one key's value) buffered
        for a client. A render_fn output larger than this is rejected by
        bb_queue_push (truncated counter incremented, frame dropped).

config BB_DATA_HTTP_OUTBOUND_MAX_BYTES
    int "Per-client outbound total byte budget"
    default 4096
    range 512 32768
    help
        Total payload-byte budget across a client's queued outbound frames
        (B1-1031). Eviction (oldest first) fires on this budget OR the entry
        capacity above, whichever is hit first.

config BB_DATA_HTTP_EVENT_RING_CAPACITY
    int "Shared EVENT ring entry capacity"
    default 16
    range 1 64
    help
        Max number of rendered EVENT frames held at once in the single
        shared ring fed by every EVENT-kind attached key (B1-1032). On
        overflow the oldest entry is evicted; any client whose own cursor
        had not yet drained an evicted entry counts it as dropped (see
        bb_data_http_client_dropped_count()). bb_data_http_cfg_t may only
        shrink this at runtime, never grow it.

        B1-1440: a producer that pushes every occurrence into the ring
        (e.g. bb_log_event's per-line log forwarding) still loses data to
        this eviction for a burst that outruns a lagging or absent client
        -- a burst larger than this many UNCONSUMED entries evicts
        oldest-first regardless of how faithfully the producer queued
        every occurrence upstream. This capacity is SHARED across every
        EVENT-kind key on the board, not per-key, so raising the default
        costs RAM on every board with any EVENT binding at all, not just
        the one that needed more headroom -- weigh that board-wide cost
        before raising it.

config BB_DATA_HTTP_SEND_FAIL_MAX
    int "Consecutive RETRIABLE send failures before a client's head-of-queue frame is dropped"
    default 3
    range 1 32
    help
        B1-1424/B1-1429: bb_data_http_sweep_step()'s flush phase retries a
        RETRIABLE (BB_ERR_TIMEOUT) send_fn failure on the client's own
        outbound queue on the NEXT sweep (never in a loop within the same
        sweep -- see bb_data_http_send_fn's doc, bb_data_http.h) rather
        than discarding the frame -- but the retry is bounded per client,
        not unlimited:
        once this many CONSECUTIVE retriable failures land on the same
        head-of-queue frame, that one frame is dropped and the counter
        resets, so one client with a wedged transport cannot fill its own
        outbound queue and permanently stop receiving anything else. A
        FATAL (any other non-BB_OK) send_fn failure never consults this
        bound -- the client is torn down immediately instead. See the
        flush phase's doc comment in bb_data_http_common.c for the full
        rationale.

# ESP-IDF backend (B1-1033 first bench-flash de-risk, design KB 1447):
# platform/espidf/bb_data_http/bb_data_http_espidf.c only -- no effect on
# the pure core or any other platform.

config BB_DATA_HTTP_SEND_TIMEOUT_MS
    int "SSE client steady-state send timeout (ms)"
    default 20
    range 1 1000
    help
        SO_SNDTIMEO set on a client's socket at connect, and restored to
        after its first frame (see BB_DATA_HTTP_FIRST_FRAME_TIMEOUT_MS
        below). Deliberately short: BB_DATA_HTTP_MAX_BLOCKING_CLIENTS (B1-1482
        -- NOT BB_DATA_HTTP_MAX_CLIENTS; a non-blocking consumer never pays
        this budget, see that option's own doc) * this value must stay under
        BB_DATA_HTTP_SWEEP_INTERVAL_MS (enforced at compile time; default
        2*20ms=40ms < 50ms) -- but that check bounds only the
        RETRIABLE-failure sub-case of the broadcaster's per-sweep flush
        cost, not a general worst case: a client whose socket stays
        congested but keeps completing writes just under this timeout can
        still cost up to BB_DATA_HTTP_OUTBOUND_CAPACITY * this value in a
        single sweep (default 8*20=160ms) -- see the compile-time check's
        own comment in platform/espidf/bb_data_http/bb_data_http_espidf.c
        for the full arithmetic and why that pathological case is left
        unbounded rather than capped.

config BB_DATA_HTTP_FIRST_FRAME_TIMEOUT_MS
    int "SSE client first-frame send timeout (ms)"
    default 120
    range 20 5000
    help
        B1-1424 review item 4 / B1-1033's curl -N closure criterion: a
        cold, freshly-accepted socket's FIRST real send can pay TCP
        slow-start latency well past BB_DATA_HTTP_SEND_TIMEOUT_MS
        (observed ~65ms on hardware against the 20ms default) -- SSE send
        failures are fatal (no retry is ever safe, see
        bb_data_http_send_fn's return contract), and a fatal failure on a
        client's very first frame is a total, permanent loss for any
        client without its own reconnect logic (curl -N does not
        reconnect, unlike a browser's EventSource -- this is what B1-1033
        actually closes on).
        Applied ONLY to each client's first send attempt (see
        bb_data_http_espidf_slot_t's `warmed` field), then reverts to
        BB_DATA_HTTP_SEND_TIMEOUT_MS unconditionally -- steady-state
        delivery never pays this cost. Further bounded to at most ONE
        cold-start client per sweep_step() call (see
        s_cold_start_available's doc, bb_data_http_espidf.c) so the worst-
        case extra cost any one sweep pays is (BB_DATA_HTTP_MAX_CLIENTS-1)
        * BB_DATA_HTTP_SEND_TIMEOUT_MS + this value, not
        BB_DATA_HTTP_MAX_CLIENTS * this value -- default (2-1)*20+120=140ms.
        That figure DOES still exceed the 50ms default
        BB_DATA_HTTP_SWEEP_INTERVAL_MS -- accepted, not hidden, because it
        is a one-time-per-client cost (never a recurring per-sweep one,
        unlike BB_DATA_HTTP_SEND_TIMEOUT_MS's own bound above), self-
        limiting once a client's first attempt is over. Default 120ms
        gives ~85% margin over the observed 65ms.

config BB_DATA_HTTP_RECV_TIMEOUT_MS
    int "SSE client receive timeout (ms)"
    default 30000
    range 1000 120000
    help
        SO_RCVTIMEO set on a client's socket at connect -- surfaces a dead
        or half-open peer via the socket layer itself, independent of the
        broadcaster's own peer-liveness pre-pass.

config BB_DATA_HTTP_SWEEP_INTERVAL_MS
    int "Broadcaster sweep interval (ms)"
    default 50
    range 10 1000
    help
        vTaskDelay() cadence of the single broadcaster task between
        peer-liveness pre-pass + bb_data_http_sweep_step() calls.

config BB_DATA_HTTP_TASK_STACK_BYTES
    int "Broadcaster task stack (bytes)"
    default 4096
    range 2048 16384
    help
        Stack budget for the single, process-lifetime broadcaster task
        (bb_task_create, BB_TASK_BACKING_DYNAMIC).

config BB_DATA_HTTP_TASK_PRIORITY
    int "Broadcaster task priority"
    default 4
    range 1 10
    help
        FreeRTOS priority of the broadcaster task -- below lwip's own
        internal task priority by default.

config BB_DATA_HTTP_RENDER_SCRATCH_BYTES
    int "Render scratch buffer size (bytes)"
    default 256
    range 32 2048
    help
        Fixed-size CALLER-OWNED scratch bb_data_render() gathers into before
        rendering (KB 1447 fork #1: a fixed Kconfig stopgap, not a per-key
        snap_size getter -- deferred to the B1-1045 cutover). A binding
        whose desc->snap_size exceeds this returns BB_ERR_NO_SPACE from
        bb_data_render(); bb_data_http_sweep_step() leaves that key's dirty
        bit set on any render_fn failure, so it is retried (and logged,
        rate-limited) every subsequent sweep rather than silently dropped.
        Default 256 covers the largest wire type attached today (the "log"
        key's bb_log_event_wire_t at 220 bytes, B1-1045 PR-4) with margin;
        bb_data_http_attach() FAILS LOUD at attach time (ESP_LOGE +
        BB_ERR_NO_SPACE, not a silent forever-failing render) if a future
        binding's bb_data_http_attach_cfg_t.snap_size field exceeds this.

endmenu
```
