## examples/smoke/main/Kconfig.projbuild
```kconfig
menu "breadboard smoke: core-claim proof (B1-1364 PR5 validation)"

config BB_SMOKE_CORE_CLAIM
    bool "Enable synthetic core-claimer task"
    default n
    help
        Compiles in and starts a synthetic CPU-bound task
        (examples/smoke/main/smoke_core_claim.c) that EXCLUSIVELY claims a
        core via bb_task_create()'s core_owning=true path
        (components/bb_task/include/bb_task.h), ordered before
        bb_http_server_ensure_started() runs. Nothing in the tree calls
        bb_wdt_claim_core_exclusive() before httpd starts otherwise, so the
        httpd-worker-core steering path (platform/espidf/bb_http_server/
        bb_http.c, B1-1364 PR5) has never actually executed anywhere --
        this knob lets it run end-to-end and be observed on serial instead
        of remaining a dormant decision matrix exercised only by host
        tests. Default off: every existing smoke env is unaffected.

config BB_SMOKE_CORE_CLAIM_CORE
    int "Core to claim exclusively (0 or 1)"
    default 1
    range 0 1
    depends on BB_SMOKE_CORE_CLAIM
    help
        Which core the synthetic claimer task pins itself to and claims
        exclusively. httpd's worker (no explicit
        CONFIG_BB_HTTP_TASK_CORE_ID pin -- the default) should steer to
        the OTHER core. On a unicore target (esp32c3/esp32s2),
        bb_task_resolve()'s existing unicore clamp (already host-tested,
        test_bb_task_resolve_core_owning_degrades_to_noop_on_unicore)
        degrades this to BB_TASK_CORE_ANY -- no claim is taken, no crash,
        the task simply runs unpinned. See smoke_core_claim.c.

endmenu

menu "breadboard smoke: bb_data_http notify-push proof (B1-1451 validation)"

config BB_SMOKE_DATA_NOTIFY
    bool "Enable notify-push HTTP proof routes (examples/smoke/main/smoke_data_notify.c)"
    default n
    help
        Compiles in and registers three POST routes
        (/api/smoke/notify-push, /api/smoke/tick-push,
        /api/smoke/notify-stress) that exercise
        bb_data_http_notify_push() (components/bb_data_http/include/
        bb_data_http.h, B1-1451) -- the first real second caller of
        bb_data_http_push_pump()'s shared-EVENT-ring multi-writer
        protocol (B1-1449/B1-1450). notify-push/tick-push are an A/B pair
        for measuring delivery latency off-board (curl -N the SSE stream
        while POSTing each in turn); notify-stress runs a bounded tight
        loop of bb_data_http_notify_push() calls concurrently with the
        broadcaster task's own periodic sweep, to exercise genuine
        two-task contention on the shared EVENT ring. Default off: every
        existing smoke env is unaffected -- the "smoke_notify" bb_data key
        is bound/attached (smoke_data_notify_bind()/_attach(),
        examples/smoke/main/smoke_data_notify.c) and its routes are
        registered ONLY when this is on; with it off, both wrappers are
        no-op BB_OK stubs, so a default smoke build never binds or attaches
        the key at all and consumes no bb_data binding-table slot for it.

endmenu
```
