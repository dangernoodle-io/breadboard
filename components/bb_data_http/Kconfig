## components/bb_mqtt_client/Kconfig
```kconfig
menu "breadboard: bb_mqtt_client"

config BB_MQTT_CLIENT_KEEPALIVE
    int "MQTT keepalive interval in seconds"
    default 120
    range 10 3600
    help
        MQTT keepalive sent to the broker. If the broker closes the connection
        after this many seconds of inactivity, esp-mqtt will reconnect
        automatically (unless disable_auto_reconnect is set).
        Note: CONFIG_MQTT_TASK_STACK_SIZE may need to be raised to 6144 or
        higher when TLS is enabled (mbedTLS handshake requires ~5-8 KB stack).

config BB_MQTT_CLIENT_NETWORK_TIMEOUT_MS
    int "MQTT network timeout (ms)"
    default 30000
    range 1000 120000
    help
        Maps to esp_mqtt_client_config_t.network.timeout_ms. esp-mqtt
        defaults to 10000, which aborts writes ("write didn't complete in
        specified timeout") on a marginal link and forces a reconnect.
        30s tolerates a slow/weak link without churning.

config BB_MQTT_CLIENT_RX_BUFFER_BYTES
    int "MQTT receive buffer size (bytes)"
    default 1024
    range 64 4096
    help
        Receive buffer for the bb_mqtt_client component (maps to
        esp_mqtt_client_config_t.buffer.size), overriding the global
        CONFIG_MQTT_BUFFER_SIZE. ALSO sizes the app-level reassembly buffer
        used by bb_mqtt_client_on_message() (B1-487) to accumulate a message across
        multiple MQTT_EVENT_DATA fragments — a message whose total size
        exceeds this value is dropped (logged) rather than delivered.
        Default 1024 covers real meta/stats-shaped subscribe payloads
        (the 256-byte legacy default only fit publish-only/non-subscribing
        clients whose RX only ever sees short protocol ACK frames); raise it
        further if your client subscribes to topics with larger payloads.

config BB_MQTT_CLIENT_TX_BUFFER_BYTES
    int "MQTT transmit buffer size (bytes)"
    default 1024
    range 128 4096
    help
        Transmit buffer (maps to esp_mqtt_client_config_t.buffer.out_size);
        1024 fits typical JSON telemetry.

config BB_MQTT_CLIENT_OUTBOX_LIMIT_BYTES
    int "MQTT outbox size limit (bytes)"
    default 4096
    range 0 65536
    help
        Maps to esp_mqtt_client_config_t.outbox.limit. esp-mqtt's outbox
        holds queued/unacknowledged messages (including bb_mqtt_client_enqueue()
        traffic) and is unbounded by default (0 = no limit), which risks
        unbounded heap growth on no-PSRAM targets under sustained publish
        pressure. A non-zero limit makes the header's documented
        BB_ERR_NO_SPACE retry contract (see bb_mqtt_client_enqueue()) actually
        reachable: esp_mqtt_client_enqueue() returns -2 (mapped to
        BB_ERR_NO_SPACE) once the outbox would exceed this many bytes.

        This is ONE client-wide limit, not enqueue()-only: esp-mqtt applies
        the SAME check to bb_mqtt_client_publish() calls with qos>0 (qos=0
        publishes are fire-and-forget and never enter the outbox). Existing
        qos>0 publish() callers therefore also newly see BB_ERR_NO_SPACE
        back-pressure under this default, not just enqueue() callers.

        Set to 0 to restore esp-mqtt's unbounded default.

config BB_MQTT_CLIENT_SUSPEND_STOP_ONLY
    bool "Suspend uses stop-only (keeps client resident, no destroy/recreate)"
    default n
    help
        When y, bb_mqtt_client_suspend_default() calls esp_mqtt_client_stop() only
        (keeps client handle, buffers, and task resident, ~11 KB -- plus up
        to BB_MQTT_CLIENT_OUTBOX_LIMIT_BYTES more if the outbox is occupied
        at suspend time) and bb_mqtt_client_resume_default() calls
        esp_mqtt_client_start() only — no destroy, no realloc, no NVS reload.

        ONLY safe when bb_mem_arena_tls covers the TLS handshake that follows
        the suspend window.  The ~11 KB (+ outbox) residency means the
        largest_free_block improvement is smaller than the full destroy
        path; use this mode only when the arena already reserves enough
        headroom.

        Default n = full destroy+recreate (original behavior): suspend calls
        bb_mqtt_client_stop() which destroys the client and frees all buffers; resume
        calls auto_client_create_from_nvs() to recreate.

endmenu
```

## components/bb_openapi/Kconfig
```kconfig
menu "breadboard: bb_openapi"

config BB_OPENAPI_RUNTIME_META
    bool "Ship OpenAPI runtime meta tables + engine into firmware"
    default n
    help
        Compiles the bb_serialize_meta engine (bb_serialize_meta_openapi_schema/
        bb_serialize_meta_validate) plus every co-located bb_serialize_desc_meta_t
        table across the tree (components/bb_serialize_meta) into the device
        image, for a runtime OpenAPI schema generator. Every describe-route
        component in the tree has adopted the descriptor-meta path -- none
        remain on hand-authored describe_route schemas -- and composes its
        schema from this engine at init when this knob is on. Default off
        ships zero bytes of this code; the PlatformIO native host test env
        always builds it regardless of this Kconfig. This is a
        runtime-compose opt-in, not a migration in progress: trading the
        device RAM/flash of the engine against generating schemas at init
        instead of shipping them as hand-authored describe_route literals.

endmenu
```

## components/bb_timer/Kconfig
```kconfig
menu "breadboard: bb_timer"

config BB_TIMER_DISP_STACK
    int "Shared dispatcher task stack size (bytes)"
    default 4096
    range 2048 16384
    help
        Stack for the bb_timer_disp task that runs MODE A deferred
        work functions. mdns/cache/cJSON are safe; TLS is not (use MODE B).

config BB_TIMER_DISP_PRIORITY
    int "Shared dispatcher task priority"
    default 5
    range 1 20
    help
        FreeRTOS priority for the bb_timer_disp task. Default 5: above
        background worker tasks (1) and equal to bb_event_disp (5), below
        the esp_timer service task (~22).

config BB_TIMER_DISP_CORE
    int "Shared dispatcher task core affinity (-1 = no affinity)"
    default -1
    range -1 1
    help
        Core to pin the bb_timer_disp task to. Default -1 (no affinity) lets
        the scheduler place it on whichever core has CPU. Without affinity,
        the prio-5 dispatcher cannot be starved on boards where core 1 runs
        a high-priority CPU-bound task (e.g. mining at prio 20). Boards that
        specifically want it off the esp_timer service core (core 0) can still
        pin it explicitly via CONFIG_BB_TIMER_DISP_CORE.

        A dispatcher that is merely starved -- not hung -- for longer than
        CONFIG_ESP_TASK_WDT_TIMEOUT_S trips BB_TIMER_DISP_WDT_ENABLE's same
        path as a genuine hang. Today, with CONFIG_ESP_TASK_WDT_PANIC unset
        by default, that only produces a spurious warning; a board owner who
        later enables CONFIG_ESP_TASK_WDT_PANIC should check the core and
        priority layout here first, or a starvation spell can trigger an
        unwanted reboot.

config BB_TIMER_DISP_QUEUE_DEPTH
    int "Shared dispatcher coalescing queue depth"
    default 16
    range 4 64
    help
        Depth of the internal queue between signal-only timer callbacks
        and the bb_timer_disp worker task. With coalescing, one slot per
        timer is sufficient in practice; the queue is a safety net for
        burst scenarios.

config BB_TIMER_DISP_WDT_ENABLE
    bool "Subscribe bb_timer_disp to the Task Watchdog Timer"
    default y
    depends on ESP_TASK_WDT_EN
    help
        When enabled, the shared dispatcher task (bb_timer_disp) subscribes
        to the global Task WDT at startup and feeds it on every idle timeout
        and after each work_fn returns.

        A work_fn that blocks longer than CONFIG_ESP_TASK_WDT_TIMEOUT_S
        (the global Task WDT timeout) trips the TWDT ISR, which logs the
        stuck task by name. With CONFIG_ESP_TASK_WDT_PANIC unset -- the
        default in every sdkconfig shipped in this repo -- that is ALL it
        does: the ISR re-arms and the dispatcher stays wedged exactly as
        before, just no longer silent. This is NOT a reboot and NOT
        self-recovery; it only gets you a reboot with reset_reason task_wdt
        if the board also has CONFIG_ESP_TASK_WDT_PANIC enabled.

        The warning is expected to stay visible even if bb_log itself is
        wedged, since the TWDT ISR logs via a direct ROM-UART print path
        that bypasses bb_log's writer queue -- not through the same queue a
        stuck dispatcher could be blocking.

        The effective stall-to-reboot bound (when PANIC is also on) is
        CONFIG_ESP_TASK_WDT_TIMEOUT_S, not BB_TIMER_DISP_WDT_FEED_MS. The
        feed interval only controls how often the dispatcher feeds on idle
        (queue empty) ticks; it must be shorter than the global WDT timeout.

        Default y — bb_timer_disp runs every MODE_SHARED work_fn
        synchronously with no per-callback timeout of its own, so a single
        hung callback previously parked every periodic job on the
        dispatcher silently forever: no warning, no reset_reason, nothing
        to attribute a hang to. Subscribing it to the Task WDT gives that
        hang a name in the log, even though the dispatcher itself remains
        wedged unless CONFIG_ESP_TASK_WDT_PANIC is also on. Turn this off
        only if even the attributed warning is unwanted.

config BB_TIMER_DISP_WDT_FEED_MS
    int "Dispatcher WDT idle feed interval (ms)"
    default 5000
    range 1000 30000
    depends on BB_TIMER_DISP_WDT_ENABLE
    help
        How often the bb_timer_disp task feeds the Task WDT when the
        dispatch queue is empty (idle). Must be shorter than
        CONFIG_ESP_TASK_WDT_TIMEOUT_S. Default 5000 ms.

endmenu
```

## components/bb_wifi_prov/Kconfig
```kconfig
menu "breadboard: bb_wifi_prov"

config BB_WIFI_PROV_TASK_STACK
    int "Provisioning manager task stack size (bytes)"
    default 6144
    range 4096 16384
    help
        Stack for the wifi_prov_mgr task that drives the WP_IDLE/WP_ACTIVE/
        WP_CLOSING provisioning FSM (wifi_prov_policy.h). PROVISIONAL AND
        UNMEASURED -- no on-device stack-high-water-mark reading has been
        taken for this task yet.

        See wifi_reconn's own RECONN_TASK_STACK comment
        (platform/espidf/bb_wifi/wifi_reconn.c) for the precedent this
        guesses from: that task shipped at 4096 and only later, after a real
        bug (B1-330), was raised to 6144 once the escalate-reboot path's NVS
        writes were measured to consume ~1.5-2 KB more stack than assumed.
        Don't repeat that mistake here without measuring.

        To measure: flash, let the manager task run through at least one
        WP_ACTIVE (portal open) cycle, then GET /api/diag/tasks and read
        stack_hwm for "wifi_prov_mgr" (every FreeRTOS task is reported
        automatically -- see bb_diag_tasks_get_wire_fill_row's
        usStackHighWaterMark field, platform/espidf/bb_diag_http/
        bb_diag_http_routes.c). Adjust this default once real numbers exist.

        Defaulted to 6144 (not wifi_reconn's original 4096) because this
        task's peak call path is heavier: act_try_ap_start/act_try_prov_start
        run esp_wifi/esp_netif AP init plus httpd_start (bb_wifi_prov_start),
        which is a deeper/heavier call chain than the NVS-write path that
        forced wifi_reconn up from 4096.

config BB_WIFI_PROV_TASK_PRIORITY
    int "Provisioning manager task priority"
    default 5
    range 1 20
    help
        FreeRTOS priority for the wifi_prov_mgr task. Default 5: matches
        wifi_reconn's RECONN_TASK_PRIO peer-manager task, above background
        worker tasks (1), well below the esp_timer service task (~22).

config BB_WIFI_PROV_QUEUE_DEPTH
    int "Provisioning manager event queue depth"
    default 8
    range 4 32
    help
        Depth of the queue between the provisioning-entry/save-success
        notifiers and the wifi_prov_mgr task. Matches wifi_reconn's
        RECONN_QUEUE_LEN peer default.

config BB_WIFI_PROV_SETTLE_MS
    int "WP_CLOSING settle-timer duration (ms)"
    default 2000
    range 100 30000
    help
        How long the provisioning FSM waits in WP_CLOSING (see
        wifi_prov_policy.h) before tearing down the portal after a
        successful POST /save, giving the in-flight HTTP response time to
        flush before ap_stop_fn tears the netif out from under it.

        Floored at 100, never 0: bb_fsm_arm_timer(fsm, event, ms==0)
        DISARMS rather than fires (bb_fsm.h), and the settle timeout is
        WP_CLOSING's ONLY exit -- a 0 here would strand the FSM (and the
        portal/AP) in WP_CLOSING forever. wifi_prov_policy.c's
        settle_ms_floor() also floors defensively at the point of use, but
        this Kconfig range is the first line of defense against a
        misconfigured build ever producing that value.

endmenu
```

## components/storage/bb_storage/Kconfig
```kconfig
menu "breadboard: bb_storage"

config BB_STORAGE_MAX_BACKENDS
    int "Storage backend registry capacity"
    default 4
    help
        Maximum number of registered backends (e.g. "nvs", "sdcard", "ram")
        in the static registry. Each entry costs sizeof(a name pointer + a
        4-function vtable + a context pointer). Registering more backends
        than this returns BB_ERR_NO_SPACE.

config BB_STORAGE_TXN_MAX_KEYS
    int "Multi-key transaction default slot capacity"
    default 3
    range 1 32
    help
        Default capacity (element count) for a bb_storage_txn_t declared via
        BB_STORAGE_TXN_DECLARE_DEFAULT() -- NOT a repo-wide ceiling (B1-1235):
        a bb_storage_txn_t's real capacity is caller-sized, set per-txn by
        the slots/cap arguments passed to bb_storage_txn_begin() (see
        bb_storage.h). This knob only sizes the DEFAULT-macro's array and
        (for now) bb_config_staged's own internal default-capacity backing
        array. Staging a new key once a transaction's slot table is full
        returns BB_ERR_NO_SPACE.

        No longer floored at 3: that floor existed only to protect
        bb_storage_rtc's fixed 3-key (ssid/pass/provisioned) commit under the
        old single-global-cap model. That constraint is now a RUNTIME,
        BACKEND-SCOPED contract instead of a compile-time one -- a caller
        declaring cap < 3 against the "rtc" backend gets BB_ERR_NO_SPACE on
        the 3rd key (see bb_storage_rtc.h).

config BB_STORAGE_TXN_VALUE_MAX_BYTES
    int "Multi-key transaction max staged value size (bytes)"
    default 64
    range 63 4096
    help
        Maximum size in bytes of a single value staged within a
        bb_storage_txn_t (covers a 63-byte WiFi password). A
        bb_storage_txn_set() call exceeding this returns BB_ERR_NO_SPACE.

        Floored at 63: bb_storage_rtc's "pass" field allows up to 63
        non-NUL bytes -- a lower cap would make staging a max-length WiFi
        password through the "rtc" backend always spuriously fail.

config BB_STORAGE_ENTRY_LIST_CAP
    int "Recommended bb_storage_list_entries() caller-side array capacity"
    default 32
    help
        NOT enforced inside bb_storage -- bb_storage_list_entries() is a
        pure caller-allocated-array API and never itself consults this
        value (see bb_storage.h). Documents the recommended
        bb_storage_entry_t[] array size for callers enumerating a
        backend's entries (e.g. bb_storage_nvs, the storage diag section)
        so they share one house-wide cap instead of each picking an
        arbitrary number.

endmenu
```
