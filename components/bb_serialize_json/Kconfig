## components/bb_serialize_json/Kconfig
```kconfig
menu "breadboard: bb_serialize_json"

config BB_SERIALIZE_JSON_F64_DECIMALS
    int "Fixed fractional digits for f64 JSON output"
    default 6
    range 1 15
    help
        Number of fractional digits emitted for double values
        (deterministic fixed-decimal, e.g. 3.5 -> "3.500000" at the
        default of 6). No snprintf/locale involved -- purely a scale-
        and-round hand-rolled formatter.

config BB_SERIALIZE_JSON_SCRATCH_MAX_BYTES
    int "Shared key/number/literal reassembly scratch size (bytes) for the JSON scanner"
    default 64
    range 16 256
    help
        Size of the single internal scratch buffer the streaming/bounded
        JSON scanner (bb_serialize_json_scan_*) uses to reassemble a
        key string plus the number or literal that immediately follows
        it -- the only token kinds ever fully buffered (string VALUES
        stream as spans and never touch this buffer). A key or number
        that would overflow this bound fails the scan with
        BB_ERR_NO_SPACE rather than truncating silently.

config BB_SERIALIZE_JSON_TOK_POOL_DEFAULT_CAP
    int "Suggested default token-recorder pool capacity (token count)"
    default 48
    range 8 512
    help
        Suggested default number of bb_serialize_json_tok_t slots for a
        caller-owned static/stack pool passed to
        bb_serialize_json_tok_recorder_init(). Sized to comfortably exceed
        the worst-case Stratum mining.notify document (16 merkle branches,
        clean_jobs present) at 29 tokens -- see
        BB_SERIALIZE_JSON_TOK_POOL_DEFAULT_CAP's doc comment in
        bb_serialize_json.h for the exact arithmetic. Purely a sizing
        suggestion: the caller supplies its own pool array and pool_cap
        explicitly to bb_serialize_json_tok_recorder_init(), so this default
        only matters to callers that choose to size their array with it.

endmenu
```

## components/bb_serialize_logfmt/Kconfig
```kconfig
menu "breadboard: bb_serialize_logfmt"

config BB_SERIALIZE_LOGFMT_F64_DECIMALS
    int "Fixed fractional digits for f64 logfmt output"
    default 6
    range 1 15
    help
        Number of fractional digits emitted for double values
        (deterministic fixed-decimal, e.g. 3.5 -> "3.500000" at the
        default of 6). No snprintf/locale involved -- purely a scale-
        and-round hand-rolled formatter, same algorithm as
        BB_SERIALIZE_JSON_F64_DECIMALS.

endmenu
```

## components/bb_settings/Kconfig
```kconfig
menu "breadboard: bb_settings"

config BB_SETTINGS_CREDS_RTC_BACKUP
    bool "Back up wifi creds to RTC slow memory (survive NVS erase-on-corruption)"
    default y
    help
      Mirrors wifi ssid/pass/provisioned (~108 bytes) into RTC_NOINIT memory so a
      crash-induced NVS erase doesn't strand a headless board. Survives software
      reset/panic; lost on full power-off. See B1-242. Rehomed from bb_nv
      (CONFIG_BB_NV_CREDS_RTC_BACKUP) as part of the bb_nv dissolution, B1-964.

endmenu
```

## components/bb_sink_display/Kconfig
```kconfig
menu "breadboard: bb_sink_display"

config BB_SINK_DISPLAY_MAX_FIELDS
    int "Maximum number of selectable display fields"
    default 16
    range 1 32
    help
        Fixed-capacity bound on the v1 hand-authored field catalog, the
        bb_filter selection output, and the row table. Raise only if a
        board's catalog genuinely exceeds 16 fields.

config BB_SINK_DISPLAY_VALUE_MAX
    int "Maximum formatted row value length (bytes, including NUL)"
    default 40
    range 8 128
    help
        Buffer size for one row's formatted "label: value unit" string
        (bb_sink_display_format_default()'s output, or a custom format_fn's).

endmenu
```

## components/bb_sink_event/Kconfig
```kconfig
menu "breadboard: bb_sink_event"

config BB_SINK_EVENT_MAX_TOPICS
    int "Maximum number of subtopics registered with bb_sink_event"
    default 16
    range 1 32

config BB_SINK_EVENT_AUTOREGISTER
    bool "Auto-register bb_sink_event sink at boot"
    default n
    help
        When enabled, bb_sink_event auto-registers at PRE_HTTP tier. Disable
        (default) to register manually with explicit subscription.

endmenu
```

## components/bb_sink_http/Kconfig
```kconfig
menu "breadboard: bb_sink_http"

config BB_SINK_HTTP_RESP_BUF_BYTES
    int "Response buffer size for HTTP publish (bytes)"
    default 256
    help
        Size of the stack-allocated response buffer used by bb_sink_http on
        each publish call. AWS IoT Core returns a minimal JSON body on
        success; 256 bytes is sufficient. Increase if your endpoint returns
        larger responses.

config BB_SINK_HTTP_MAX_CONSEC_FAILURES
    int "Consecutive transport failures before session reset"
    default 3
    range 1 20
    help
        When this many consecutive publish transport errors occur on the
        reusable keep-alive session, the session is closed and re-opened on
        the next publish attempt. A lower value recovers faster from server-
        side idle-socket evictions; a higher value tolerates transient blips
        without incurring reconnect overhead. Default 3 matches the prior
        hardcoded value (no behavior change).

config BB_SINK_HTTP_HEADERS_BUF_BYTES
    int "NVS serialization buffer size for configured headers (bytes)"
    default 2596
    range 512 8192
    help
        Size of the buffer used to serialize and read back the configured
        HTTP headers from NVS. The minimum safe value is
        BB_SINK_HTTP_HEADERS_MAX * (BB_SINK_HTTP_HEADER_NAME_MAX +
        BB_SINK_HTTP_HEADER_VALUE_MAX + 4) = 8 * (64 + 256 + 4) = 2592
        bytes. The default (2596) covers the maximum header set with 4 bytes
        of headroom. Increase if you need more headers than the default
        BB_SINK_HTTP_HEADERS_MAX (8).

endmenu
```

## components/bb_sink_mqtt/Kconfig
```kconfig
menu "breadboard: bb_sink_mqtt"

config BB_SINK_MQTT_QOS
    int "Default MQTT QoS level for telemetry publishes"
    default 0
    range 0 1
    help
        MQTT Quality-of-Service level used by bb_sink_mqtt when publishing
        telemetry payloads. 0 = at-most-once (fire-and-forget, lowest
        overhead); 1 = at-least-once (acknowledged delivery, required by
        AWS IoT Core for reliable ingestion). Default 0 matches the prior
        hardcoded value (no behavior change). Set to 1 for AWS IoT Core
        deployments. QoS 2 is not supported by bb_sink_mqtt.

config BB_SINK_MQTT_RETAIN
    bool "Set the MQTT retain flag on telemetry publishes"
    default n
    help
        When enabled, telemetry messages published via bb_sink_mqtt carry
        the MQTT retain flag so the broker stores the last message per topic
        and delivers it immediately to new subscribers. Default n (retain
        off) matches the prior hardcoded value (no behavior change). Enable
        for deployments where dashboard tools rely on retained state (e.g.
        Home Assistant auto-discovery).

endmenu
```

## components/bb_sink_udp/Kconfig
```kconfig
menu "breadboard: bb_sink_udp"

config BB_SINK_UDP_ENABLE
    bool "Enable UDP telemetry egress sink"
    default n
    help
        Compiles in bb_sink_udp, an additive fan-out bb_pub sink that emits
        one bb_udp_frame datagram (kind=TELEMETRY) per publish over IPv4 UDP.
        Coexists with bb_sink_mqtt / bb_sink_http — not the bb_pub
        exclusive-sink arbiter.

        This is a menu-gate for the sibling options below (_MTU,
        _AUTOREGISTER) — it controls their visibility and defaults in
        menuconfig only. Like other tier-2 satellites, the bb_sink_udp
        component sources compile whenever the component is added to a
        consumer's REQUIRES, regardless of this flag; actual runtime
        behavior (whether the sink ever sends a datagram) is gated by
        _AUTOREGISTER or by the consumer's own manual
        bb_sink_udp_init()/bb_sink_udp()/bb_pub_add_sink() call sequence.

        Destination config (host/port/broadcast) is no longer configured
        here — it moved to the bb_udp_client transport component (see
        components/bb_udp_client/Kconfig, CONFIG_BB_UDP_PORT /
        CONFIG_BB_UDP_BROADCAST) per KB#702/#710.

config BB_SINK_UDP_MTU
    int "Max encoded datagram size (bytes)"
    default 1400
    range 512 2048
    depends on BB_SINK_UDP_ENABLE
    help
        Upper bound on the encoded bb_udp_frame (header + topic + payload).
        A publish whose encoded frame exceeds this is dropped (never
        fragmented) and counted by bb_sink_udp_dropped().

        This buffer is a plain stack allocation (uint8_t buf[MTU]) inside
        udp_publish(), which runs on the bb_pub worker task — its stack must
        be sized to cover this allocation plus its own call-frame overhead;
        see CONFIG_BB_PUB_WORKER_STACK.

        Floor is 512, not the 11-byte frame-header minimum: a realistic
        fully-qualified topic ("metrics/<hostname>/<subtopic>") plus a
        small JSON payload routinely runs 100-300+ bytes, and 256 was found
        too tight to leave headroom for that in practice. Ceiling is 2048
        to stay under the common Ethernet/WiFi path MTU (1500) with room
        for IP/UDP headers, while still allowing jumbo-frame LANs some
        margin; values above 2048 risk IP fragmentation, which this sink
        deliberately never performs (oversized frames are dropped instead).

endmenu
```

## components/bb_sink_ws/Kconfig
```kconfig
menu "bb_sink_ws"
config BB_SINK_WS_AUTOREGISTER
    bool "Auto-register bb_sink_ws on startup"
    default n
endmenu
```

## components/bb_sse_writer/Kconfig
```kconfig
menu "breadboard: bb_sse_writer"

config BB_SSE_SEND_TIMEOUT_MS
    int "SSE-write send timeout (ms)"
    default 3000
    range 500 30000
    help
        SSE-write send timeout in ms; a stalled client send is abandoned after
        this interval so the socket and async httpd session are reclaimed.

config BB_SSE_RECV_TIMEOUT_MS
    int "SSE-write receive timeout (ms)"
    default 30000
    range 1000 120000
    help
        SSE-write receive timeout in ms (SO_RCVTIMEO); surfaces dead peers on
        the read path. Default 30000 (= 2x the 15 s heartbeat interval).

config BB_SSE_ABORT_POLL_MS
    int "SSE peer-abort poll interval (ms)"
    default 1000
    range 100 15000
    help
        Maximum slice of the wait_fn/heartbeat interval between peer-abort
        (MSG_PEEK) checks. The outer SSE loop only re-checks for a dead peer
        when wait_fn returns, which can otherwise take up to heartbeat_ms
        (e.g. 15 s) on a quiet topic — during that window an aborted
        connection's socket lingers, retaining lwIP PCB/pbuf resources
        (B1-517). Lowering this value detects abort sooner at the cost of
        more frequent (non-blocking) peek syscalls; it does not change the
        heartbeat cadence itself.

endmenu
```

## components/bb_storage/Kconfig
```kconfig
menu "breadboard: bb_storage"

config BB_STORAGE_MAX_BACKENDS
    int "Storage backend registry capacity"
    default 4
    help
        Maximum number of registered backends (e.g. "nvs", "sdcard", "ram")
        in the static registry. Each entry costs sizeof(a name pointer + a
        4-function vtable + a context pointer). Registering more backends
        than this returns BB_ERR_NO_SPACE.

config BB_STORAGE_TXN_MAX_KEYS
    int "Multi-key transaction slot capacity"
    default 3
    help
        Maximum number of distinct keys a single bb_storage_txn_t can stage
        (matches wifi-pending ssid/pass/try). Staging a new key once a
        transaction's slot table is full returns BB_ERR_NO_SPACE.

config BB_STORAGE_TXN_VALUE_MAX_BYTES
    int "Multi-key transaction max staged value size (bytes)"
    default 64
    help
        Maximum size in bytes of a single value staged within a
        bb_storage_txn_t (covers a 63-byte WiFi password). A
        bb_storage_txn_set() call exceeding this returns BB_ERR_NO_SPACE.

endmenu
```

## components/bb_storage_http/Kconfig
```kconfig
menu "breadboard: bb_storage_http (backend-agnostic DELETE /api/diag/storage, POST /api/diag/factory-reset)"

config BB_STORAGE_HTTP_FACTORY_RESET
    bool "Enable POST /api/diag/factory-reset route (full NVS wipe + deferred reboot)"
    default n
    help
      When enabled, registers POST /api/diag/factory-reset. A valid request
      body {"confirm":"factory-reset"} erases the entire "nvs" bb_storage
      backend (all namespaces), invalidates the RTC creds mirror so the
      restore-heal path cannot resurrect credentials, responds 202, then
      reboots after ~500 ms. Disabled by default because factory reset is a
      destructive operation that should be opt-in.

endmenu
```

## components/bb_storage_nvs/Kconfig
```kconfig
menu "breadboard: bb_storage_nvs"

config BB_STORAGE_NVS_GET_SCRATCH_MAX
    int "Max bytes for truncated blob reads via the generic bb_storage facade"
    default 512
    help
        When a caller requests fewer bytes (cap) than a stored NVS blob's
        full length via the generic bb_storage_get() facade, the "nvs"
        backend copies through a bounded on-stack scratch buffer of this
        size (no heap). A blob larger than this value that also needs
        truncation returns BB_ERR_NO_SPACE. Does not apply to
        bb_nv_get_str/u8/u16/u32 (the typed accessors read directly into the
        caller's buffer via nvs_get_str/nvs_get_u*, unaffected by this
        limit).

endmenu
```

## components/bb_storage_ram/Kconfig
```kconfig
menu "breadboard: bb_storage_ram"

config BB_STORAGE_RAM_MAX_ENTRIES
    int "In-memory storage backend table capacity"
    default 32
    help
        Maximum number of distinct keys the "ram" bb_storage backend can
        hold at once. Fixed-size table, no heap. Storing a new key once
        the table is full returns BB_ERR_NO_SPACE.

config BB_STORAGE_RAM_MAX_VALUE_BYTES
    int "In-memory storage backend max value size (bytes)"
    default 256
    help
        Maximum size in bytes of a single stored value. A bb_storage_set()
        call exceeding this returns BB_ERR_NO_SPACE (never truncated).

config BB_STORAGE_RAM_MAX_KEY_BYTES
    int "In-memory storage backend max key length (bytes, incl. NUL)"
    default 64
    help
        Maximum length of a key string, including the NUL terminator. A key
        at or above this length is rejected with BB_ERR_INVALID_ARG.

endmenu
```

## components/bb_sub/Kconfig
```kconfig
menu "breadboard: bb_sub"

config BB_SUB_MAX_PAYLOAD_BYTES
    int "Max payload size bb_sub caches per topic (bytes)"
    default 1024
    range 128 4096
    help
        Per-topic owned-buffer cap used by bb_sub_route(). Payloads larger
        than this are DROPPED (BB_ERR_NO_SPACE), not truncated. Should be
        >= the ingress transport's own reassembly cap (e.g.
        CONFIG_BB_MQTT_RX_BUFFER_BYTES) so no message that reaches bb_sub
        is silently lost at this layer.

endmenu
```
