## components/bb_sub_mqtt/Kconfig
```kconfig
menu "breadboard: bb_sub_mqtt"

config BB_SUB_MQTT_AUTOREGISTER
    bool "Auto-register bb_sub_mqtt ingress adapter via bb_init (regular tier)"
    default y
    help
        When enabled, bb_sub_mqtt self-registers at the regular bb_init
        tier. On init it loads CONFIG_BB_SUB_MQTT_TOPICS (space/comma-
        separated filter list) plus any filters already added via
        bb_sub_mqtt_add_topic(), subscribes each via bb_mqtt_subscribe() on
        bb_mqtt_default(), and registers bb_sub_route (via
        bb_mqtt_on_message()) as the MQTT receive callback. No-ops (logs +
        returns BB_OK) when no default MQTT client is configured. Disable
        to call bb_sub_mqtt_init() manually.

config BB_SUB_MQTT_TOPICS
    string "Default MQTT topic filter(s) to subscribe (space/comma-separated)"
    default "metrics/+/meta"
    help
        Subscribed at boot via bb_mqtt_subscribe(), one call per filter.
        Combine with bb_sub_mqtt_add_topic() for filters that can't be
        expressed as a static Kconfig default.

config BB_SUB_MQTT_INGEST_SELF
    bool "Ingest this device's own published topics back through bb_sub"
    default n
    help
        By default (n) bb_sub_mqtt drops any inbound message whose 2nd
        '/'-delimited topic segment equals this device's own hostname
        (bb_nv_config_hostname()) — i.e. "<prefix>/<hostname>/<subtopic>",
        matching bb_pub's own topic shape. This prevents a device that both
        publishes AND subscribes to the same wildcard (e.g.
        "metrics/+/meta") from ingesting its own published data back into
        bb_cache. Enable (y) to opt out of self-exclusion. Runtime override:
        bb_sub_mqtt_set_ignore_self().

endmenu
```

## components/bb_system/Kconfig
```kconfig
menu "breadboard: bb_system (routes)"

config BB_SYSTEM_BOOT_BANNER
    bool "Emit a one-time boot banner (project/version/build/idf)"
    default y
    help
        When enabled, bb_system auto-emits a single bb_log_i line during the
        EARLY init tier naming the project, firmware version, build
        date/time, and ESP-IDF version — via the existing bb_system
        accessors. Disable for consumers that build their own boot banner.

config BB_SYSTEM_REBOOT_BUDGET_MIN_INTERVAL_S
    int "Minimum seconds between rate-limited reboots (per cause)"
    default 1800
    range 300 86400
    help
        Shared reboot-budget cooldown consulted by bb_system_reboot_budget_
        allows()/_record() (B1-863). Each bb_reboot_cause_t is rate-limited
        independently (its own persisted ring) but shares this ONE knob —
        at most one reboot per this many seconds, per cause.

config BB_SYSTEM_REBOOT_BUDGET_DAILY_CAP
    int "Maximum rate-limited reboots per rolling 24h (per cause)"
    default 4
    range 1 10
    help
        Hard cap on reboots per cause within a rolling 24h window,
        persisted across reboots (ring buffer of reboot timestamps).

config BB_SYSTEM_BOOT_FAIL_THRESHOLD
    int "Boot-fail count at/above which a caller should treat the device as stuck"
    default 3
    range 1 255
    help
        Consulted by bb_system_boot_fail_over_threshold() (B1-864). Compared
        against bb_system_boot_count_get() with >=. Not wired into any
        reboot call site by this component — a consumer (e.g. the WiFi FSM's
        anti-brick fallback) decides what to do once the threshold is hit.

config BB_SYSTEM_ROUTES_AUTOREGISTER
    bool "Build bb_system HTTP routes (/api/version, /api/reboot, /api/ping)"
    default y
    help
        When enabled, bb_system compiles its routes module that exposes
        GET /api/version, POST /api/reboot, and GET /api/ping. Adds bb_http,
        bb_json, and esp_timer to bb_system's PRIV_REQUIRES.
        Disable for headless system-helper-only consumers that don't want to
        drag the HTTP stack.

endmenu
```

## components/bb_task/Kconfig
```kconfig
menu "breadboard: bb_task"

config BB_TASK_BASE_MAX
    int "Task base-registry capacity (max concurrently-tracked bb_task_create() tasks)"
    default 24
    range 1 64
    help
        Capacity of the pointer-keyed base registry that bb_task_create()
        upserts into (one entry per live task created through this API).
        Must be <= BB_REGISTRY_SNAPSHOT_MAX (64).

        Dormant in this PR -- no in-tree caller of bb_task_create() exists
        yet; a later PR migrates existing xTaskCreate* call sites onto this
        API.

endmenu
```

## components/bb_task_registry/Kconfig
```kconfig
menu "breadboard: bb_task_registry"

config BB_TASK_REGISTRY_MAX
    int "Task registry capacity (max concurrently-tracked FreeRTOS tasks)"
    default 24
    range 1 64
    help
        Capacity of the diagnostic task registry consumed by
        GET /api/diag/tasks and the "rtos" bb_pub telemetry source. Every
        self-registering task-creation site registers here (best-effort); a
        full registry logs a warning and does NOT fail task creation. Must be
        <= BB_REGISTRY_SNAPSHOT_MAX (64). Also sizes the sw-watchdog
        monitor's static snapshot buffer (BSS; see
        bb_task_registry_sw_wdt_check()) when BB_TASK_REGISTRY_SW_WDT is
        enabled.

config BB_TASK_REGISTRY_WDT_SUPPORT
    bool "Route per-task hardware Task WDT subscribe/feed through bb_task_registry"
    default y
    depends on ESP_TASK_WDT_EN
    help
        When enabled, bb_task_registry_register()'s opts->hw_wdt_subscribe
        performs esp_task_wdt_add(handle) on the caller's behalf, and
        bb_task_registry_deregister() performs the matching
        esp_task_wdt_delete(handle). When disabled (or the Task WDT itself
        is off), hw_wdt_subscribe is accepted but is a no-op — registration
        always succeeds.

config BB_TASK_REGISTRY_SW_WDT
    bool "Enable software per-task watchdog monitor"
    default n
    help
        Compiles in and auto-starts the sw-watchdog monitor task
        (platform/espidf/bb_task_registry/bb_task_registry_monitor.c), which
        periodically calls bb_task_registry_sw_wdt_check() and reports
        overdue tasks (observe-only — never reboots). The
        bb_task_registry_sw_wdt_check() API and per-task
        opts->sw_wdt_timeout_ms field always compile in, on host and
        ESP-IDF, regardless of this setting — this gate only controls
        whether the monitor TASK is created. Per-task enablement is always
        opts->sw_wdt_timeout_ms (0 = off); this Kconfig has no default-on
        effect on any task.

config BB_TASK_REGISTRY_SW_WDT_CHECK_MS
    int "Software watchdog monitor check cadence (ms)"
    default 1000
    range 100 10000
    depends on BB_TASK_REGISTRY_SW_WDT
    help
        How often the monitor task calls bb_task_registry_sw_wdt_check().

config BB_TASK_REGISTRY_SW_WDT_STACK
    int "Software watchdog monitor task stack (bytes)"
    default 3072
    range 2048 8192
    depends on BB_TASK_REGISTRY_SW_WDT

config BB_TASK_REGISTRY_SW_WDT_PRIORITY
    int "Software watchdog monitor task priority"
    default 2
    range 1 20
    depends on BB_TASK_REGISTRY_SW_WDT

config BB_TASK_REGISTRY_SW_WDT_CORE
    int "Software watchdog monitor task core affinity (-1 = no affinity)"
    default -1
    range -1 1
    depends on BB_TASK_REGISTRY_SW_WDT

config BB_TASK_REGISTRY_SW_WDT_HW_SUBSCRIBE
    bool "Subscribe the software watchdog monitor task to the hardware Task WDT"
    default y
    depends on BB_TASK_REGISTRY_SW_WDT && ESP_TASK_WDT_EN
    help
        When enabled, the monitor task registers itself into
        bb_task_registry with opts->hw_wdt_subscribe=true, so a dead monitor
        (unable to feed itself) trips the global hardware Task WDT.

endmenu
```

## components/bb_tcp_client/Kconfig
```kconfig
menu "breadboard: bb_tcp_client"

config BB_TCP_CLIENT_MAX_INSTANCES
    int "Maximum concurrent bb_tcp_client instances"
    default 1
    help
        Size of the static instance pool bb_tcp_client_init() allocates from.
        Zero heap: every instance lives in this fixed-size pool.
        bb_tcp_client_init() returns BB_ERR_NO_SPACE once it is exhausted.

config BB_TCP_CONNECT_TIMEOUT_MS
    int "Default connect timeout (ms)"
    default 5000
    help
        Bound on bb_tcp_client_connect() when cfg.connect_timeout_ms is 0.

config BB_TCP_IO_TIMEOUT_MS
    int "Default read/write I/O timeout (ms)"
    default 5000
    help
        Bound on bb_tcp_client_read() and the short-write retry loop in
        bb_tcp_client_write() when cfg.io_timeout_ms is 0.

config BB_TCP_TLS_DEFAULT
    bool "Default to TLS when loading persisted/Kconfig config"
    default n
    help
        Default value of cfg.tls when bb_tcp_client_init(NULL) loads config
        with no persisted NVS "tls" key set yet. Persisted config in NVS
        ("bb_tcp" namespace, key "tls") overrides this default once set.

endmenu
```

## components/bb_telemetry/Kconfig
```kconfig
menu "breadboard: bb_telemetry"

config BB_TELEMETRY_MAX_SECTIONS
    int "Maximum number of registered telemetry sections"
    default 6
    range 1 16
    help
        Fixed-array capacity for section providers registered via
        bb_telemetry_register_section. Default 6 covers mqtt, http,
        publisher, and up to 3 consumer (e.g. TM) sections.

endmenu
```

## components/bb_tls/Kconfig
```kconfig
menu "breadboard: bb_tls"

config BB_TLS_HEAP_CONTIGUOUS_FLOOR
    int "Pre-TLS minimum largest-free-block guard (bytes; 0=auto-derive, <0=disable)"
    range -1 131072
    default 0
    help
        Shared contiguous-heap pre-flight floor for TLS handshakes (OTA pull,
        OTA boot status check, and future HTTP/MQTT TLS sinks).

        The dominant contiguous alloc is the mbedTLS IN record buffer
        (= CONFIG_MBEDTLS_SSL_IN_CONTENT_LEN); the floor auto-derives as
        SSL_IN_CONTENT_LEN + ~1 KB record overhead.

        0 (default) = auto-derive: floor = BB_TLS_SSL_IN_FLOOR
        (CONFIG_MBEDTLS_SSL_IN_CONTENT_LEN + 1024). Lower SSL_IN and the
        floor follows everywhere — one knob.

        Positive value = explicit byte override; pin an exact floor when
        the auto formula does not match your board's real handshake budget.

        Negative value = disable the contiguous guard entirely.

config BB_TLS_HEAP_TOTAL_FLOOR
    int "Pre-TLS minimum total-free-heap guard (bytes; 0=disabled)"
    range 0 262144
    default 0
    help
        Shared total-free-heap pre-flight floor for TLS handshakes.

        Companion to BB_TLS_HEAP_CONTIGUOUS_FLOOR: a board can clear the
        contiguous bar yet still OOM-panic if total free is too low
        (esp32-s2-mini: ~20 KB transient vs ~25 KB free). Set to ~30720
        on heap-tight boot-strategy boards.

        0 (default) = disabled; boards with ample heap are unaffected.

endmenu
```
