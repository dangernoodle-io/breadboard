## components/bb_http/Kconfig.projbuild
```kconfig
menu "BB HTTP Server"

config BB_HTTP_ROUTE_REGISTRY_CAP
    int "Route descriptor registry capacity"
    default 64
    range 16 256
    help
        Maximum number of route descriptors held in the process-wide
        bb_http route registry (used by bb_openapi and route introspection).
        When BB_HTTP_ROUTE_REGISTRY_STRICT is enabled (default), overflow
        panics at boot; otherwise the descriptor is silently dropped. Default
        64 matches the original hardcoded value; typical firmware uses 19-40
        routes. Lower for ROM-tight builds; raise for large applications.

config BB_HTTP_AUTOSTART
    bool "Auto-start HTTP server from bb_init_init()"
    default y
    help
        When enabled, bb_init_init() calls bb_http_server_start() automatically
        after the PRE_HTTP tier and before the regular route-registration tier.
        Disable if the application manages server startup itself (e.g. after CORS
        or OpenAPI configuration that must precede server start).

config BB_HTTP_MAX_URI_HANDLERS
    int "Fixed httpd handler-table size"
    default 12
    help
        Fixed httpd handler-table size: the /api/* wildcards (5) + OPTIONS /* +
        asset GET /* + headroom for non-/api routes (/save, captive portal /*,
        etc.). /api endpoints do NOT consume these slots — they use the dispatch
        table (BB_DISPATCH_API_CAP instead).

config BB_DISPATCH_API_CAP
    int "API dispatch table capacity"
    default 64
    help
        Maximum number of /api/* route entries in the static dispatch table.
        Each entry costs sizeof(bb_dispatch_api_entry_t) (~12 bytes on 32-bit).
        A high-watermark warning fires once when count reaches CAP-8.
        Does not affect httpd's handler-table (BB_HTTP_MAX_URI_HANDLERS).

config BB_HTTP_MAX_OPEN_SOCKETS
    int "Maximum concurrent HTTP sockets"
    default 5
    range 4 16
    help
      ESP-IDF httpd reserves 3 of these for internal control sockets, so
      the effective client capacity is N-3. The IDF default is 7 (= 4
      client slots), which is too low when SSE log streaming + web UI
      page loads + occasional OTA upload run concurrently — lru_purge
      silently drops the oldest socket (often the SSE stream). Default
      5 (= 2 client slots) is a safe lower bound aligning with the most-
      restrictive realistic LWIP socket pool (LWIP=8 → cap=5); raise for
      fleets with many simultaneous clients.

config BB_HTTP_RECV_WAIT_TIMEOUT_S
    int "Per-recv socket timeout (seconds)"
    default 10
    help
      Maximum time httpd waits on a single recv() before returning
      timeout. OTA push compensates with a 30-retry loop (so 10s gives
      300s total stall budget). SSE streams bypass this via setsockopt
      after async handoff. Lower values reduce the window in which a
      stalled client holds a socket against the BB_HTTP_MAX_OPEN_SOCKETS
      cap.

config BB_HTTP_SEND_WAIT_TIMEOUT_S
    int "Per-send socket timeout (seconds)"
    default 10
    help
      Maximum time httpd waits on a single send() before returning
      timeout. See BB_HTTP_RECV_WAIT_TIMEOUT_S.

config BB_HTTP_TASK_CORE_ID
    int "HTTP server task core affinity (-1 = no affinity, 0 = CPU0, 1 = CPU1)"
    default -1
    range -1 1
    help
      Pins the esp_http_server worker task to a specific core. The IDF
      default (tskNO_AFFINITY) lets the worker land on either CPU, which
      can starve under contention with a high-priority single-core busy
      loop on the same CPU (e.g. a SHA mining hot loop). Pin off the
      hot-loop core to keep HTTP responsive.

config BB_HTTP_TASK_STACK_SIZE
    int "HTTP server task stack size (bytes)"
    default 6144
    range 4096 16384
    help
      Stack for the esp_http_server worker task. 6144 is the breadboard
      default — headroom over the IDF default (4096) for the JSON-assembling
      /api handlers and response paths. Raise if a consumer's route handler
      does deep work (large stack frames, nested JSON); lower only on RAM-tight
      builds with shallow handlers.

config BB_HTTP_LWIP_RESERVE
    int "Sockets reserved for non-httpd usage (stratum, mDNS, transient outbound)"
    default 3
    range 1 6
    help
      bb_http caps httpd's max_open_sockets at CONFIG_LWIP_MAX_SOCKETS minus
      this value, so the remaining sockets stay available for stratum TCP,
      mDNS UDP, and any transient outbound HTTP (bb_http_client, bb_ota_pull,
      bb_ota_check). Default 3 matches the original hardcoded behavior.

      Consumers with tighter actual non-httpd usage can lower this to give
      httpd more headroom for parallel-fetch UIs. Raising it carves off more
      slots for outbound work at httpd's expense.

config BB_HTTP_LWIP_SEM_PER_THREAD
    bool "Use per-thread lwip op-completed sem (SSE / chunked-emit safety)"
    default y
    help
      Defines LWIP_NETCONN_SEM_PER_THREAD=1 build-wide so lwip's per-call
      op_completed_sem lives in per-thread TLS instead of inside the
      netconn / select_cb struct. Without this, a peer RST that frees
      the netconn (or a closed socket that frees its select_cb) while
      another thread is mid-call invalidates the sem, and LWIP_ASSERT
      aborts the device inside tcpip_send_msg_wait_sem (chunked emit)
      or lwip_select (httpd select loop).

      LWIP_NETCONN_SEM_PER_THREAD is a pure lwip C macro (not an
      ESP-IDF Kconfig symbol), so bb_http's CMakeLists injects
      -DLWIP_NETCONN_SEM_PER_THREAD=1 into the build-wide COMPILE_OPTIONS
      when this knob is on. A prior `select` directive here was a
      silent no-op — Kconfig only `select`s other Kconfig symbols.

      Cost: roughly one sem (~88 B) per thread that touches lwip; on a
      typical ESP-IDF firmware that's ~1 KB heap. Worth it on any
      consumer running SSE under normal browser load.

      Disable only if you've explicitly profiled the heap cost and
      know you're not running SSE or chunked emits under load.

config BB_HTTP_ROUTE_REGISTRY_STRICT
    bool "Panic/assert on route registry overflow after regular-tier walk"
    default y
    help
      After bb_init_init() finishes the regular-tier (route-registration)
      walk, audit bb_http_route_registry_count() against BB_ROUTE_REGISTRY_CAP.
      When enabled (default), overflow triggers an assert (fatal). At count >=
      CAP-8 a bb_log_w warning fires unconditionally even when strict is off.
      Disable only on explicitly constrained ROM builds where the silent-drop
      behaviour is acceptable.

config BB_HTTP_ROUTE_DUP_STRICT
    bool "Panic/assert on duplicate (method,path) route registration"
    default n
    help
      When a route with the same HTTP method and path is registered more than
      once, bb_dispatch_api_add always warns and drops the duplicate (first
      registration wins). When this option is enabled, a duplicate additionally
      triggers an assert (fatal), surfacing accidental collisions in CI and
      smoke builds. Disable (default) in production firmware where the
      warn-and-drop behaviour is acceptable.

config BB_HTTP_RESP_SEND_CHUNK_LIVENESS_PROBE
    bool "Probe socket liveness before each bb_http_resp_send_chunk"
    default y
    help
      Before each chunk send, non-blocking peek the underlying socket
      so that a peer that already closed surfaces as an early error
      return rather than dragging the chunked emitter through N more
      no-op sends. Defense-in-depth complement to
      BB_HTTP_LWIP_SEM_PER_THREAD; doesn't fully close the race (peer
      can still RST between probe and lwip_send) but stops long-tail
      writes into a dead socket.

endmenu
```

## components/bb_http_client/Kconfig
```kconfig
menu "breadboard: bb_http_client"

config BB_HTTP_CLIENT_KEEPALIVE
    bool "Enable TCP/TLS keep-alive on reusable sessions"
    default y
    help
        When enabled, bb_http_client_session_open sets keep_alive_enable=true
        on the underlying esp_http_client so the TCP/TLS connection is reused
        across bb_http_client_session_post calls (lower latency per publish).
        Disable to open+close a fresh connection on every session_post call
        (higher latency, no idle-socket wedge risk).  The default (y) preserves
        the behaviour prior to B1-284.

config BB_HTTP_CLIENT_BACKOFF_BASE_MS
    int "Retry backoff base interval (ms)"
    default 2000
    range 100 30000
    help
        Base delay for the exponential back-off ladder used between transport
        retry attempts in bb_http_client_get and bb_http_client_post. The
        ladder is computed as: attempt 0 → base, attempt 1 → base*2, attempt
        2 → min(base*4, max). Default 2000 ms matches the prior hardcoded
        value (no behavior change).

config BB_HTTP_CLIENT_BACKOFF_MAX_MS
    int "Retry backoff maximum interval (ms)"
    default 8000
    range 500 120000
    help
        Cap on the exponential back-off ladder. Derived ladder entries beyond
        this value are clamped to this maximum. Default 8000 ms matches the
        prior hardcoded maximum (no behavior change).

config BB_HTTP_CLIENT_STREAM_CHUNK_BYTES
    int "Streaming GET chunk buffer size (bytes)"
    default 2048
    range 256 8192
    help
        Size of the stack-allocated chunk buffer used by
        bb_http_client_get_stream to feed response bytes to the caller's
        callback. Larger values reduce callback frequency at the cost of
        stack space. Default 2048 matches the prior hardcoded value (no
        behavior change).

config BB_HTTP_CLIENT_DEFAULT_BUF_SIZE
    int "Default esp_http_client internal receive buffer size (bytes)"
    default 4096
    range 512 16384
    help
        Default value for cfg.buffer_size passed to esp_http_client. Controls
        the internal HTTP receive buffer. Increase for servers that send large
        response headers. Default 4096 matches the prior hardcoded fallback
        (no behavior change).

config BB_HTTP_CLIENT_DEFAULT_TIMEOUT_MS
    int "Default request timeout (ms)"
    default 10000
    range 1000 120000
    help
        Default per-request timeout for bb_http_client_get when cfg.timeout_ms
        is 0.

config BB_HTTP_CLIENT_DEFAULT_MAX_ATTEMPTS
    int "Default retry attempts"
    default 3
    range 1 10
    help
        Default number of transport attempts before giving up.

config BB_HTTP_CLIENT_TASK_STACK_SIZE
    int "Minimum task stack size for callers of bb_http_client_get* (bytes)"
    default 8192
    range 4096 16384
    help
        Any FreeRTOS task that calls bb_http_client_get or
        bb_http_client_get_stream must allocate at least this much stack to
        cover the mbedTLS handshake + cert-bundle parse path. 8 KiB is the
        empirically-validated floor on ESP32-S3; 4 KiB overflows into adjacent
        heap. Use the BB_HTTP_CLIENT_TASK_STACK macro from bb_http_client.h
        when calling xTaskCreate so the budget stays consistent across
        consumers.

        NOTE (B1-274): this default is intentionally NOT gate-keyed on
        BB_HTTP_TLS_ENABLE / BB_MQTT_TLS_ENABLE.  The OTA/update-check HTTPS
        path (esp_http_client + crt-bundle via bb_ota_check / bb_ota_pull)
        is always compiled in regardless of the sink TLS gates and requires
        >= 8 KiB of task stack for the GitHub TLS handshake.  Lowering this
        below 8192 on any build that includes bb_ota_check or bb_ota_pull
        risks a stack overflow at update-check time even when the sink TLS
        gates are OFF.  Keep at 8192 unless you have explicitly excluded both
        update-check and OTA-pull from your build.

        Note: the TLS handshake also requires a contiguous internal heap block
        of roughly CONFIG_MBEDTLS_SSL_IN_CONTENT_LEN bytes at handshake time.
        On no-PSRAM pull-strategy boards, bb_ota_pull's pre-flight guard
        (CONFIG_BB_TLS_HEAP_CONTIGUOUS_FLOOR) enforces this at runtime.

endmenu
```

## components/bb_http_pub/Kconfig
```kconfig
menu "breadboard: bb_http_pub"

config BB_HTTP_PUB_RESP_BUF_BYTES
    int "Response buffer size for HTTP publish (bytes)"
    default 256
    help
        Size of the stack-allocated response buffer used by bb_http_pub on
        each publish call. AWS IoT Core returns a minimal JSON body on
        success; 256 bytes is sufficient. Increase if your endpoint returns
        larger responses.

endmenu
```

## components/bb_http_pub_routes/Kconfig
```kconfig
menu "breadboard: bb_http_pub_routes"

config BB_HTTP_PUB_ROUTES_AUTOREGISTER
    bool "Auto-register /api/httppub HTTP routes via bb_registry"
    default y
    help
        When enabled, bb_http_pub_routes self-registers GET and PATCH
        /api/httppub through bb_registry at order 6. Disable to call
        bb_http_pub_routes_init manually, or omit the call entirely if
        your app defines its own /api/httppub handler.

endmenu
```

## components/bb_http_pub_telemetry/Kconfig
```kconfig
menu "breadboard: bb_http_pub_telemetry"

config BB_HTTP_PUB_TELEMETRY_AUTOREGISTER
    bool "Auto-register http publish telemetry section via bb_registry"
    default y
    depends on BB_TELEMETRY_AUTOREGISTER
    help
        When enabled, bb_http_pub_telemetry registers the "http" section with
        bb_telemetry at the PRE_HTTP tier. Disable to call
        bb_http_pub_telemetry_init manually.

endmenu
```

## components/bb_info/Kconfig
```kconfig
menu "breadboard: bb_info"

config BB_INFO_BUILD_TOPIC
    bool "Publish build info as retained MQTT/event topic"
    default y
    help
        When enabled, build metadata is published as a retained 'build'
        state topic via bb_cache. The topic is attached to bb_event_routes
        so SSE clients receive the initial build snapshot on connect.

endmenu
```

## components/bb_lifecycle/Kconfig
```kconfig
menu "breadboard: bb_lifecycle"

config BB_LIFECYCLE_MAX_SERVICES
    int "Max registered services"
    default 8
    range 1 255
    help
        Fixed-capacity table size for bb_lifecycle_register(). Registration
        beyond this cap fails with BB_ERR_NO_SPACE.

config BB_LIFECYCLE_MAX_OBSERVERS
    int "Max PUSH observers"
    default 8
    range 1 255
    help
        Fixed-capacity table size for bb_lifecycle_observe(). Registration
        beyond this cap fails with BB_ERR_NO_SPACE.

config BB_LIFECYCLE_MAX_REASONS
    int "Max distinct interned pause reasons"
    default 32
    range 1 255
    help
        Fixed-capacity global reason-string intern table shared by every
        service. A brand-new reason string once this table is full fails
        with BB_ERR_NO_SPACE.

config BB_LIFECYCLE_NAME_MAX
    int "Max service name length (bytes, incl. NUL)"
    default 24
    range 1 255
    help
        Service names longer than this are truncated on registration.

config BB_LIFECYCLE_REASON_MAX
    int "Max pause reason string length (bytes, incl. NUL)"
    default 24
    range 1 255
    help
        Pause reason strings longer than this are truncated on intern; two
        reasons sharing the same truncated prefix map to the same bit.

config BB_LIFECYCLE_ASYNC_QUEUE_DEPTH
    int "Async observer queue depth"
    default 8
    range 1 64
    help
        Bounded-MPSC capacity of the shared async dispatch queue. A full
        queue drops the event (bb_bqueue_dropped() counter; rate-limited
        warn log) rather than blocking the emitter.

config BB_LIFECYCLE_ASYNC_TASK_STACK
    int "Async observer drain task stack (bytes)"
    default 3072
    range 2048 8192

config BB_LIFECYCLE_ASYNC_TASK_PRIORITY
    int "Async observer drain task priority"
    default 3
    range 1 20

config BB_LIFECYCLE_ASYNC_TASK_CORE
    int "Async observer drain task core affinity (-1 = no affinity)"
    default -1
    range -1 1

endmenu
```
