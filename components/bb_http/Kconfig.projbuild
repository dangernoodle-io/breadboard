## components/bb_log_event/Kconfig
```kconfig
menu "breadboard: bb_log_event"

config BB_LOG_EVENT_QUEUE_LEN
    int "Log event forwarder queue depth"
    default 48 if SPIRAM
    default 24
    range 8 256
    help
        Number of slots in the off-hot-path forwarder queue between
        bb_log's s_log_vprintf and the bb_log_event forwarder task. Each slot
        holds one log line (~192 B), so 48 slots ~ 9 KB worst-case buffering.
        Lines are dropped (with a counter) when the queue is full; the
        dropped count is visible via bb_log_event_dropped().

        PSRAM-axis DERIVE: default 48 on SPIRAM boards (ample heap); 24 on
        no-PSRAM boards (~4.6 KB, lower than the prior 48-slot default that
        allocated ~9 KB on heap-tight boards). Per-board sdkconfig fragments
        (e.g. esp32-s2-mini at 8) override this derive and take precedence.

endmenu
```

## components/bb_log_http/Kconfig
```kconfig
menu "breadboard: bb_log_http"

config BB_LOG_ROUTES
    bool "Build bb_log HTTP routes (log-level GET/POST)"
    default y
    help
        When enabled, bb_log_http compiles the routes module that exposes
        GET /api/log/level and POST /api/log/level. Disable for headless
        logging-only consumers that compose bb_log_http but don't want the
        routes wired.

        The structured log stream is served separately via bb_data/
        bb_data_http at GET /api/events?topic=log (see bb_log_event's
        "log" bb_data key, B1-1045).

config BB_LOG_SSE_KEEPALIVE_MS
    int "SSE keepalive interval (ms)"
    default 5000
    range 1000 60000
    depends on BB_LOG_ROUTES
    help
        Vestigial — the /api/logs SSE route has been retired. This symbol
        is kept to avoid build breakage on boards that still reference it
        via sdkconfig. It is unused.

endmenu
```

## components/bb_mdns/Kconfig
```kconfig
menu "breadboard: bb_mdns"

config BB_MDNS_INSTANCE_NAME_MAX
    int "Maximum mDNS instance name length (bytes, including NUL)"
    default 32
    range 16 64
    help
        Governs BB_MDNS_INSTANCE_NAME_MAX in bb_mdns.h and sizes the
        instance_name field inside bb_mdns_identity_t (and thus
        bb_mdns_peer_t / bb_mdns_query_result_t).  Fleet instance names
        are typically ≤18 chars (e.g. "TaipanMiner-abc123"); the default
        of 32 provides headroom while saving ~32 B per struct slot vs the
        old 64 B default.  Raise to 64 only if your instance names exceed
        31 printable characters.

config BB_MDNS_HOSTNAME_MAX
    int "Maximum mDNS hostname length (bytes, including NUL)"
    default 32
    range 16 64
    help
        Governs BB_MDNS_HOSTNAME_MAX in bb_mdns.h and sizes the hostname
        field inside bb_mdns_identity_t.  Fleet hostnames are typically
        ≤17 chars (e.g. "tdongles3-1.local"); the default of 32 is
        sufficient.  Raise to 64 only if your hostnames exceed 31 chars.

config BB_MDNS_EVT_POOL_SIZE
    int "Notifier event pool size"
    default 8
    range 4 64
    help
        Pre-allocated bb_mdns_evt_t slots used by the notifier callback to
        hand events to the dispatch task without per-event malloc. IDF's
        mDNS task delivers a linked list of mdns_result_t in one callback,
        so this caps how many peers can be queued in a single notify burst
        before events are dropped (logged as "event pool exhausted").

        Each slot is ~588 bytes; default 8 fits 1-8 peers and saves ~4.7 KB
        BSS vs the old default of 16. Raise to 16+ for large LANs.

config BB_MDNS_BATCH_MAX
    int "mDNS coalescing batch size (input side)"
    default 16
    range 2 64
    help
        Maximum number of peer events buffered in the in-progress coalescing
        batch (s_batch, one static bb_mdns_evt_t[BB_MDNS_BATCH_MAX] array,
        ~516 B per slot, total ~8.2 KB at default of 16) before a synchronous
        flush into the dispatch ring is triggered.

        BB_MDNS_BATCH_MAX also determines the size of the heap-allocated
        dispatch scratch item (bb_mdns_batch_item_t, ~sizeof(bb_mdns_evt_t)
        * BB_MDNS_BATCH_MAX + 4 B) allocated once in bb_mdns_init.  Memory
        cost scales linearly with this value.

        On no-PSRAM boards set this to 4 (not the default 16) to keep the
        scratch item and ring slots within internal heap budget.  The default
        of 16 targets PSRAM-equipped boards where the ring allocator places
        large items in SPIRAM.

        Lowering this on small-heap boards reclaims BSS and heap at the cost
        of more frequent flushes into the ring — any peers that overflow both
        the batch and the ring within a single burst are dropped.

config BB_MDNS_BATCH_RING_DEPTH
    int "mDNS dispatch ring capacity (bb_queue drop-new)"
    default 4 if SPIRAM
    default 3
    range 1 32
    help
        Capacity of the bb_queue used to queue coalesced mDNS batch items for
        the dispatch task.  Each slot holds one bb_mdns_batch_item_t (one full
        flush worth of peers, sizeof ~= BB_MDNS_BATCH_MAX * ~516 B + 4 B).

        Heap cost (SPIRAM-preferred on ESP-IDF, internal heap on no-PSRAM
        boards): capacity × (bb_queue entry metadata (~24 B) +
        sizeof(bb_mdns_batch_item_t)).  At default capacity=4 and
        BB_MDNS_BATCH_MAX=16: 4 × (24 + 4 + 16 * 516) ≈ 33 KB on SPIRAM;
        on no-PSRAM boards the same bytes come from internal heap.

        Memory cost scales with BB_MDNS_BATCH_MAX — lower both together on
        no-PSRAM boards (e.g. BATCH_MAX=4, RING_DEPTH=3).

        The ring uses BB_QUEUE_REJECT_NEW: when full the 50 ms flush timer
        re-arms and retries the SAME batch on the next tick (the batch is
        not cleared on a failed push).  Raise if your network produces more
        than BB_MDNS_BATCH_RING_DEPTH burst-separated discovery/PTR-scan cycles before
        the dispatch task can drain.

        PSRAM-axis DERIVE (B1-435): default 4 on SPIRAM boards (ring lives
        in SPIRAM; large batches affordable), 3 on no-PSRAM boards (internal
        heap is the bottleneck; aligns with TaipanMiner sdkconfig/no-psram).
        BB_MDNS_BATCH_MAX is left at its flat default of 16 because it is
        set for DIFFERENT reasons by both single-core and no-PSRAM fragments
        in TaipanMiner — deriving it on the SPIRAM axis alone would miss the
        single-core constraint.  RING_DEPTH is purely PSRAM-axis and safe to
        derive here.

config BB_MDNS_TXT_PENDING_MAX
    int "Maximum pending TXT key/value pairs before mDNS starts"
    default 4
    range 1 16
    help
        bb_mdns_set_txt() may be called before the mDNS service has started.
        Pending writes are held in a static table of this size and flushed
        when the service starts. Default 4 covers typical usage (update,
        board, fw, custom key). Raise if more TXT keys are set pre-start.

config BB_MDNS_TASK_PRIORITY
    int "bb_mdns dispatch/query task priority"
    default 3
    range 1 24
    help
        FreeRTOS priority for the bb_mdns dispatch and query tasks. The
        dispatch task drains coalesced browse-notify events and frees the
        single coalescing batch slot; if it is starved the slot is not freed
        in time and bursts of peer events are dropped (logged as
        "notifier: queue+batch full").

        On dual-core boards the default of 3 is ample — the task runs on the
        core the miner is not pinned to. On single-core boards (ESP32-C3/S2)
        the dispatch task competes with the miner on the one core; raise this
        (e.g. 10, still well below a typical priority-20 mining task) so it
        drains promptly and browse-based discovery (e.g. knot) does not lag.
        Keep it below the consumer's mining/hot-loop task priority.

endmenu
```

## components/bb_mdns_cache/Kconfig
```kconfig
menu "breadboard: bb_mdns_cache"

config BB_MDNS_CACHE_REQUERY_PERIOD_S
    int "Re-query worker period (seconds)"
    default 30
    range 1 3600
    help
        How often the dedicated re-query worker task issues mdns_query_ptr
        to refresh presence entries beyond bb_mdns's hello/bye browse
        notifications. Overridable per-call via
        bb_mdns_cache_config_t.requery_period_ms (0 = use this default).

config BB_MDNS_CACHE_QUERY_TIMEOUT_MS
    int "mdns_query_ptr timeout (ms)"
    default 3000
    range 100 60000
    help
        Per-tick timeout passed to mdns_query_ptr on the dedicated re-query
        worker task. Not overridable per-call.

config BB_MDNS_CACHE_MAX_RESULTS
    int "mdns_query_ptr max results"
    default 16
    range 1 64
    help
        Max results requested per mdns_query_ptr call on the re-query
        worker tick. Not overridable per-call.

config BB_MDNS_CACHE_STALE_AGE_MS
    int "Default stale-age threshold (ms, 0 = no stale window)"
    default 0
    range 0 3600000
    help
        Default bb_cache AGE_OUT stale_age_ms for registered presence
        entries. Overridable per-call via
        bb_mdns_cache_config_t.stale_age_ms (0 = use this default).

config BB_MDNS_CACHE_EVICT_AGE_MS
    int "Default evict-age threshold (ms)"
    default 90000
    range 1000 3600000
    help
        Default bb_cache AGE_OUT evict_age_ms for registered presence
        entries -- an entry unread/unwritten past this age is evicted.
        Overridable per-call via bb_mdns_cache_config_t.evict_age_ms
        (0 = use this default). Must exceed BB_MDNS_CACHE_STALE_AGE_MS.

config BB_MDNS_CACHE_WORKER_STACK
    int "Re-query worker task stack (bytes)"
    default 4096
    range 2048 16384
    help
        Stack size for the dedicated re-query worker task (bb_timer worker
        mode -- mdns_query_ptr can block).

config BB_MDNS_CACHE_WORKER_PRIORITY
    int "Re-query worker task priority"
    default 3
    range 1 24
    help
        FreeRTOS priority for the dedicated re-query worker task.

config BB_MDNS_CACHE_ENTRY_MAX
    int "Max per-entry scratch buffer size (bytes)"
    default 192
    range 32 1024
    help
        Compile-time cap on the local stack scratch buffer used to build a
        cache entry before upsert. bb_mdns_cache_start() rejects
        (BB_ERR_INVALID_ARG) any effective entry_size (cfg->entry_size, or
        sizeof(bb_mdns_cache_entry_t) when 0) exceeding this cap -- fails
        loud rather than risking a silent stack overflow.

config BB_MDNS_CACHE_AUTOREGISTER
    bool "Auto-start bb_mdns_cache on init (PRE_HTTP tier)"
    default n
    help
        When enabled, bb_mdns_cache_init() self-starts at its PRE_HTTP
        init tier (wired in by codegen or handwire) using
        BB_MDNS_CACHE_AUTO_SERVICE / BB_MDNS_CACHE_AUTO_PROTO as the
        compiled-in default service/proto. Disable (default) to call
        bb_mdns_cache_start() manually with a consumer-chosen
        service/proto.

config BB_MDNS_CACHE_AUTO_SERVICE
    string "Auto-registered mDNS service (e.g. _miner)"
    default "_miner"
    depends on BB_MDNS_CACHE_AUTOREGISTER
    help
        Service label passed to bb_mdns_cache_start() when
        BB_MDNS_CACHE_AUTOREGISTER is enabled.

config BB_MDNS_CACHE_AUTO_PROTO
    string "Auto-registered mDNS proto (e.g. _tcp)"
    default "_tcp"
    depends on BB_MDNS_CACHE_AUTOREGISTER
    help
        Proto label passed to bb_mdns_cache_start() when
        BB_MDNS_CACHE_AUTOREGISTER is enabled.

endmenu
```

## components/bb_mem_arena_tls/Kconfig
```kconfig
menu "breadboard: bb_mem_arena_tls"

config BB_MEM_ARENA_TLS_BYTES
    int "mbedTLS arena size (bytes; 0 = disabled, use heap fallback only)"
    range 0 65536
    default 0
    help
        Size in bytes of the static boot-reserved contiguous arena for mbedTLS
        allocations. When > 0 and CONFIG_MBEDTLS_CUSTOM_MEM_ALLOC=y, a
        static uint8_t buffer of this size backs a bb_mem_arena instance
        (components/bb_mem_arena) at boot. mbedTLS allocations are tried
        arena-first; if the arena is exhausted, the allocator falls back to
        the internal-heap facade (bb_calloc_internal() / bb_mem_free()).

        IMPORTANT: bb_mem_arena is a bump allocator — bb_mem_arena_free() does NOT
        reclaim space mid-handshake; freed bytes stay consumed until the
        arena is reset. bb_mem_arena_tls resets the arena automatically once
        every outstanding arena allocation has been freed (the arena fully
        drains between handshakes), so one arena is reused across many
        sequential handshakes over device uptime. Size this value for the
        CUMULATIVE allocation of ONE handshake (every allocation mbedTLS
        makes during that handshake, summed) — not just the peak
        concurrently-live bytes — because the bump pointer only rewinds on
        full drain, not on each individual free. If any allocation from a
        handshake is never freed, or the arena is exhausted mid-handshake,
        the outstanding count never reaches zero, the arena never resets,
        and subsequent allocations fall back to the internal heap until it
        does — a safe degradation, not a crash.

        0 (default) = no arena buffer; all mbedTLS allocations go directly to
        bb_calloc_internal() / bb_mem_free() (the ESP-IDF internal 8-bit pool).

        CONCURRENCY: the calloc/free hooks are the process-wide mbedTLS
        allocator and are guarded by a single mutex, so they are safe to call
        from multiple concurrent TLS handshakes (e.g. telemetry sink +
        OTA/update-check, WPA-supplicant). Concurrent callers are serialized,
        not parallelized — there is one shared arena, not one per caller.
        Size this value for the CUMULATIVE allocation across every handshake
        that may be concurrently in flight, not just a single handshake, and
        remember the arena reclaims (resets) only once ALL outstanding
        allocations across ALL callers have fully drained — a slow or stuck
        concurrent caller holding even one allocation blocks reclaim for
        everyone.

        Requires CONFIG_MBEDTLS_CUSTOM_MEM_ALLOC=y to have any effect.
        For no-PSRAM wroom32/c3/tdongle boards: set to 14336 (14 KB) to cover
        the manifest check TLS handshake's cumulative allocation (IN buffer +
        ssl_context + handshake).

endmenu
```

## components/bb_meminfo/Kconfig
```kconfig
menu "breadboard: bb_meminfo"

config BB_MEMREPORT_MAX_REGIONS
    int "bb_memreport arena region-registry capacity"
    default 8
    range 1 64
    help
        Maximum number of bb_mem_arena_t regions bb_memreport_get() can
        aggregate (bb_memreport_register_arena capacity). Must not exceed
        BB_REGISTRY_SNAPSHOT_MAX (64).

config BB_MEMINFO_HEAP_LOW_BYTES
    int "Free-heap LOW threshold (bytes)"
    default 40000
    range 1000 1000000
    help
        Total free heap bytes below which the heap state transitions to LOW.
        Applies to bb_meminfo_classify_heap()'s input (PSRAM + internal on
        boards with PSRAM; internal-only on boards without). Tune down on
        boards with PSRAM where total free can be hundreds of KB. Relocated
        from bb_board (B1-977 dissolution); a saved sdkconfig override of the
        old BB_BOARD_HEAP_LOW_BYTES name silently reverts to this default.

config BB_MEMINFO_HEAP_CRITICAL_BYTES
    int "Free-heap CRITICAL threshold (bytes)"
    default 20000
    range 1000 1000000
    help
        Total free heap bytes below which the heap state transitions to
        CRITICAL. Must be less than BB_MEMINFO_HEAP_LOW_BYTES. Relocated
        from bb_board (B1-977 dissolution); a saved sdkconfig override of the
        old BB_BOARD_HEAP_CRITICAL_BYTES name silently reverts to this
        default.

endmenu
```
