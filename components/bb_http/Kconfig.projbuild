## components/bb_ota_pull/Kconfig
```kconfig
menu "breadboard: bb_ota_pull"

config BB_OTA_PULL_AUTOREGISTER
    bool "Auto-register OTA pull HTTP routes via bb_init"
    default y if BB_OTA_STRATEGY_PULL
    default n
    help
        When enabled, bb_ota_pull self-registers its HTTP route handlers
        (POST /api/update/apply, /check, GET /api/update/progress) through
        bb_init. Defaults on when the OTA strategy is in-place pull (see
        BB_OTA_STRATEGY) so /api/update/apply has a single owner. Disable this
        if you want to keep bb_ota_pull's public C API but drive route
        registration manually or skip routes entirely (e.g. headless
        OTA-driver use).

config BB_OTA_PULL_WDT_EXTENDED_S
    int "Task WDT timeout (s) during OTA flash phase"
    range 30 1800
    default 300
    help
        While bb_ota_pull is downloading + writing firmware, esp_flash_write
        calls cache_disable for tens of ms at a time, and consumer pause
        callbacks may hold the mining task in a semaphore wait for the full
        download. WDT-subscribed tasks (typically IDLE0 and consumer mining
        tasks) cannot reset the WDT during these windows; if the cumulative
        unfed window exceeds CONFIG_ESP_TASK_WDT_TIMEOUT_S the WDT trips.

        bb_ota_pull temporarily reconfigures the WDT timeout to this value
        for the duration of the OTA work, then restores the Kconfig default
        on exit. 300 s covers a full firmware download over weak WiFi.

config BB_OTA_PULL_HTTP_TIMEOUT_MS
    int "Per-recv HTTP timeout (ms) for OTA download"
    range 1000 120000
    default 20000
    help
        Per-recv HTTP timeout (ms) for the OTA download; the runtime setter
        bb_ota_pull_set_http_timeout_ms() overrides it.

config BB_OTA_PULL_DL_MAX_ATTEMPTS
    int "Max OTA download attempts"
    range 1 10
    default 3
    help
        Max download attempts (outer retry loop + inner handshake retry).

config BB_OTA_PULL_WIFI_SETTLE_MS
    int "Max wait for WiFi/DNS to settle before first OTA attempt (ms)"
    range 0 30000
    default 8000
    help
        On single-core-lwIP boards (e.g. ESP32-C3) the TCP/DNS layer may not be
        fully settled even after GOT_IP, so an OTA fired seconds after boot can
        exhaust all download attempts before the stack is ready. bb_ota_pull
        polls bb_wifi_has_ip() in 500 ms steps up to this total before starting
        the download; on a healthy board the first poll passes and there is no
        delay. Set to 0 to disable the settle wait (fail fast if no IP).

config BB_OTA_PULL_DL_BACKOFF_BASE_MS
    int "Base retry backoff (ms)"
    range 0 60000
    default 3000
    help
        Base retry backoff (ms); doubles each attempt up to the cap.

config BB_OTA_PULL_DL_BACKOFF_MAX_MS
    int "Cap for exponential retry backoff (ms)"
    range 0 120000
    default 20000
    help
        Cap for the exponential retry backoff (ms).

config BB_OTA_PULL_STALL_WARN_S
    int "Stall warning threshold (seconds)"
    range 1 600
    default 10
    help
        Warn if no download bytes move for this many seconds.

config BB_OTA_PULL_HTTP_CHUNK_SIZE
    int "OTA download HTTP Range chunk size (bytes)"
    range 1024 16384
    default 4096
    help
        esp_https_ota partial_http_download chunk size (bytes per Range GET).
        Drives the inbound TLS record size, hence the per-record mbedTLS
        buffer allocation.

        Default 4096: each TLS record is ~4.4 KB. On a no-PSRAM board with
        DYNAMIC_BUFFER (per-record realloc), that allocation fails mid-download
        once concurrent httpd/SSE load fragments the internal heap below ~4.4 KB
        contiguous — observed largest_free_block collapsing to ~4.6 KB at ~80%.

        Lower to 2048 on no-PSRAM boards that do an in-place pull (esp32-wroom32,
        esp32-wroom32-cyd, esp32-c3): the per-record alloc drops to ~2.2 KB,
        fitting a far more fragmented heap, at the cost of ~2x more Range GETs.
        Leave at 4096 on PSRAM boards (bitaxe-*), which do not fragment, and on
        boot-mode boards (esp32-s2), which pull at full early-boot heap — both
        benefit from fewer round-trips. Must stay <= MBEDTLS_SSL_IN_CONTENT_LEN.

config BB_OTA_PULL_TASK_STACK
    int "OTA worker task stack size (bytes)"
    range 8192 65536
    default 12288
    help
        Stack size in bytes for the xTaskCreatePinnedToCore OTA worker task.
        The task runs esp_https_ota (mbedTLS + esp_http_client) which needs at
        least ~8 KB; 12 KB provides headroom for deeper call stacks on boards
        with long pause-hook chains.

config BB_OTA_PULL_APPLY_CACHE_FRESH_S
    int "POST /api/update/apply: cached check freshness window (seconds, 0=always refresh)"
    range 0 86400
    default 300
    help
        When POST /api/update/apply is called, bb_ota_pull trusts the
        bb_update_check cached result if it is younger than this many seconds
        (cache-first). If the cache is stale or empty, bb_ota_pull kicks the
        update-check worker and waits up to ~15 s for a fresh result before
        deciding.

        Default 300 s (5 minutes): a fleet apply right after a release or
        right after a reboot refreshes automatically instead of silently
        no-oping on a stale RAM cache. Setting to 0 forces a refresh on every
        apply call regardless of cache age.

endmenu
```
