## components/bb_mqtt/Kconfig
```kconfig
menu "breadboard: bb_mqtt"

config BB_MQTT_AUTOREGISTER
    bool "Auto-register MQTT client init via bb_init (EARLY tier)"
    default y
    help
        When enabled, bb_mqtt self-registers at the EARLY tier. On init it reads
        NVS namespace "bb_mqtt" for uri/client_id/username/password/enabled and,
        when enabled=1, connects to the broker. Disable to call bb_mqtt_init
        manually.

config BB_MQTT_KEEPALIVE
    int "MQTT keepalive interval in seconds"
    default 120
    range 10 3600
    help
        MQTT keepalive sent to the broker. If the broker closes the connection
        after this many seconds of inactivity, esp-mqtt will reconnect
        automatically (unless disable_auto_reconnect is set).
        Note: CONFIG_MQTT_TASK_STACK_SIZE may need to be raised to 6144 or
        higher when TLS is enabled (mbedTLS handshake requires ~5-8 KB stack).

config BB_MQTT_NETWORK_TIMEOUT_MS
    int "MQTT network timeout (ms)"
    default 30000
    range 1000 120000
    help
        Maps to esp_mqtt_client_config_t.network.timeout_ms. esp-mqtt
        defaults to 10000, which aborts writes ("write didn't complete in
        specified timeout") on a marginal link and forces a reconnect.
        30s tolerates a slow/weak link without churning.

config BB_MQTT_RX_BUFFER_BYTES
    int "MQTT receive buffer size (bytes)"
    default 256
    range 64 4096
    help
        Receive buffer for the bb_mqtt client (maps to
        esp_mqtt_client_config_t.buffer.size), overriding the global
        CONFIG_MQTT_BUFFER_SIZE. Default 256 suits publish-only/non-subscribing
        clients (the telemetry auto-client never subscribes — RX only sees ≤10B
        protocol frames); raise it if your client SUBSCRIBES to topics with
        larger payloads.

config BB_MQTT_TX_BUFFER_BYTES
    int "MQTT transmit buffer size (bytes)"
    default 1024
    range 128 4096
    help
        Transmit buffer (maps to esp_mqtt_client_config_t.buffer.out_size);
        1024 fits typical JSON telemetry.

config BB_MQTT_SUSPEND_STOP_ONLY
    bool "Suspend uses stop-only (keeps client resident, no destroy/recreate)"
    default n
    help
        When y, bb_mqtt_suspend_default() calls esp_mqtt_client_stop() only
        (keeps client handle, buffers, and task resident, ~11 KB) and
        bb_mqtt_resume_default() calls esp_mqtt_client_start() only — no
        destroy, no realloc, no NVS reload.

        ONLY safe when bb_heap_arena covers the TLS handshake that follows
        the suspend window.  The ~11 KB residency means the largest_free_block
        improvement is smaller than the full destroy path; use this mode only
        when the arena already reserves enough headroom.

        Default n = full destroy+recreate (original behavior): suspend calls
        bb_mqtt_stop() which destroys the client and frees all buffers; resume
        calls auto_client_create_from_nvs() to recreate.

endmenu
```

## components/bb_mqtt_routes/Kconfig
```kconfig
menu "breadboard: bb_mqtt_routes"

config BB_MQTT_ROUTES_AUTOREGISTER
    bool "Auto-register /api/mqtt HTTP routes via bb_registry"
    default y
    help
        When enabled, bb_mqtt_routes self-registers GET and PATCH /api/mqtt
        through bb_registry at order 5. Disable to call bb_mqtt_routes_init
        manually, or omit the call entirely if your app defines its own
        /api/mqtt handler.

endmenu
```

## components/bb_net_health/Kconfig
```kconfig
menu "breadboard: bb_net_health"

config BB_NET_HEALTH_SSE_AUTO_ATTACH
    bool "Auto-attach 'net.health' retained SSE topic to /api/events"
    default y
    help
        When enabled (default), bb_net_health_attach_sse() attaches the
        retained "net.health" bb_event topic to /api/events, publishes an
        initial snapshot, and starts the periodic evaluator that re-publishes
        on state or early_warning change. Default y preserves the existing
        behavior for callers of bb_net_health_attach_sse() (B1-546); disable
        to make the call a no-op (e.g. when a board wants /api/health only,
        without the SSE topic).

config BB_NET_HEALTH_RSSI_GOOD
    int "RSSI threshold for GOOD bucket (dBm)"
    default -67
    range -100 0
    help
        RSSI >= this value is classified as GOOD.

config BB_NET_HEALTH_RSSI_MARGINAL_LO
    int "Lower RSSI threshold for MARGINAL bucket (dBm)"
    default -75
    range -100 0
    help
        RSSI in the range [BB_NET_HEALTH_RSSI_MARGINAL_LO ..
        BB_NET_HEALTH_RSSI_GOOD-1] is classified as MARGINAL.
        RSSI below this value is classified as POOR.

config BB_NET_HEALTH_HYST_DOWN
    int "Hysteresis sample count before downgrading state"
    default 3
    range 1 10
    help
        Number of consecutive worse-bucket RSSI samples required before
        the published state is downgraded. Prevents single-sample flaps.

config BB_NET_HEALTH_HYST_UP
    int "Hysteresis sample count before upgrading state"
    default 3
    range 1 10
    help
        Number of consecutive better-bucket RSSI samples required before
        the published state is upgraded.

config BB_NET_HEALTH_EVAL_PERIOD_S
    int "Net-health evaluator period (seconds)"
    range 1 3600
    default 5
    help
        How often the net-health evaluator fires to sample RSSI and MQTT
        state and potentially publish a new "net.health" SSE snapshot.
        Default 5 s. Increasing this reduces CPU/WiFi polling; decreasing
        makes health transitions more responsive.

config BB_NET_HEALTH_HEAP_LOW_BYTES
    int "Free-heap LOW threshold (bytes)"
    default 40000
    range 1000 1000000
    help
        Total free heap bytes below which the heap state transitions to LOW.
        Applies to bb_board_heap_free_total() (PSRAM + internal on boards with
        PSRAM; internal-only on boards without). Tune down on boards with PSRAM
        where total free can be hundreds of KB.

config BB_NET_HEALTH_HEAP_CRITICAL_BYTES
    int "Free-heap CRITICAL threshold (bytes)"
    default 20000
    range 1000 1000000
    help
        Total free heap bytes below which the heap state transitions to CRITICAL.
        Must be less than BB_NET_HEALTH_HEAP_LOW_BYTES.

config BB_NET_HEALTH_HEAP_TRACE
    bool "Emit HEAPTRACE log line each eval cycle"
    default n
    help
        When enabled, eval_work_fn emits one bb_log_i(TAG, "HEAPTRACE ...") line
        every BB_NET_HEALTH_EVAL_PERIOD_S seconds with: uptime, global free/min/
        largest block, heap state bucket, and bb_mem accounting counters.
        Requires BB_MEM_STATS_ENABLE to populate the m_* fields; they will be
        zero otherwise (stats still disabled independently).
        Default OFF — zero runtime cost when disabled.

config BB_NET_HEALTH_EGRESS_ACT_ENABLE
    bool "Enable egress-recovery ACT gate (tier-2 request_recovery + tier-3 reboot)"
    default n
    help
        When enabled, the evaluator ACTS on the egress-recovery SSOT
        classification instead of only logging it (B1-518 PR4):
          - tier-2: bb_wifi_request_recovery() is called on the edge
            transition into BB_EGRESS_STATE_GW_UNREACHABLE.
          - tier-3: if the gateway stays unreachable for
            BB_NET_HEALTH_EGRESS_ACT_REBOOT_S seconds, esp_restart() is
            called, rate-limited by BB_NET_HEALTH_EGRESS_ACT_REBOOT_MIN_INTERVAL_S
            and BB_NET_HEALTH_EGRESS_ACT_REBOOT_DAILY_CAP, persisted across
            reboots in NVS as real epoch seconds (time(NULL), never a
            boot-relative uptime — the rate limits must survive a reboot).
            Tier-3 is gated on bb_ntp_is_synced(): while the clock has never
            synced, tier-3 is log-only (no reboot, no NVS write) — tier-2
            is unaffected by this gate.
        Also retires the wifi_reconn safeguard-reboot escalation (the actual
        esp_restart() call) when enabled — see wifi_reconn.c.
        Default OFF — zero behavioral change; the whole act path compiles
        out. Gate: #if CONFIG_BB_NET_HEALTH_EGRESS_ACT_ENABLE.

config BB_NET_HEALTH_EGRESS_ACT_REBOOT_S
    int "Seconds of sustained GW_UNREACHABLE before tier-3 reboot"
    default 480
    range 60 3600
    depends on BB_NET_HEALTH_EGRESS_ACT_ENABLE
    help
        How long the gateway must stay unreachable (continuously) before
        the evaluator escalates to esp_restart().

config BB_NET_HEALTH_EGRESS_ACT_REBOOT_MIN_INTERVAL_S
    int "Minimum seconds between tier-3 reboots"
    default 1800
    range 300 86400
    depends on BB_NET_HEALTH_EGRESS_ACT_ENABLE
    help
        Rate-limit: at most one tier-3 reboot per this many seconds,
        persisted across reboots in NVS.

config BB_NET_HEALTH_EGRESS_ACT_REBOOT_DAILY_CAP
    int "Maximum tier-3 reboots per rolling 24h"
    default 4
    range 1 10
    depends on BB_NET_HEALTH_EGRESS_ACT_ENABLE
    help
        Hard cap on tier-3 reboots within a rolling 24h window, persisted
        across reboots in NVS (ring buffer of reboot timestamps).

config BB_NET_HEALTH_LOG_INTERVAL_S
    int "Diagnostic heartbeat log interval (seconds)"
    default 60
    range 5 3600
    help
        Minimum interval between periodic heartbeat log lines when net_mode
        is unchanged (e.g. "still no_ip after 5min"). A net_mode transition
        always logs immediately regardless of this interval. The heartbeat
        itself is always compiled in (a few hundred bytes flash, zero heap)
        and controlled at runtime via the dedicated "net_state" log tag's
        level (default INFO = visible; lower the tag's level to suppress —
        no reflash required).

endmenu
```

## components/bb_nv/Kconfig
```kconfig
menu "breadboard: bb_nv"

config BB_NV_CREDS_RTC_BACKUP
    bool "Back up wifi creds to RTC slow memory (survive NVS erase-on-corruption)"
    default y
    help
      Mirrors wifi ssid/pass/provisioned (~108 bytes) into RTC_NOINIT memory so a
      crash-induced NVS erase doesn't strand a headless board. Survives software
      reset/panic; lost on full power-off. See B1-242.

endmenu
```

## components/bb_ota_boot/Kconfig
```kconfig
menu "breadboard: bb_ota_boot"

config BB_OTA_BOOT_PROGRESS_HTTP
    bool "Serve /api/update/progress + advertise mDNS during boot-mode OTA"
    default n
    help
      When set, bb_ota_boot stands up a one-route HTTP server (GET
      /api/update/progress) and advertises (responder-only, no browse) mDNS
      during the boot-mode OTA download, so a remote dashboard sees live
      progress and the device stays discoverable. Costs ~12 KB heap during
      the download (httpd task + mDNS responder). Leave off for heap-tight or
      headless consumers — the existing progress callback is unaffected.

      The transient GET /api/update/progress endpoint is ONLY available during
      the boot-mode OTA download window — it is not part of the normal-operation
      OpenAPI spec (boot-mode boards do not compile bb_ota_pull, so /progress
      is absent in normal mode). The response schema is identical to bb_ota_pull's
      /api/update/progress: {state:string, in_progress:bool, progress_pct:integer}.

config BB_OTA_BOOT_STATUS_HTTP
    bool "Serve GET /api/update/status + POST /api/update/check for boot-mode boards"
    default n
    help
      When set, bb_ota_boot registers two runtime routes on the main httpd
      (the normal registry path, not the transient boot-progress server):

        GET  /api/update/status  — returns cached bb_ota_check status JSON
                                   (same shape as the persistent worker route).
        POST /api/update/check   — on-demand one-shot manifest check. Guards
                                   against low heap: if the largest contiguous
                                   internal block is below the TLS threshold
                                   (auto-derived from
                                   CONFIG_MBEDTLS_SSL_IN_CONTENT_LEN + ~1 KB,
                                   or overridden by
                                   CONFIG_BB_TLS_HEAP_CONTIGUOUS_FLOOR) it
                                   returns 503 {"error":"insufficient_heap"}
                                   and leaves the cached result intact.
                                   Otherwise spawns a transient fat-stack task
                                   that calls bb_ota_check_now() then exits;
                                   responds 202 {"status":"checking"}
                                   immediately. Client polls
                                   GET /api/update/status for results.

      Intended for boot-strategy boards (e.g. ESP32-S2) that skip the
      persistent bb_ota_check worker (CONFIG_BB_OTA_CHECK_AUTOREGISTER
      defaults off for BB_OTA_STRATEGY_BOOT) but still need a runtime status
      endpoint for the web UI and taipan-cli. bb_ota_check is initialised
      once at startup using the releases_url/board values passed to
      bb_ota_boot_run_if_pending; if that function has not been called yet the
      routes respond with 503.

      No persistent worker task is created — the only TLS activity is on-demand
      via POST /api/update/check, and only when heap permits.

config BB_OTA_CHECK_ON_APPLY_FALLBACK
    bool "Return check_on_apply directive instead of insufficient_heap"
    depends on BB_OTA_BOOT_STATUS_HTTP
    default n
    help
      When POST /api/update/check cannot allocate the contiguous heap the TLS
      manifest fetch needs, return 200 {"status":"check_on_apply"} (and mark
      GET /api/update/status outcome=check_on_apply, available=false) instead
      of 503 {"error":"insufficient_heap"}. Signals API consumers to skip the
      runtime check and POST /api/update/apply directly — boot-mode performs
      the manifest check at full early-boot heap. Opt-in; off preserves the
      insufficient_heap error.

endmenu
```
