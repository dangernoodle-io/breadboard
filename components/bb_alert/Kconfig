## components/bb_alert/Kconfig
```kconfig
menu "breadboard: bb_alert"

config BB_ALERT_ENABLE
    bool "Enable bb_alert one-shot alert event channel"
    default n
    help
        When disabled, bb_alert_emit() compiles to a safe no-op and the
        alert topic is not registered or attached. Callers can invoke
        bb_alert_emit() unconditionally at zero cost.

        When enabled, discrete alert events are surfaced on /api/events
        under the "alert" topic (non-retained). Each event carries a JSON
        envelope: {type, severity, uptime_ms, ...fill fields}.

config BB_ALERT_MIN_SEVERITY
    int "Minimum alert severity to emit (0=INFO, 1=WARNING, 2=CRITICAL)"
    default 0
    range 0 2
    depends on BB_ALERT_ENABLE
    help
        Alerts with severity below this threshold are silently dropped.
        0 = emit all (INFO and above). 1 = WARNING and above. 2 = CRITICAL only.

        The C default and this Kconfig default both equal 0 so the bridge
        is never silently inert.

endmenu
```

## components/bb_board/Kconfig
```kconfig
menu "breadboard: bb_board"

config BB_BOARD_AUTOREGISTER
    bool "Auto-register /api/board HTTP route via bb_init"
    default y
    help
        When enabled, bb_board self-registers GET /api/board (chip model,
        cores, flash size, heap, OTA state) through bb_init. Disable
        to skip the route while keeping any other bb_board API exposed.

config BB_BOARD_HEAP_LOW_BYTES
    int "Free-heap LOW threshold (bytes)"
    default 40000
    range 1000 1000000
    help
        Total free heap bytes below which the heap state transitions to LOW.
        Applies to bb_board_heap_free_total() (PSRAM + internal on boards with
        PSRAM; internal-only on boards without). Tune down on boards with PSRAM
        where total free can be hundreds of KB. Moved from bb_net_health
        (net_health teardown PR-C); a saved sdkconfig override of the old
        BB_NET_HEALTH_HEAP_LOW_BYTES name silently reverts to this default.

config BB_BOARD_HEAP_CRITICAL_BYTES
    int "Free-heap CRITICAL threshold (bytes)"
    default 20000
    range 1000 1000000
    help
        Total free heap bytes below which the heap state transitions to
        CRITICAL. Must be less than BB_BOARD_HEAP_LOW_BYTES. Moved from
        bb_net_health (net_health teardown PR-C); a saved sdkconfig override
        of the old BB_NET_HEALTH_HEAP_CRITICAL_BYTES name silently reverts to
        this default.

config BB_BOARD_HEAP_TRACE
    bool "Emit a HEAPTRACE log line each periodic heap-eval cycle"
    default n
    help
        When enabled, a periodic evaluator emits one
        bb_log_i(TAG, "HEAPTRACE ...") line with: uptime, global free/min/
        largest block, heap state bucket, and bb_mem accounting counters.
        Requires BB_MEM_STATS_ENABLE to populate the m_* fields; they will
        be zero otherwise (stats still disabled independently). Default
        OFF — zero runtime cost when disabled. Moved from bb_net_health
        (net_health teardown PR-C); a saved sdkconfig override of the old
        BB_NET_HEALTH_HEAP_TRACE name silently reverts to this default.
        NOTE (B1-969): bb_net_health (the evaluator that drove this knob)
        has been dissolved -- no periodic caller currently exists, so this
        knob is presently inert until a replacement periodic heap-eval call
        site lands (B1-1011).

endmenu
```

## components/bb_bqueue/Kconfig
```kconfig
menu "breadboard: bb_bqueue"

config BB_BQUEUE_MAX_INSTANCES
    int "Maximum concurrent bb_bqueue instances"
    default 2
    help
        Size of the static instance pool bb_bqueue_create() allocates from.
        TaipanMiner needs exactly two: a work queue and a result queue.
        Zero heap: every instance lives in this fixed-size pool.
        bb_bqueue_create() returns BB_ERR_NO_SPACE once it is exhausted.

        SRAM cost: every instance in the pool reserves
        BB_BQUEUE_MAX_CAPACITY * BB_BQUEUE_MAX_ITEM_BYTES bytes of static
        item storage regardless of that instance's actual cfg (see those
        options' help text) -- raising this value multiplies that
        per-instance cost by the new instance count, even for callers that
        only ever create one small queue.

config BB_BQUEUE_MAX_CAPACITY
    int "Maximum queue capacity (items) per instance"
    default 16
    help
        Upper bound on cfg->capacity accepted by bb_bqueue_create(); sizes
        the static per-instance item storage array. bb_bqueue_create()
        returns BB_ERR_INVALID_ARG if cfg->capacity exceeds this.

        SRAM cost: worst-case static footprint across the whole pool is
        BB_BQUEUE_MAX_INSTANCES * BB_BQUEUE_MAX_CAPACITY *
        BB_BQUEUE_MAX_ITEM_BYTES bytes (default: 2 * 16 * 64 = 2048 bytes),
        reserved regardless of any single instance's actual cfg. Raising
        this to satisfy one caller's large queue costs that extra SRAM for
        EVERY pooled instance, not just that caller's.

config BB_BQUEUE_MAX_ITEM_BYTES
    int "Maximum item size (bytes) per instance"
    default 64
    help
        Upper bound on cfg->item_bytes accepted by bb_bqueue_create(); sizes
        the static per-instance item storage array. bb_bqueue_create()
        returns BB_ERR_INVALID_ARG if cfg->item_bytes exceeds this.

        SRAM cost: worst-case static footprint across the whole pool is
        BB_BQUEUE_MAX_INSTANCES * BB_BQUEUE_MAX_CAPACITY *
        BB_BQUEUE_MAX_ITEM_BYTES bytes (default: 2 * 16 * 64 = 2048 bytes),
        reserved regardless of any single instance's actual cfg. Raising
        this to satisfy one caller's large item type costs that extra SRAM
        for EVERY pooled instance, not just that caller's.

endmenu
```

## components/bb_cache/Kconfig
```kconfig
menu "bb_cache"

config BB_CACHE_MAX_TOPICS
    int "Maximum number of registered cache topics"
    default 32
    range 1 64
    help
        Fixed-size registry capacity. Each entry holds a fixed-size key
        buffer, optional owned struct buffer, serializer fn, and a mutex.
        Increase if more than 8 state topics need caching.

config BB_CACHE_KEY_MAX
    int "Maximum length of a registered cache key (bytes, incl. NUL)"
    default 96
    range 8 256
    help
        Fixed-size per-entry key buffer. bb_cache_register() copies the
        caller's key into this buffer (the caller no longer needs to keep
        the string alive) and rejects keys of length >= this value with
        BB_ERR_INVALID_ARG. The default (96) historically matched the
        deleted bb_sub component's ingress topic cap, sized for
        dynamically-routed MQTT topics; static breadboard keys (e.g.
        "update.available") are far shorter. Standing cost is
        BB_CACHE_KEY_MAX * BB_CACHE_MAX_TOPICS bytes.

config BB_CACHE_SWEEP_ENABLE
    bool "Enable periodic age-out eviction sweep backstop"
    default n
    help
        When enabled, a periodic background sweep (bb_cache_foreach) evicts
        BB_CACHE_EVICT_AGE_OUT keys past their evict_age_ms even if nothing
        reads them -- LAZY (read-time) eviction only fires on an actual
        read. The sweep starts via a pre_http registry hook (bbtool:init
        marker in bb_cache.h); no application code changes are needed.
        Disabled by default: LAZY
        eviction alone is sufficient for read-driven keys; enable this for
        keys that may go unread for long stretches (e.g. a disconnected
        ingress source) and still need their memory reclaimed.

config BB_CACHE_SWEEP_PERIOD_MS
    int "Age-out sweep period (ms)"
    default 30000
    range 1000 3600000
    depends on BB_CACHE_SWEEP_ENABLE
    help
        Interval between sweep passes. Should be well under the shortest
        registered evict_age_ms among AGE_OUT keys, or eviction lags behind
        the configured window.

config BB_CACHE_SWEEP_WORKER_STACK
    int "bb_cache eviction sweep worker task stack (bytes)"
    default 8192
    range 4096 16384
    depends on BB_CACHE_SWEEP_ENABLE
    help
        FreeRTOS task stack for the sweep's dedicated bb_timer_worker task.
        Each sweep pass's call chain is sweep_cb -> evict_if_aged_out_locked
        -> bb_cache_delete_if_generation -> the evict-notify hook -> (when
        a composer has installed one, e.g. bb_mdns_cache) an ARBITRARY
        consumer-supplied on_remove callback -- the depth of that last hop
        is not something bb_cache controls or can bound. 8192 matches
        the house precedent for a TLS-tier background worker stack (a
        callback chain of unknown depth) rather than the ESP-IDF
        pthread default (~3072 bytes) the sweep used before this
        firmware-review fix, which was unsafe once the sweep became live.

config BB_CACHE_SWEEP_WORKER_PRIORITY
    int "bb_cache eviction sweep worker task priority"
    default 1
    range 1 24
    depends on BB_CACHE_SWEEP_ENABLE
    help
        FreeRTOS task priority for the sweep worker. Default 1 (lowest
        application priority) matches the house background-worker default --
        background housekeeping should not compete with time-sensitive
        application tasks.

config BB_CACHE_SWEEP_WORKER_CORE
    int "bb_cache eviction sweep worker task core affinity"
    default -1
    range -1 1
    depends on BB_CACHE_SWEEP_ENABLE
    help
        -1 = no affinity (default, runs on either core); 0 or 1 = pin the
        sweep worker task to that core.

endmenu
```

## components/bb_cache_reactive/Kconfig
```kconfig
menu "breadboard: bb_cache_reactive"

config BB_CACHE_REACTIVE_ENABLE
    bool "Enable bb_cache_reactive change-driven observers"
    default n
    help
        When disabled, bb_cache_reactive_observe() compiles to a safe
        no-op (BB_ERR_UNSUPPORTED) and bb_cache_reactive_update() compiles
        to a direct passthrough to bb_cache_update() -- callers can invoke
        either unconditionally at zero cost. Disable on tight boards (e.g.
        ESP32-C3) that do not need change-driven push delivery.

        When enabled, observers registered via bb_cache_reactive_observe()
        are fired synchronously (on the writer's thread, after the
        internal observer-lock is released) whenever
        bb_cache_reactive_update() reports a changed value.

config BB_CACHE_REACTIVE_MAX_OBSERVERS
    int "Maximum number of registered reactive observers"
    default 8
    range 1 32
    depends on BB_CACHE_REACTIVE_ENABLE
    help
        Fixed-size observer pool. Each slot holds a key buffer
        (BB_CACHE_KEY_MAX bytes) plus three callback pointers and a ctx
        pointer -- cheap; raise only if more than 8 concurrent observers
        (e.g. WS delta sink + display + brood aggregator) are needed.

config BB_CACHE_REACTIVE_PAYLOAD_MAX
    int "Max serialized {ts_ms,data} envelope bytes fetched per on_change fire"
    default 512
    range 64 4096
    depends on BB_CACHE_REACTIVE_ENABLE
    help
        Stack buffer size used to fetch a changed key's serialized envelope
        via bb_cache_get_serialized() before firing on_change. Must be large
        enough to hold the largest observed key's envelope (512 matches the
        bb_net_health "net.health" precedent) or fire_on_change silently
        drops the notification (logged) for that key.

endmenu
```

## components/bb_cache_routes/Kconfig
```kconfig
menu "breadboard: bb_cache_routes"

config BB_CACHE_ROUTES_BUF_BYTES
    int "Stack buffer size for the serialized cache snapshot (bytes)"
    default 768
    range 128 2048
    help
        Buffer used by the GET /api/cache handler to hold the
        bb_cache_get_serialized() envelope for one key. Must be large enough
        to hold the largest registered key's {"ts_ms":N,"data":{...}}
        envelope, or the handler returns 500 (BB_ERR_NO_SPACE).

        This buffer is stack-allocated on the httpd worker task and must
        stay well under CONFIG_BB_HTTP_TASK_STACK_SIZE (default 6144).

endmenu
```

## components/bb_cache_serialize/Kconfig
```kconfig
menu "bb_cache_serialize"

config BB_CACHE_SERIALIZE_MAX_ENTRIES
    int "Maximum number of registered (format, key) render memo slots"
    default 8
    range 1 32
    help
        Fixed-size slot table capacity. Each slot holds one memoized
        rendered payload for a single (format, key) pair -- increase if
        more than 8 distinct wire endpoints are memoized via
        bb_cache_serialize_get() at once.

config BB_CACHE_SERIALIZE_BUF_BYTES
    int "Render memo slot buffer size (bytes)"
    default 512
    range 64 4096
    help
        Dual-budget knob -- this single value sizes BOTH the per-slot
        rendered wire bytes buffer (.bss, one per slot: standing cost is
        BB_CACHE_SERIALIZE_BUF_BYTES * BB_CACHE_SERIALIZE_MAX_ENTRIES bytes)
        AND the raw-struct snapshot scratch buffer (a stack array on the
        CALLING task, sized fresh for each bb_cache_serialize_get() call).
        Size it for the LARGER of the two requirements: the widest rendered
        JSON payload, or the largest owned struct being snapshotted. A
        render or snapshot whose size exceeds this fails with
        BB_ERR_NO_SPACE.

config BB_CACHE_SERIALIZE_MAX_KEYS
    int "Maximum number of registered (key -> descriptor) bindings"
    default 8
    range 1 32
    help
        Fixed-size descriptor registry capacity. Each entry binds one
        bb_cache key to its {descriptor, gather, ctx} via
        bb_cache_serialize_register() -- increase if more than 8 distinct
        keys register a serialize binding at once.

endmenu
```

## components/bb_core/Kconfig
```kconfig
menu "breadboard: OTA strategy"

choice BB_OTA_STRATEGY
    prompt "OTA update strategy (/api/update/apply owner)"
    default BB_OTA_STRATEGY_PULL
    help
        Selects which component owns POST /api/update/apply. Exactly one
        strategy is active per board, so /apply has a single registrant and
        bb_ota_pull / bb_ota_boot never both auto-register the route.

        This choice only drives the default of the per-component autoregister
        symbols (BB_OTA_PULL_AUTOREGISTER, BB_OTA_BOOT_AUTOREGISTER); each can
        still be overridden to register the route manually.

config BB_OTA_STRATEGY_PULL
    bool "In-place pull (bb_ota_pull owns /api/update/apply)"
    help
        bb_ota_pull downloads + flashes the new image in place at runtime
        heap, then reboots. Suitable for boards with enough contiguous heap
        for the TLS + OTA buffers.

config BB_OTA_STRATEGY_BOOT
    bool "Boot-mode full-heap pull (bb_ota_boot owns /api/update/apply)"
    help
        bb_ota_boot arms a one-shot flag and reboots; the manifest resolve +
        firmware download run at FULL early-boot heap before any subsystem
        starts. For tight / serial-less single-core boards (e.g.
        esp32-s2-mini) that cannot afford an in-place pull under a fragmented
        runtime heap.

config BB_OTA_STRATEGY_NONE
    bool "None / push-only (no /api/update/apply owner)"
    help
        Neither pull nor boot auto-registers /api/update/apply. Use for
        push-only firmware delivery (POST /api/update/push) or boards with no
        onboard OTA trigger.

endchoice

config BB_OTA_STATIC_STACK
    bool "Use static (BSS) stacks for OTA PULL-strategy worker tasks"
    default n
    help
        Reserve the OTA PULL-strategy worker task stacks (ota_pull, upd_check)
        in static BSS at boot instead of allocating them from the heap on demand.
        Enable on boards where high-uptime internal-heap fragmentation can make
        those workers fail to spawn. Consumers enable it per-fleet (e.g.
        TaipanMiner sets it in sdkconfig.defaults).

        Boot-mode boards (BB_OTA_STRATEGY_BOOT) self-exempt via their
        AUTOREGISTER=n; this option affects only the two PULL-strategy runtime
        workers.

endmenu
```
