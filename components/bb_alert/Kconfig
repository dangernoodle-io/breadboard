## components/bb_diag/Kconfig
```kconfig
menu "breadboard: bb_diag"

config BB_DIAG_PANIC_CAPTURE
    bool "Capture log tail to RTC RAM for panic diagnosis"
    default y
    help
        Mirrors bb_log_stream output to RTC slow memory so the last
        few KB of log lines survive a software reboot. Exposed via
        GET /api/diag/panic on the next boot if the previous boot was
        abnormal (panic, watchdog, brownout). Costs CONFIG_BB_DIAG_PANIC_BUF_SIZE
        bytes of RTC slow memory.

config BB_DIAG_PANIC_BUF_SIZE
    int "Panic log RTC buffer size (bytes)"
    default 1024
    range 512 8192
    depends on BB_DIAG_PANIC_CAPTURE
    help
        Size of the circular buffer in RTC slow memory. Must fit in
        the chip's RTC slow memory budget (~8KB on ESP32-S3, less on
        smaller chips). ~30 lines fit in 1024 bytes; raise if you need
        deeper panic context. Default 1024 saves 1 KB RTC slow memory
        vs the old default of 2048.

config BB_DIAG_PANIC_COREDUMP
    bool "Capture ESP-IDF coredump for panic backtraces"
    default n
    depends on BB_DIAG_PANIC_CAPTURE
    help
        On panic, ESP-IDF writes a coredump to a dedicated flash partition.
        On the next boot, bb_diag_panic decodes it via esp_core_dump_get_summary
        and exposes the task name, exception PC, and backtrace via
        GET /api/diag/panic. Requires a "coredump" partition entry in the
        consumer's partitions.csv (see examples/smoke/partitions.*.csv for
        the 64 KB layout). Also requires the following in sdkconfig.defaults:
            CONFIG_ESP_COREDUMP_ENABLE_TO_FLASH=y
            CONFIG_ESP_COREDUMP_DATA_FORMAT_ELF=y
            CONFIG_ESP_COREDUMP_CHECKSUM_CRC32=y
        Disabled by default to avoid forcing the partition change on existing
        consumers.


# BB_DIAG_ROUTES, BB_DIAG_PANIC_TRIGGER, and BB_DIAG_SECTIONS moved to
# bb_diag_http's own Kconfig menu (B1-1153, KB 1477) -- they now gate that
# component's own SRCS, not bb_diag's. Same symbol names, relocated
# ownership: existing sdkconfig files need no changes (Kconfig symbols are a
# flat, global namespace regardless of which component's Kconfig declares
# them -- same precedent as bb_wifi_http's CONFIG_BB_WIFI_ROUTES_AUTOREGISTER
# relocation).

config BB_DIAG_SECTION_SCRATCH_BYTES
    int "Shared render scratch buffer size (bytes)"
    default 1536
    range 64 4096
    depends on BB_DIAG_SECTIONS
    help
        Size of the stack buffer a dispatched /api/diag/<name> request
        fills a section's snapshot into before rendering. Every
        registered section's snap_desc->snap_size must fit within this
        bound -- bb_diag_register_section() rejects (BB_ERR_NO_SPACE) any
        section whose snapshot exceeds it, rather than truncating at
        request time. Default raised from 512 to 1536 (B1-767 PR9) to fit
        the storage/nvs and storage/partitions sections' snapshots
        (~1.3KB / ~1KB at their default caps) with headroom.

config BB_DIAG_STORAGE_PARTITIONS_ROW_CAP
    int "storage/partitions section: max partition rows per response"
    default 16
    range 1 32
    depends on BB_DIAG_SECTIONS
    help
        Caller-allocated array capacity for the GET
        /api/diag/storage/partitions section's row list. Matches the
        existing legacy /api/diag/partitions handler's hardcoded parts[16]
        (bb_partition_routes.c) -- same precedent, not invented.

config BB_DIAG_SECTION_QUERY_VALUE_BYTES
    int "Per-query-param value buffer size (bytes)"
    default 32
    range 8 256
    depends on BB_DIAG_SECTIONS
    help
        Size of the stack buffer used to hold one query-string value while
        threading a section's declared query_keys through to its fill
        hook. A value longer than this is truncated (same convention as
        bb_http_req_query_key_value()).

endmenu
```

## components/bb_diag_http/Kconfig
```kconfig
menu "breadboard: bb_diag_http (bb_diag's aggregate HTTP surface)"

config BB_DIAG_ROUTES
    bool "Build bb_diag HTTP routes"
    default y
    depends on BB_DIAG_PANIC_CAPTURE
    help
        When enabled, bb_diag_http registers the legacy exact-route HTTP
        handlers: GET/DELETE /api/diag/boot, GET/DELETE /api/diag/panic,
        GET /api/diag/coredump, GET /api/diag/heap-check, GET /api/diag/tasks,
        and GET /api/diag/sockets. Relocated verbatim from bb_diag (B1-1153)
        -- same symbol name, same behavior, only ownership moved.

config BB_DIAG_PANIC_TRIGGER
    bool "Expose POST /api/diag/panic/trigger to force a panic (debug only)"
    default n
    depends on BB_DIAG_ROUTES
    help
        When enabled, bb_diag_http exposes POST /api/diag/panic/trigger which
        deliberately dereferences a null pointer to force a LoadProhibited
        panic. Used to validate panic capture / coredump end-to-end on bench
        hardware without physically rebooting the device. NEVER ship to
        production: any unauthenticated caller can crash the firmware.

config BB_DIAG_SECTIONS
    bool "Build the generic /api/diag/* section registry (wildcard dispatch)"
    default y
    help
        When enabled, bb_diag_sections_init() registers a GET /api/diag/*
        wildcard route dispatching to whichever section a caller has
        registered via bb_diag_register_section() (bb_diag). Independent of
        BB_DIAG_ROUTES (the legacy exact-route panic/coredump handlers) --
        this registry is a separate, generic seam that will eventually
        replace those handlers section by section. The portable registry
        itself (bb_diag_register_section, bb_diag) always builds regardless
        of this option; only this component's ESP-IDF wildcard-route
        dispatcher is gated.

# Dissolved in from the former bb_storage_http component (B1-1154, KB 1477)
# -- DELETE /api/diag/storage always builds (same posture as
# BB_DIAG_SECTIONS' portable registry above); this option gates ONLY the
# separate, destructive POST /api/diag/factory-reset route. Symbol name
# KEPT unchanged from its bb_storage_http-era name -- renaming would break
# any sdkconfig.defaults already setting it.
config BB_STORAGE_HTTP_FACTORY_RESET
    bool "Enable POST /api/diag/factory-reset route (full NVS wipe + deferred reboot)"
    default n
    help
      When enabled, registers POST /api/diag/factory-reset. A valid request
      body {"confirm":"factory-reset"} erases the entire "nvs" bb_storage
      backend (all namespaces), invalidates the RTC creds mirror so the
      restore-heal path cannot resurrect credentials, responds 202, then
      reboots after ~500 ms. Disabled by default because factory reset is a
      destructive operation that should be opt-in.

# Dissolved in from the former bb_log_http component (B1-1155, KB 1477) --
# symbol names KEPT unchanged from their bb_log_http-era names; renaming
# would break any sdkconfig.defaults already setting them.
config BB_LOG_ROUTES
    bool "Build bb_log HTTP routes (log-level GET/POST)"
    default y
    help
        When enabled, bb_diag_http compiles the routes module that exposes
        GET /api/log/level and POST /api/log/level. Disable for headless
        logging-only consumers that compose bb_diag_http but don't want the
        routes wired.

        The structured log stream is served separately via bb_data/
        bb_data_http at GET /api/events?topic=log (see bb_log_event's
        "log" bb_data key, B1-1045).

config BB_LOG_SSE_KEEPALIVE_MS
    int "SSE keepalive interval (ms)"
    default 5000
    range 1000 60000
    depends on BB_LOG_ROUTES
    help
        Vestigial — the /api/logs SSE route has been retired. This symbol
        is kept to avoid build breakage on boards that still reference it
        via sdkconfig. It is unused.

endmenu
```

## components/bb_dispatch_cmd/Kconfig
```kconfig
menu "breadboard: bb_dispatch_cmd"

config BB_DISPATCH_CMD_CAP
    int "Command dispatch table capacity"
    default 32
    help
        Maximum number of registered actions in the static dispatch table.
        Each entry costs sizeof(bb_dispatch_cmd_entry_t) (a function pointer
        + context pointer + action string pointer). Registering more actions
        than this returns BB_ERR_NO_SPACE (logged, non-fatal).

endmenu
```

## components/bb_display/Kconfig
```kconfig
menu "bb_display"

menu "bb_display fonts"

config BB_DISPLAY_FONT_5X8
    bool "Include 5x8 font"
    default y
    help
        Spleen 5x8 bitmap font (~760 B flash rodata). Disable to save
        flash when the 5x8 font is not used.

config BB_DISPLAY_FONT_6X12
    bool "Include 6x12 font"
    default y
    help
        Spleen 6x12 bitmap font (~1140 B flash rodata). Disable to save
        flash when the 6x12 font is not used.

config BB_DISPLAY_FONT_8X16
    bool "Include 8x16 font"
    default y
    help
        Spleen 8x16 bitmap font (~1520 B flash rodata). Disable to save
        flash when the 8x16 font is not used.

endmenu

# B1-893: re-homed from the deleted bb_display_info satellite Kconfig
# verbatim -- health.display's cache/SSE surface is independent of bb_info
# and stays live. Symbol name kept as BB_DISPLAY_INFO_AUTO_ATTACH on
# relocation: it is tracked by the di_legacy fence's auto_attach_kconfig
# marker by (type, symbol) identity, not file path, so renaming it would
# read as a new marker rather than a pure move -- see scripts/bbtool/README.md.
config BB_DISPLAY_INFO_AUTO_ATTACH
    bool "Auto-attach health.display to /api/events"
    default n
    depends on BB_EVENT_ROUTES_AUTOREGISTER
    help
        When enabled, bb_display_register_info attaches the "health.display"
        topic to the bb_event_routes SSE stream so /api/events surfaces it
        without an explicit consumer call. Disable if a consumer wants the
        bb_event topic for internal logic only.
        Default n (opt-in): enable only on boards whose hardware this
        telemetry describes; without it the display panel source is never
        attached.

endmenu
```

## components/bb_display_ek79007/Kconfig
```kconfig
menu "bb_display_ek79007"

config BB_DISPLAY_EK79007_AUTOREGISTER
    bool "Auto-register EK79007 display backend"
    default y
    help
        When enabled, the EK79007 backend self-registers via a
        constructor before app_main and bb_display_init() will
        select it. Disable to keep the component's public API
        available without registering at link time.

endmenu
```

## components/bb_display_ili9341/Kconfig
```kconfig
menu "bb_display_ili9341"

config BB_DISPLAY_ILI9341_AUTOREGISTER
    bool "Auto-register ILI9341 backend"
    default y

config BB_DISPLAY_ILI9341_SPI_HOST
    int "SPI host (2 = SPI2_HOST, 3 = SPI3_HOST)"
    default 2
    range 2 3

config BB_DISPLAY_ILI9341_PIXEL_CLK_HZ
    int "SPI pixel clock (Hz)"
    default 40000000
    help
        ILI9341 tops out around 40 MHz on most boards. Drop to 20 MHz
        if you see tearing or unreliable transfers on long ribbon
        cables (e.g. Arduino shield form factor).

config BB_DISPLAY_ILI9341_READ_CLK_HZ
    int "SPI read clock for register probing (Hz)"
    default 5000000
    range 100000 10000000
    help
        Clock used only during probe (RDDID 0xD3 read). The ILI9341 cannot
        drive MISO reliably above ~6.6 MHz. After probe this IO handle is
        deleted and the pixel clock (above) is used for all subsequent writes.
        Default 5 MHz is safe for known CYD/breakout boards.

config BB_DISPLAY_ILI9341_BL_ACTIVE_LOW
    bool "Backlight is active-low"
    default n
    help
        Most generic ILI9341 boards drive backlight active-high
        (BL=1 turns the LED on). Some Arduino shields invert it.

config BB_DISPLAY_ILI9341_SKIP_PROBE
    bool "Skip RDDID probe (assume panel present)"
    default n
    help
        When set, the ILI9341 backend registers with a NULL probe, so
        bb_display_init treats it as present without an RDDID read. Use on
        boards whose panel MISO/SDO is not wired (e.g. many CYD variants are
        write-only) — the panel is committed at build time, and writes work
        at the full pixel clock. Leave off for boards with readable MISO.

endmenu
```

## components/bb_display_info/Kconfig
```kconfig
menu "breadboard: bb_display_info"

config BB_DISPLAY_INFO_AUTO_ATTACH
    bool "Auto-attach health.display to /api/events"
    default n
    depends on BB_EVENT_ROUTES_AUTOREGISTER
    help
        When enabled, bb_display_register_info attaches the "health.display"
        topic to the bb_event_routes SSE stream so /api/events surfaces it
        without an explicit consumer call. Disable if a consumer wants the
        bb_event topic for internal logic only.
        Default n (opt-in): enable only on boards whose hardware this
        telemetry describes; without it the display panel source is never
        attached.

endmenu
```

## components/bb_display_ssd1306/Kconfig
```kconfig
menu "bb_display_ssd1306"

config BB_DISPLAY_SSD1306_AUTOREGISTER
    bool "Auto-register SSD1306 backend"
    default y
    help
        When enabled, the SSD1306 backend self-registers via a
        constructor before app_main and bb_display_init() will
        consider it during the registry walk. Disable to keep the
        component's public API available without registering.

config BB_DISPLAY_SSD1306_I2C_ADDR
    hex "SSD1306 I²C address"
    default 0x3C
    help
        7-bit I²C device address. Most SSD1306 modules use 0x3C
        (SA0=0); some use 0x3D (SA0=1).

config BB_DISPLAY_SSD1306_HEIGHT
    int "OLED height (px)"
    default 32
    help
        128x32 (default) or 128x64. Width is always 128.

config BB_DISPLAY_SSD1306_I2C_HZ
    int "I²C bus speed (Hz)"
    default 400000

endmenu
```
