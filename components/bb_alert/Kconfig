## components/bb_heap_arena/Kconfig
```kconfig
menu "breadboard: bb_heap_arena"

config BB_HEAP_ARENA_BYTES
    int "mbedTLS arena size (bytes; 0 = disabled, use heap fallback only)"
    range 0 65536
    default 0
    help
        Size in bytes of the static boot-reserved contiguous arena for mbedTLS
        allocations. When > 0 and CONFIG_MBEDTLS_CUSTOM_MEM_ALLOC=y, a
        static uint8_t buffer of this size is registered as a private multi_heap
        at boot. mbedTLS allocations are tried arena-first; if the arena is
        exhausted, the allocator falls back to heap_caps_calloc(INTERNAL|8BIT).

        0 (default) = no arena buffer; all mbedTLS allocations go directly to
        heap_caps_calloc(INTERNAL|8BIT) (the ESP-IDF default pool).

        Requires CONFIG_MBEDTLS_CUSTOM_MEM_ALLOC=y to have any effect.
        For no-PSRAM wroom32/c3/tdongle boards: set to 14336 (14 KB) to cover
        the manifest check TLS handshake (IN buffer + ssl_context + handshake).

config BB_HEAP_ARENA_AUTOREGISTER
    bool "Auto-register bb_heap_arena at EARLY tier"
    default n
    depends on MBEDTLS_CUSTOM_MEM_ALLOC
    help
        When enabled, bb_heap_arena registers itself at the EARLY tier via
        bb_init, calling bb_heap_arena_init() during bb_init_init_early().

        WARNING: This may race with bb_wifi's WPA-supplicant mbedTLS use.
        The SAFE contract is to call bb_heap_arena_init() explicitly at the TOP
        of app_main(), BEFORE bb_init_init_early(). Only enable this if
        you are certain no mbedTLS use occurs before EARLY-tier init and
        bb_heap_arena is registered at a lower order than bb_wifi.

        Default: n (use explicit bb_heap_arena_init() instead).

endmenu
```
