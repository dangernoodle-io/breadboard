## components/bb_display_st77xx/Kconfig
```kconfig
menu "bb_display_st77xx"

choice BB_DISPLAY_ST77XX_VARIANT
    prompt "ST77xx panel variant"
    default BB_DISPLAY_ST77XX_VARIANT_ST7735
    help
        Picks which backend the bb_display_st77xx component compiles
        and registers. Both variants share the underlying ESP-IDF
        st7789 panel driver; the ST7735 path overlays a custom
        vendor-init sequence (gamma/power/frame) needed for the
        LilyGo T-Dongle S3 panel that the default ST7735 driver
        doesn't program correctly. Future probe-capable boards can
        register both and let the registry's probe()->init() walker
        pick at runtime.

config BB_DISPLAY_ST77XX_VARIANT_ST7735
    bool "ST7735 (LilyGo T-Dongle S3)"

config BB_DISPLAY_ST77XX_VARIANT_ST7789
    bool "ST7789 (generic)"

endchoice

config BB_DISPLAY_ST7735_AUTOREGISTER
    bool "Auto-register ST7735 backend"
    depends on BB_DISPLAY_ST77XX_VARIANT_ST7735
    default y

config BB_DISPLAY_ST7789_AUTOREGISTER
    bool "Auto-register ST7789 backend"
    depends on BB_DISPLAY_ST77XX_VARIANT_ST7789
    default y

config BB_DISPLAY_ST7735_SKIP_VENDOR_INIT
    bool "ST7735: skip vendor-init overlay"
    depends on BB_DISPLAY_ST77XX_VARIANT_ST7735
    default n
    help
        The ST7735 backend overlays a custom vendor-init sequence
        (gamma/power/frame) on top of esp_lcd_new_panel_st7789's
        standard init. This is needed for the LilyGo T-Dongle S3
        panel, where the default driver doesn't program the chip
        correctly. Enable this option for ST7735 panels where the
        stock driver works on its own — skips the overlay entirely.

config BB_DISPLAY_ST77XX_SPI_HOST
    int "SPI host number for the ST77xx LCD bus"
    range 0 2
    default 1
    help
        SPI peripheral index passed to bb_display_spi_init_bus as the host.
        Matches the spi_host_device_t enum values: 0=SPI1_HOST, 1=SPI2_HOST
        (HSPI on classic ESP32), 2=SPI3_HOST (VSPI on classic ESP32).
        Default 1 = SPI2_HOST, the factory default for LilyGo T-Dongle S3
        and most ST77xx boards.

config BB_DISPLAY_ST77XX_CLK_HZ
    int "SPI clock frequency for the ST77xx LCD bus (Hz)"
    range 1000000 80000000
    default 20000000
    help
        Pixel clock in Hz for the SPI master driving the ST77xx panel.
        Default 20 000 000 (20 MHz) works on the LilyGo T-Dongle S3 and
        most ST77xx panels. Some panels tolerate up to 40 MHz; lower to
        10 MHz if you see display corruption on longer cable runs.

endmenu
```

## components/bb_event/Kconfig
```kconfig
menu "breadboard: bb_event"

config BB_EVENT_MAX_TOPICS
    int "Maximum number of event topics"
    default 8
    range 1 256
    help
        Maximum number of topics that can be created at runtime.
        Default 8 covers typical usage (update.available, mining.share.*,
        ota.progress, etc.) and saves ~2 KB BSS vs the old default of 16.
        Raise if your application attaches more than 8 concurrent topics.

config BB_EVENT_QUEUE_DEPTH
    int "Event queue depth per subscription"
    default 16
    range 1 256
    help
        Number of events that can be queued per subscription before
        the oldest event is dropped.

config BB_EVENT_MAX_PAYLOAD
    int "Maximum event payload size (bytes)"
    default 1024 if SPIRAM
    default 512
    range 0 4096
    help
        Maximum size of event payload data. Set to 0 if events
        contain only metadata.

        PSRAM-axis DERIVE (TA-517): default 1024 on SPIRAM boards, 512 on
        no-PSRAM boards, sized to carry a full telemetry-scale serialized
        payload without truncation.

endmenu
```

## components/bb_event_ring/Kconfig
```kconfig
menu "breadboard: bb_event_ring"

config BB_EVENT_RING_ENABLED
    bool "Enable bb_event_ring"
    default y
    help
        Enable the ring buffer event storage backend.

endmenu
```

## components/bb_event_routes/Kconfig
```kconfig
menu "breadboard: bb_event_routes"

config BB_EVENT_ROUTES_AUTOREGISTER
    bool "Auto-register /api/events route via bb_init"
    default y
    help
        When enabled, bb_event_routes registers GET /api/events automatically
        via the bb_init regular tier after the HTTP server starts.

config BB_EVENT_ROUTES_MAX_CLIENTS
    int "Max concurrent SSE clients"
    default 2
    range 1 32
    help
        Maximum number of simultaneous /api/events subscribers. Additional
        connections receive 503 {"error":"max_clients"}.

        Default is conservative for tight-heap boards (ESP32-S3 without PSRAM,
        ~30 KB heap budget for idle TLS handshake). Each client consumes ~2.7 KB
        (8*256 B payload buf + 8*24 B queue entry overhead + ~88 B mutex).
        Consumers with more heap can override in sdkconfig.

config BB_EVENT_ROUTES_QUEUE_DEPTH
    int "Per-client event queue depth"
    default 8
    range 4 256
    help
        Events buffered per subscriber. On overflow, the oldest entry is
        dropped and the dropped counter is incremented; the next emitted
        frame's id reflects the gap.

        Default is conservative for tight-heap boards (ESP32-S3 without PSRAM,
        ~30 KB heap budget for idle TLS handshake). With default max_clients=2
        and queue_depth=8, each client consumes ~2.7 KB total. Consumers with
        more heap can override in sdkconfig.

config BB_EVENT_ROUTES_RING_CAPACITY
    int "Per-attached-topic replay ring capacity (non-retained)"
    default 16
    range 1 256
    help
        bb_event_ring depth backing replay-on-connect for each non-retained
        (discrete-event) attached topic.

config BB_EVENT_ROUTES_RETAINED_RING_CAPACITY
    int "Per-attached-topic replay ring capacity (retained)"
    default 1
    range 1 256
    help
        bb_event_ring depth backing replay-on-connect for each retained
        (state) attached topic. A retained topic only ever needs to replay its
        latest value on connect, so the default is 1. On no-PSRAM boards this
        saves ~1 KB of internal heap per retained topic compared to the
        non-retained capacity.

config BB_EVENT_ROUTES_RING_MAX_ENTRY
    int "Per-attached-topic replay payload cap (bytes)"
    default 256
    range 16 4096
    help
        Maximum per-event payload size buffered for replay.

config BB_EVENT_ROUTES_POOL_STATIC
    bool "Permanent static-BSS SSE pool (default: lazy heap-backed instead)"
    default n
    help
        The SSE per-client pool (queue entries + payload buffers, and on
        ESP-IDF the writer task stack + TCB) is always index-addressed —
        client slot i deterministically owns pool bundle i for the pool's
        lifetime (B1-478 PR E; no shared free-list, no per-connect
        malloc/free churn). This knob selects the pool's *backing*:

        n (default) — LAZY HEAP-BACKED (B1-491). The pool arena(s) are
        allocated via a single contiguous heap allocation (SPIRAM-preferred
        on ESP-IDF) on the FIRST SSE client connect, not at boot — a board
        that never gets an SSE client (no dashboard attached) pays ~0
        standing RAM. A failed allocation (fragmented/low heap) fails soft:
        the connection is rejected and retried on the next connect attempt,
        never a crash or unchecked NULL. The heap allocation is never freed
        once created (no idle-reclaim) — the per-client bundle includes a
        live FreeRTOS task stack, and freeing a stack out from under a task
        that has not finished exiting is a use-after-free (see B1-484 /
        PR-E-CRITICAL); one standing allocation for the process lifetime is
        the safe trade, and it still fully avoids permanent BSS.

        y — the pre-B1-491 permanent static-BSS arena: fixed BSS reservation
        carved once at boot, sized by the compile-time Kconfig values below,
        never allocated or freed at runtime. Use this on boards that need a
        fully deterministic, zero-heap SSE pool and can afford the fixed
        ~13.5 KB BSS cost at default MAX_CLIENTS/QUEUE_DEPTH/RING_MAX_ENTRY
        (the tightest no-PSRAM boards, e.g. ESP32-C3, generally cannot).

        Both backings are sized by the compile-time Kconfig values
        (BB_EVENT_ROUTES_MAX_CLIENTS, BB_EVENT_ROUTES_QUEUE_DEPTH,
        BB_EVENT_ROUTES_RING_MAX_ENTRY). If the runtime cfg overrides those
        to larger values, acquire returns BB_ERR_NO_SPACE rather than crash.

        In both modes, the writer task is always created with
        xTaskCreateStatic against the pool's stack+TCB bundle, regardless of
        this setting — static allocation is always available on modern
        ESP-IDF (>= 4.3), so this does not depend on any separate Kconfig.

config BB_EVENT_ROUTES_HEARTBEAT_MS
    int "Idle heartbeat interval (ms)"
    default 15000
    range 1000 600000
    help
        On idle, emit a SSE comment-frame `: ping` every N ms so dead peers
        surface promptly via the chunk write.

config BB_EVENT_ROUTES_MAX_TOPICS
    int "Max attached topics"
    default 8
    range 1 64
    help
        Maximum number of topics that can be attached via
        bb_event_routes_attach().

endmenu
```

## components/bb_fan/Kconfig
```kconfig
menu "breadboard: bb_fan"

config BB_FAN_AUTOFAN
    bool "Enable autofan PID controller in bb_fan"
    default n
    help
        When enabled, bb_fan owns a PID-based autofan controller that runs
        inside bb_fan_poll(). Parameters are a faithful port of TaipanMiner's
        proven autofan: Kp=5 Ki=0.1 Kd=2, P_ON_E, REVERSE direction,
        5000 ms sample time, dual EMA (alpha=0.2) for die and aux (VR) temps,
        input-src selected by max((ema-target)/target) ratio.

        When enabled, PATCH /api/sensors (bb_sensor_http, fan section) parses
        autofan config fields (autofan, die_target_c, vr_target_c, manual_pct,
        min_pct) instead of raw duty_pct. GET /api/sensors gains additional
        telemetry fields (die_ema_c, vr_ema_c, pid_input_c, pid_input_src).

        Consumers that feed aux (VR) temperature must call bb_fan_set_aux_temp()
        periodically. bb_fan does not depend on bb_power; the consumer is
        responsible for reading the VR sensor and feeding it here.

        Default off — enable when your app wants bb_fan to own autofan policy.

endmenu
```

## components/bb_fsm/Kconfig
```kconfig
menu "breadboard: bb_fsm"

config BB_FSM_MAX_TIMERS
    int "Max distinct armed timers per instance"
    default 1
    range 1 32
    help
        Fixed-capacity table size for bb_fsm_arm_timer(), sizing the
        embedded timers[] array in bb_fsm_t. Arming a new distinct
        timeout_event beyond this cap fails with BB_ERR_NO_SPACE.

endmenu
```

## components/bb_health/Kconfig
```kconfig
menu "breadboard: bb_health"

config BB_HEALTH_STACK_LOW_BYTES
    int "Stack low-water threshold (bytes)"
    default 256
    range 64 65536
    help
        Free stack bytes below which a task is flagged as low. This is a
        near-overflow danger threshold: a task within ~256 B (64 words) of
        overflowing its stack. The old default of 512 B over-warned because
        fixed-depth system tasks (ipc0, ipc1, bb_log_writer) normally run
        at ~500 B high-water and are not in danger. 256 B fires only when
        a task is genuinely close to overflow. Still tunable via
        CONFIG_BB_HEALTH_STACK_LOW_BYTES.

        A health.stack event posts on the first scan where a task crosses
        below this threshold (transition into low), not on every scan, to
        avoid spamming the event bus. The periodic scan itself is owned by
        bb_task_registry (task-registry unification PR3) --
        CONFIG_BB_TASK_REGISTRY_BASE_POLL_MS sets its cadence and
        CONFIG_BB_TASK_BASE_MAX its tracked-task capacity; this component is
        a pure observer of that scan's low-stack transition callback.

        Strongly recommended: also set
          CONFIG_FREERTOS_CHECK_STACKOVERFLOW_PTRVAL=y
        (CONFIG_FREERTOS_CHECK_STACKOVERFLOW=2) so a real overflow prints
        an attributable task-name message instead of a silent abort.

config BB_HEALTH_STACK_AUTOSTART
    bool "Auto-register the low-stack observer with bb_task_registry at PRE_HTTP"
    default y
    depends on FREERTOS_USE_TRACE_FACILITY
    help
        When enabled, bb_health_stack_monitor_start registers this
        component's low-stack transition handler with bb_task_registry
        (bb_task_registry_set_low_stack_handler) at the pre_http registry
        tier. Disable to call bb_health_stack_monitor_start manually before
        bb_health_stack_monitor_init.

config BB_HEALTH_SECTION_TABLE_CAP
    int "Composer section registry table capacity (bb_health_section, B1-1096)"
    default 8
    range 1 16
    help
        Fixed table capacity for the bb_health_section composer registry
        (components/bb_health/include/bb_health_section.h) -- distinct from
        the legacy bb_health_register_section()/BB_RESPONSE_MAX registry.
        Default 8 matches today's BB_RESPONSE_MAX. ADDITIVE AND INERT in
        this PR -- nothing consumes this registry yet (B1-1096, epic
        B1-1054).

config BB_HEALTH_SECTION_SCRATCH_BYTES
    int "Composer section per-section render scratch buffer size (bytes)"
    default 128
    range 32 1024
    help
        Size of the stack buffer the future bb_health composer (B1-1054
        PR-5) fills one section's snapshot into before rendering it.
        bb_health_section_register() rejects (BB_ERR_NO_SPACE) any section
        whose snap_desc->snap_size exceeds this bound at registration time.
        Default 128 is measured, not padded: the largest known snapshot
        today is 32 B (bb_mqtt_client_health_snap_t and its bb_tcp_client/
        bb_http_client siblings); 128 B is 4x headroom over that. The
        composer's real worst-case path -- the full
        BB_HEALTH_SECTION_TABLE_CAP x BB_HEALTH_SECTION_SCRATCH_BYTES arena
        (1024 B) plus the bb_serialize_json flush buffer (768 B) plus
        root/entries overhead (~200 B), roughly 2 KB total -- fits
        CONFIG_BB_HTTP_TASK_STACK_SIZE's (6144 B) budget checked on this
        composer's own path independently -- the WS-connect snapshot
        path's ~3.5 KB claim is a SEPARATE, sequential top-level route
        dispatch on the same task type, an alternate peak rather than a
        shared claim to subtract -- see bb_health_section_priv.h's
        BB_HEALTH_SECTION_SCRATCH_BYTES comment for the full arithmetic.

endmenu
```
